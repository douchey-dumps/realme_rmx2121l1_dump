/dts-v1/;

/ {

	__fixups__ {
		accdet = "/fragment@68:target:0";
		adc = "/fragment@10/__overlay__/chg:io-channels:0", "/fragment@10/__overlay__/chg:io-channels:8", "/fragment@10/__overlay__/chg:io-channels:16", "/fragment@10/__overlay__/chg:io-channels:24", "/fragment@10/__overlay__/chg:io-channels:32", "/fragment@10/__overlay__/chg:io-channels:40", "/fragment@10/__overlay__/chg:io-channels:48", "/fragment@10/__overlay__/chg:io-channels:56";
		apuart0 = "/fragment@18:target:0";
		auxadc = "/fragment@14/__overlay__:io-channels:0", "/fragment@14/__overlay__:io-channels:8", "/fragment@14/__overlay__:io-channels:16", "/fragment@36:target:0", "/fragment@37/__overlay__:io-channels:0";
		bat_gm30 = "/fragment@13:target:0", "/fragment@15:target:0";
		charger = "/fragment@14:target:0";
		chosen = "/fragment@1:target:0";
		consys = "/fragment@24:target:0";
		dispsys_config = "/fragment@65:target:0";
		dsi0 = "/fragment@66:target:0";
		dsi_te = "/fragment@57:target:0";
		gpio = "/fragment@50:target:0";
		gpio_usage_mapping = "/fragment@49:target:0";
		i2c0 = "/fragment@26:target:0", "/fragment@39:target:0";
		i2c1 = "/fragment@40:target:0";
		i2c2 = "/fragment@34:target:0", "/fragment@35:target:0", "/fragment@41:target:0";
		i2c3 = "/fragment@42:target:0";
		i2c4 = "/fragment@43:target:0";
		i2c5 = "/fragment@44:target:0";
		i2c6 = "/fragment@30:target:0", "/fragment@45:target:0";
		i2c7 = "/fragment@12:target:0", "/fragment@46:target:0";
		i2c8 = "/fragment@47:target:0";
		i2c9 = "/fragment@20:target:0", "/fragment@48:target:0";
		irq_nfc = "/fragment@52:target:0";
		irtx_pwm = "/fragment@69:target:0";
		kd_camera_hw1 = "/fragment@33:target:0", "/fragment@61:target:0";
		keypad = "/fragment@4:target:0", "/fragment@63:target:0";
		md1_sim1_hot_plug_eint = "/fragment@58:target:0";
		md_auxadc = "/fragment@37:target:0";
		mrdump_ext_rst = "/fragment@51:target:0";
		mt6360_ldo = "/fragment@11:target:0";
		mt6360_pmic = "/fragment@8:target:0";
		mt6360_pmu = "/fragment@7:target:0", "/fragment@10:target:0", "/fragment@10/__overlay__/chg:interrupt-parent:0";
		mt6360_typec = "/fragment@9:target:0";
		mt_pmic_vcamio_ldo_reg = "/fragment@33/__overlay__:cam0_vcamio-supply:0", "/fragment@33/__overlay__:cam1_vcamio-supply:0", "/fragment@33/__overlay__:cam2_vcamio-supply:0", "/fragment@33/__overlay__:cam3_vcamio-supply:0", "/fragment@59:target:0", "/fragment@61/__overlay__:vcamio-supply:0";
		mt_pmic_vcn13_ldo_reg = "/fragment@33/__overlay__:cam0_vcamd-supply:0", "/fragment@33/__overlay__:cam1_vcamd-supply:0";
		mt_pmic_vio28_ldo_reg = "/fragment@16:target:0";
		mt_pmic_vmch_ldo_reg = "/fragment@33/__overlay__:cam2_vcama-supply:0";
		mt_pmic_vtp_ldo_reg = "/fragment@33/__overlay__:vcammainaf-supply:0", "/fragment@60:target:0", "/fragment@62/__overlay__:vtouch-supply:0";
		mtkfb = "/fragment@67:target:0";
		odm = "/fragment@2:target:0", "/fragment@77:target:0";
		oppo_fp_common = "/fragment@71:target:0";
		phy_tuning = "/fragment@3:target:0";
		pio = "/fragment@2/__overlay__/kpd_volume_up:interrupt-parent:0", "/fragment@2/__overlay__/kpd_volume_down:interrupt-parent:0", "/fragment@2/__overlay__/oppo_devinfo:Hw,sim_det:0", "/fragment@4/__overlay__:keypad,volume-up:0", "/fragment@4/__overlay__:keypad,volume-down:0", "/fragment@5:target:0", "/fragment@7/__overlay__:mt6360,intr_gpio:0", "/fragment@9/__overlay__:mt6360pd,intr_gpio:0", "/fragment@14/__overlay__:qcom,dischg-gpio:0", "/fragment@17:target:0", "/fragment@19:target:0", "/fragment@21:target:0", "/fragment@22/__overlay__/st54spi@0:gpio-power-std:0", "/fragment@23:target:0", "/fragment@25/__overlay__/touchscreen@0:interrupt-parent:0", "/fragment@25/__overlay__/touchscreen@0:irq-gpio:0", "/fragment@25/__overlay__/touchscreen@0:reset-gpio:0", "/fragment@26/__overlay__/gt9886@5d:interrupt-parent:0", "/fragment@26/__overlay__/gt9886@5d:irq-gpio:0", "/fragment@26/__overlay__/gt9886@5d:reset-gpio:0", "/fragment@27:target:0", "/fragment@28:target:0", "/fragment@32:target:0", "/fragment@49/__overlay__:GPIO_SIM1_HOT_PLUG:0", "/fragment@49/__overlay__:GPIO_SIM2_SCLK:0", "/fragment@49/__overlay__:GPIO_SIM2_SRST:0", "/fragment@49/__overlay__:GPIO_SIM2_SIO:0", "/fragment@49/__overlay__:GPIO_SIM1_SIO:0", "/fragment@49/__overlay__:GPIO_SIM1_SRST:0", "/fragment@49/__overlay__:GPIO_SIM1_SCLK:0", "/fragment@49/__overlay__:GPIO_FDD_BAND_SUPPORT_DETECT_1ST_PIN:0", "/fragment@49/__overlay__:GPIO_FDD_BAND_SUPPORT_DETECT_2ND_PIN:0", "/fragment@49/__overlay__:GPIO_FDD_BAND_SUPPORT_DETECT_3RD_PIN:0", "/fragment@49/__overlay__:GPIO_FDD_BAND_SUPPORT_DETECT_4TH_PIN:0", "/fragment@49/__overlay__:GPIO_RF_PWREN_RST_PIN:0", "/fragment@51/__overlay__:interrupt-parent:0", "/fragment@51/__overlay__:deb-gpios:0", "/fragment@52/__overlay__:interrupt-parent:0", "/fragment@53/__overlay__:interrupt-parent:0", "/fragment@54/__overlay__:interrupt-parent:0", "/fragment@55/__overlay__:interrupt-parent:0", "/fragment@56/__overlay__:interrupt-parent:0", "/fragment@56/__overlay__:deb-gpios:0", "/fragment@57/__overlay__:interrupt-parent:0", "/fragment@64:target:0", "/fragment@66/__overlay__/panel1@0:lcd-1p8-gpios:0", "/fragment@66/__overlay__/panel1@0:pm-enable-gpios:0", "/fragment@66/__overlay__/panel1@0:reset-gpios:0", "/fragment@66/__overlay__/panel1@0:bias-gpios:0", "/fragment@66/__overlay__/panel1@0:bias-gpios:12", "/fragment@66/__overlay__/panel2@0:lcd-1p8-gpios:0", "/fragment@66/__overlay__/panel2@0:pm-enable-gpios:0", "/fragment@66/__overlay__/panel2@0:reset-gpios:0", "/fragment@66/__overlay__/panel2@0:bias-gpios:0", "/fragment@66/__overlay__/panel2@0:bias-gpios:12", "/fragment@70:target:0", "/fragment@71/__overlay__:oppo,fp_gpio_id:0", "/fragment@72:target:0", "/fragment@74:target:0", "/fragment@76:target:0";
		pmic_clock_buffer_ctrl = "/fragment@38:target:0";
		reserved_memory = "/fragment@0:target:0";
		silead_fp = "/fragment@53:target:0", "/fragment@75:target:0";
		snd_audio_dsp = "/fragment@6:target:0";
		sound = "/fragment@29:target:0";
		spi1 = "/fragment@22:target:0";
		spi4 = "/fragment@25:target:0";
		spi5 = "/fragment@73:target:0";
		subpmic_pmu_eint = "/fragment@55:target:0";
		swtp = "/fragment@31:target:0", "/fragment@56:target:0";
		tcpc_pd = "/fragment@54:target:0";
		touch = "/fragment@62:target:0";
	};

	__local_fixups__ {

		fragment@14 {

			__overlay__ {
				pinctrl-0 = <0x0>;
				pinctrl-1 = <0x0>;
				pinctrl-2 = <0x0>;
			};
		};

		fragment@18 {

			__overlay__ {
				pinctrl-0 = <0x0>;
				pinctrl-1 = <0x0>;
			};
		};

		fragment@24 {

			__overlay__ {
				pinctrl-0 = <0x0>;
				pinctrl-1 = <0x0>;
				pinctrl-2 = <0x0>;
				pinctrl-3 = <0x0>;
			};
		};

		fragment@25 {

			__overlay__ {

				touchscreen@0 {
					pinctrl-0 = <0x0>;
				};
			};
		};

		fragment@26 {

			__overlay__ {
				pinctrl-0 = <0x0>;
				pinctrl-1 = <0x0>;
				pinctrl-2 = <0x0>;
				pinctrl-3 = <0x0>;
				pinctrl-4 = <0x0>;
				pinctrl-5 = <0x0>;

				gt9886@5d {
					pinctrl-0 = <0x0 0x4 0x8>;
					pinctrl-1 = <0x0 0x4>;
				};
			};
		};

		fragment@29 {

			__overlay__ {

				mediatek,speaker-codec {
					sound-dai = <0x0>;
				};
			};
		};

		fragment@33 {

			__overlay__ {
				pinctrl-0 = <0x0>;
				pinctrl-1 = <0x0>;
				pinctrl-10 = <0x0>;
				pinctrl-11 = <0x0>;
				pinctrl-12 = <0x0>;
				pinctrl-13 = <0x0>;
				pinctrl-14 = <0x0>;
				pinctrl-15 = <0x0>;
				pinctrl-16 = <0x0>;
				pinctrl-17 = <0x0>;
				pinctrl-18 = <0x0>;
				pinctrl-19 = <0x0>;
				pinctrl-2 = <0x0>;
				pinctrl-20 = <0x0>;
				pinctrl-21 = <0x0>;
				pinctrl-22 = <0x0>;
				pinctrl-23 = <0x0>;
				pinctrl-24 = <0x0>;
				pinctrl-25 = <0x0>;
				pinctrl-26 = <0x0>;
				pinctrl-27 = <0x0>;
				pinctrl-28 = <0x0>;
				pinctrl-29 = <0x0>;
				pinctrl-3 = <0x0>;
				pinctrl-30 = <0x0>;
				pinctrl-31 = <0x0>;
				pinctrl-32 = <0x0>;
				pinctrl-33 = <0x0>;
				pinctrl-34 = <0x0>;
				pinctrl-35 = <0x0>;
				pinctrl-36 = <0x0>;
				pinctrl-4 = <0x0>;
				pinctrl-5 = <0x0>;
				pinctrl-6 = <0x0>;
				pinctrl-7 = <0x0>;
				pinctrl-8 = <0x0>;
				pinctrl-9 = <0x0>;
			};
		};

		fragment@4 {

			__overlay__ {
				pinctrl-0 = <0x0>;
				pinctrl-1 = <0x0>;
			};
		};

		fragment@65 {

			__overlay__ {
				pinctrl-0 = <0x0>;
				pinctrl-1 = <0x0>;
				pinctrl-2 = <0x0>;
			};
		};

		fragment@66 {

			__overlay__ {

				panel1@0 {

					port {

						endpoint {
							remote-endpoint = <0x0>;
						};
					};
				};

				panel2@0 {

					port {

						endpoint {
							remote-endpoint = <0x0>;
						};
					};
				};

				ports {

					port {

						endpoint {
							remote-endpoint = <0x0>;
						};
					};
				};
			};
		};

		fragment@67 {

			__overlay__ {
				pinctrl-0 = <0x0>;
				pinctrl-1 = <0x0>;
				pinctrl-2 = <0x0>;
				pinctrl-3 = <0x0>;
				pinctrl-4 = <0x0>;
				pinctrl-5 = <0x0>;
				pinctrl-6 = <0x0>;
			};
		};

		fragment@69 {

			__overlay__ {
				pinctrl-0 = <0x0>;
				pinctrl-1 = <0x0>;
			};
		};

		fragment@71 {

			__overlay__ {
				pinctrl-0 = <0x0>;
			};
		};

		fragment@75 {

			__overlay__ {
				pinctrl-0 = <0x0>;
				pinctrl-1 = <0x0>;
				pinctrl-2 = <0x0>;
				pinctrl-3 = <0x0>;
				pinctrl-4 = <0x0>;
				pinctrl-5 = <0x0>;
			};
		};
	};

	__symbols__ {
		camera_main_af_mtk = "/fragment@41/__overlay__/camera_main_af@18";
		camera_main_mtk = "/fragment@41/__overlay__/camera_main@6c";
		camera_main_three_mtk = "/fragment@41/__overlay__/camera_main_three@1b";
		camera_main_two_mtk = "/fragment@43/__overlay__/camera_main_two@6e";
		camera_pins_cam0_mclk_2ma = "/fragment@32/__overlay__/camera_pins_cam0_mclk_2ma";
		camera_pins_cam0_mclk_4ma = "/fragment@32/__overlay__/camera_pins_cam0_mclk_4ma";
		camera_pins_cam0_mclk_6ma = "/fragment@32/__overlay__/camera_pins_cam0_mclk_6ma";
		camera_pins_cam0_mclk_8ma = "/fragment@32/__overlay__/camera_pins_cam0_mclk_8ma";
		camera_pins_cam0_mclk_off = "/fragment@32/__overlay__/camera_pins_cam0_mclk_off";
		camera_pins_cam0_rst_0 = "/fragment@32/__overlay__/cam0@0";
		camera_pins_cam0_rst_1 = "/fragment@32/__overlay__/cam0@1";
		camera_pins_cam0_vcama_0 = "/fragment@32/__overlay__/cam0@vcam2";
		camera_pins_cam0_vcama_1 = "/fragment@32/__overlay__/cam0@vcam3";
		camera_pins_cam1_mclk_2ma = "/fragment@32/__overlay__/camera_pins_cam1_mclk_2ma";
		camera_pins_cam1_mclk_4ma = "/fragment@32/__overlay__/camera_pins_cam1_mclk_4ma";
		camera_pins_cam1_mclk_6ma = "/fragment@32/__overlay__/camera_pins_cam1_mclk_6ma";
		camera_pins_cam1_mclk_8ma = "/fragment@32/__overlay__/camera_pins_cam1_mclk_8ma";
		camera_pins_cam1_mclk_off = "/fragment@32/__overlay__/camera_pins_cam1_mclk_off";
		camera_pins_cam1_rst_0 = "/fragment@32/__overlay__/cam1@0";
		camera_pins_cam1_rst_1 = "/fragment@32/__overlay__/cam1@1";
		camera_pins_cam1_vcama_0 = "/fragment@32/__overlay__/cam1@vcam2";
		camera_pins_cam1_vcama_1 = "/fragment@32/__overlay__/cam1@vcam3";
		camera_pins_cam2_mclk_2ma = "/fragment@32/__overlay__/camera_pins_cam2_mclk_2ma";
		camera_pins_cam2_mclk_4ma = "/fragment@32/__overlay__/camera_pins_cam2_mclk_4ma";
		camera_pins_cam2_mclk_6ma = "/fragment@32/__overlay__/camera_pins_cam2_mclk_6ma";
		camera_pins_cam2_mclk_8ma = "/fragment@32/__overlay__/camera_pins_cam2_mclk_8ma";
		camera_pins_cam2_mclk_off = "/fragment@32/__overlay__/camera_pins_cam2_mclk_off";
		camera_pins_cam2_rst_0 = "/fragment@32/__overlay__/cam2@0";
		camera_pins_cam2_rst_1 = "/fragment@32/__overlay__/cam2@1";
		camera_pins_cam2_vcama_0 = "/fragment@32/__overlay__/cam2@vcam2";
		camera_pins_cam2_vcama_1 = "/fragment@32/__overlay__/cam2@vcam3";
		camera_pins_cam3_mclk_2ma = "/fragment@32/__overlay__/camera_pins_cam3_mclk_2ma";
		camera_pins_cam3_mclk_4ma = "/fragment@32/__overlay__/camera_pins_cam3_mclk_4ma";
		camera_pins_cam3_mclk_6ma = "/fragment@32/__overlay__/camera_pins_cam3_mclk_6ma";
		camera_pins_cam3_mclk_8ma = "/fragment@32/__overlay__/camera_pins_cam3_mclk_8ma";
		camera_pins_cam3_mclk_off = "/fragment@32/__overlay__/camera_pins_cam3_mclk_off";
		camera_pins_cam3_rst_0 = "/fragment@32/__overlay__/cam3@0";
		camera_pins_cam3_rst_1 = "/fragment@32/__overlay__/cam3@1";
		camera_pins_cam3_vcama_0 = "/fragment@32/__overlay__/cam3@vcam2";
		camera_pins_cam3_vcama_1 = "/fragment@32/__overlay__/cam3@vcam3";
		camera_pins_default = "/fragment@32/__overlay__/camdefault";
		camera_sub_mtk = "/fragment@43/__overlay__/camera_sub@20";
		camera_sub_two_mtk = "/fragment@41/__overlay__/camera_sub_two@6e";
		charger_pins_default = "/fragment@17/__overlay__/eint0default";
		consys_pins_default = "/fragment@23/__overlay__/consys_default";
		ctp_gt9896s_int_active = "/fragment@27/__overlay__/int1_active";
		ctp_gt9896s_int_suspend = "/fragment@27/__overlay__/int1_suspend";
		ctp_gt9896s_pins_default = "/fragment@27/__overlay__/pins_default";
		ctp_gt9896s_reset_active = "/fragment@27/__overlay__/reset1_active";
		ctp_gt9896s_reset_suspend = "/fragment@27/__overlay__/reset1_suspend";
		ctp_gt9896s_spi_mode = "/fragment@27/__overlay__/spimode_default";
		ctp_novatek_spi_mode = "/fragment@28/__overlay__/ctp_novatek_spi_mode";
		ctp_pins_default = "/fragment@27/__overlay__/eintdefault";
		ctp_ts_i2c_mode = "/fragment@27/__overlay__/i2cmode_default";
		ctp_ts_int_active = "/fragment@27/__overlay__/int_active";
		ctp_ts_int_suspend = "/fragment@27/__overlay__/int_suspend";
		ctp_ts_reset_active = "/fragment@27/__overlay__/reset_active";
		ctp_ts_reset_suspend = "/fragment@27/__overlay__/reset_suspend";
		dischg_disable = "/fragment@17/__overlay__/dischg_disable";
		dischg_enable = "/fragment@17/__overlay__/dischg_enable";
		dsi_out = "/fragment@66/__overlay__/ports/port/endpoint";
		fan53870_mtk = "/fragment@48/__overlay__/fan53870@35";
		fingerprint_pins_default = "/fragment@74/__overlay__/fp_default";
		gpio_id0_default = "/fragment@72/__overlay__/gpio_id0_default";
		gpio_redriver_c1_high = "/fragment@21/__overlay__/c1_high";
		gpio_redriver_c1_hiz = "/fragment@21/__overlay__/c1_highz";
		gpio_redriver_c1_init = "/fragment@21/__overlay__/c1_init";
		gpio_redriver_c1_low = "/fragment@21/__overlay__/c1_low";
		gpio_redriver_c2_high = "/fragment@21/__overlay__/c2_high";
		gpio_redriver_c2_hiz = "/fragment@21/__overlay__/c2_highz";
		gpio_redriver_c2_init = "/fragment@21/__overlay__/c2_init";
		gpio_redriver_c2_low = "/fragment@21/__overlay__/c2_low";
		gpio_u3_switch_disable = "/fragment@21/__overlay__/u3_sw_dis";
		gpio_u3_switch_enable = "/fragment@21/__overlay__/u3_sw_en";
		gpio_u3_switch_sel1 = "/fragment@21/__overlay__/u3_sw_sel1";
		gpio_u3_switch_sel2 = "/fragment@21/__overlay__/u3_sw_sel2";
		gpslna_pins_init = "/fragment@23/__overlay__/gpslna@0";
		gpslna_pins_oh = "/fragment@23/__overlay__/gpslna@1";
		gpslna_pins_ol = "/fragment@23/__overlay__/gpslna@2";
		i2c_lcd_bias_mtk = "/fragment@45/__overlay__/i2c_lcd_bias@3e";
		irtx_gpio_led_default = "/fragment@70/__overlay__/irtx_gpio_led_def@gpio57";
		irtx_gpio_led_set = "/fragment@70/__overlay__/irtx_gpio_led_set@gpio57";
		kpd_volume_down = "/fragment@2/__overlay__/kpd_volume_down";
		kpd_volume_up = "/fragment@2/__overlay__/kpd_volume_up";
		led0 = "/fragment@2/__overlay__/led@0";
		led1 = "/fragment@2/__overlay__/led@1";
		led2 = "/fragment@2/__overlay__/led@2";
		led3 = "/fragment@2/__overlay__/led@3";
		led4 = "/fragment@2/__overlay__/led@4";
		led5 = "/fragment@2/__overlay__/led@5";
		led6 = "/fragment@2/__overlay__/led@6";
		mtk_camera_eeprom0 = "/fragment@34/__overlay__/camera_eeprom0@50";
		mtk_camera_eeprom3 = "/fragment@35/__overlay__/camera_eeprom3@52";
		mtkfb_pins_lcd_bias_enn0 = "/fragment@64/__overlay__/lcd_bias_enn0_gpio";
		mtkfb_pins_lcd_bias_enn1 = "/fragment@64/__overlay__/lcd_bias_enn1_gpio";
		mtkfb_pins_lcd_bias_enp0 = "/fragment@64/__overlay__/lcd_bias_enp0_gpio";
		mtkfb_pins_lcd_bias_enp1 = "/fragment@64/__overlay__/lcd_bias_enp1_gpio";
		mtkfb_pins_lcm_dsi_te = "/fragment@64/__overlay__/lcm_dsi_te";
		mtkfb_pins_lcm_rst_out0_gpio = "/fragment@64/__overlay__/lcm_rst_out0_gpio";
		mtkfb_pins_lcm_rst_out1_gpio = "/fragment@64/__overlay__/lcm_rst_out1_gpio";
		nfc_mtk = "/fragment@42/__overlay__/nfc@08";
		oppo_devinfo = "/fragment@2/__overlay__/oppo_devinfo";
		oppo_fp = "/fragment@73/__overlay__/fingerprint@0";
		oppo_project = "/fragment@2/__overlay__/oppo_project";
		panel_in1 = "/fragment@66/__overlay__/panel1@0/port/endpoint";
		panel_in2 = "/fragment@66/__overlay__/panel2@0/port/endpoint";
		silfp_default = "/fragment@76/__overlay__/silfpdefault";
		silfp_irq = "/fragment@76/__overlay__/fp_eint@7";
		silfp_irq_low = "/fragment@76/__overlay__/silfp_irq_low";
		silfp_rst_high = "/fragment@76/__overlay__/state_reset_high";
		silfp_rst_low = "/fragment@76/__overlay__/state_reset_low";
		speaker_amp = "/fragment@30/__overlay__/speaker_amp@34";
		strobe_main_mtk = "/fragment@42/__overlay__/strobe_main@63";
		subpmic_ldo_mtk = "/fragment@44/__overlay__/subpmic_ldo@64";
		subpmic_mtk = "/fragment@44/__overlay__/subpmic@34";
		subpmic_pmic_mtk = "/fragment@44/__overlay__/subpmic_pmic@1a";
		uart0_rx_gpio_input = "/fragment@19/__overlay__/uart0_rx_gpio@gpio61";
		uart0_tx_gpio_input = "/fragment@19/__overlay__/uart0_tx_gpio@gpio62";
		usb_default = "/fragment@21/__overlay__/usb_default";
		usb_type_c_mtk = "/fragment@44/__overlay__/usb_type_c@4e";
		vibrator0 = "/fragment@2/__overlay__/vibrator@0";
		volume_down_gpio_eint = "/fragment@5/__overlay__/volume_down@0";
		volume_up_gpio_eint = "/fragment@5/__overlay__/volume_up@0";
	};

	fragment@0 {
		target = <0xffffffff>;

		__overlay__ {
		};
	};

	fragment@1 {
		target = <0xffffffff>;

		__overlay__ {
			atag,videolfb-fb_base_h = <0x0>;
			atag,videolfb-fb_base_l = "~`P";
			atag,videolfb-fps = <0x1770>;
			atag,videolfb-islcm_inited = <0x0>;
			atag,videolfb-islcmfound = <0x1>;
			atag,videolfb-lcmname = "nt35595_fhd_dsi_cmd_truly_nt50358_drv";
			atag,videolfb-vramSize = <0x1be0000>;
		};
	};

	fragment@10 {
		target = <0xffffffff>;

		__overlay__ {

			chg {
				aicc_once = <0x1>;
				aicr = <0x7a120>;
				batoc_notify = <0x0>;
				chg_name = "primary_chg";
				compatible = "mediatek,mt6360_pmu_chg";
				cv = <0x426030>;
				en_te = <0x1>;
				en_wdt = <0x1>;
				ichg = <0x1e8480>;
				ieoc = <0x249f0>;
				interrupt-names = "chg_treg_evt", "chg_mivr_evt", "pwr_rdy_evt", "chg_batsysuv_evt", "chg_vsysuv_evt", "chg_vsysov_evt", "chg_vbatov_evt", "chg_vbusov_evt", "chg_tmri", "chg_adpbadi", "chg_rvpi", "chg_aiccmeasl", "wdtmri", "pumpx_donei", "attachi", "chrdet_ext_evt", "hvdcp_det";
				interrupt-parent = <0xffffffff>;
				interrupts = <0x4 0x0 0x6 0x0 0x7 0x0 0x9 0x0 0xc 0x0 0xd 0x0 0xe 0x0 0xf 0x0 0x1b 0x0 0x1d 0x0 0x1e 0x0 0x20 0x0 0x23 0x0 0x28 0x0 0x30 0x0 0x3c 0x0 0x35 0x0>;
				io-channel-names = "USBID", "VBUSDIV5", "VSYS", "VBAT", "IBUS", "IBAT", "TEMP_JC", "TS";
				io-channels = <0xffffffff 0x0 0xffffffff 0x1 0xffffffff 0x3 0xffffffff 0x4 0xffffffff 0x5 0xffffffff 0x6 0xffffffff 0x8 0xffffffff 0xa>;
				ircmp_resistor = <0x61a8>;
				ircmp_vclamp = <0x7d00>;
				mivr = <0x432380>;
				post_aicc = <0x1>;
				safety_timer = <0x14>;
			};
		};
	};

	fragment@11 {
		target = <0xffffffff>;

		__overlay__ {

			ldo3 {
				regulator-always-on;
			};
		};
	};

	fragment@12 {
		target = <0xffffffff>;

		__overlay__ {

			bq25910@4B {
				chip-name = "BQ25910";
				compatible = "oppo,bq25910-charger";
				reg = <0x4b>;
				status = "okay";
			};
		};
	};

	fragment@13 {
		target = <0xffffffff>;

		__overlay__ {
			CAR_TUNE_VALUE = <0x63>;
			battery0_profile_t0 = <0x0 0xace2 0x3b6 0x3b6 0x1fd 0xac72 0x3b7 0x3b7 0x3fa 0xac06 0x3ac 0x3ac 0x5f8 0xaba5 0x3b3 0x3b3 0x7f5 0xab45 0x3b7 0x3b7 0x9f2 0xaae6 0x3b7 0x3b7 0xbef 0xaa84 0x3bd 0x3bd 0xded 0xaa1c 0x3bf 0x3bf 0xfea 0xa9b2 0x3b9 0x3b9 0x11e7 0xa948 0x3c6 0x3c6 0x13e4 0xa8dc 0x3d1 0x3d1 0x15e1 0xa867 0x3c5 0x3c5 0x17df 0xa7f0 0x3c4 0x3c4 0x19dc 0xa776 0x3ba 0x3ba 0x1bd9 0xa6ff 0x3c0 0x3c0 0x1dd6 0xa685 0x3c4 0x3c4 0x1fd3 0xa607 0x3be 0x3be 0x21d1 0xa588 0x3b6 0x3b6 0x23ce 0xa50c 0x3b9 0x3b9 0x25cb 0xa492 0x3c7 0x3c7 0x27c8 0xa41c 0x3d2 0x3d2 0x29c6 0xa3a0 0x3d2 0x3d2 0x2bc3 0xa325 0x3d2 0x3d2 0x2dc0 0xa2aa 0x3d4 0x3d4 0x2fbd 0xa22e 0x3c9 0x3c9 0x31ba 0xa1b6 0x3cd 0x3cd 0x33b8 0xa141 0x3d2 0x3d2 0x35b5 0xa0ce 0x3d9 0x3d9 0x37b2 0xa05b 0x3e1 0x3e1 0x39af 0x9fe9 0x3e5 0x3e5 0x3bad 0x9f7e 0x3ef 0x3ef 0x3daa 0x9f13 0x3ef 0x3ef 0x3fa7 0x9ea2 0x3ef 0x3ef 0x41a4 0x9e37 0x3ef 0x3ef 0x43a1 0x9dd1 0x403 0x403 0x459f 0x9d68 0x400 0x400 0x479c 0x9d05 0x40c 0x40c 0x4999 0x9ca6 0x425 0x425 0x4b96 0x9c46 0x433 0x433 0x4d93 0x9be6 0x436 0x436 0x4f91 0x9b89 0x44a 0x44a 0x518e 0x9b2e 0x46e 0x46e 0x538b 0x9ac7 0x485 0x485 0x5588 0x9a30 0x453 0x453 0x5786 0x9975 0x3e7 0x3e7 0x5983 0x98f1 0x3c8 0x3c8 0x5b80 0x988f 0x3bc 0x3bc 0x5d7d 0x9839 0x3b7 0x3b7 0x5f7a 0x97ea 0x3b7 0x3b7 0x6178 0x97a3 0x3b7 0x3b7 0x6375 0x9760 0x3b7 0x3b7 0x6572 0x971d 0x3b7 0x3b7 0x676f 0x96df 0x3b7 0x3b7 0x696d 0x96a2 0x3b7 0x3b7 0x6b6a 0x966a 0x3b7 0x3b7 0x6d67 0x9632 0x3b7 0x3b7 0x6f64 0x95fe 0x3b7 0x3b7 0x7161 0x95ce 0x3bf 0x3bf 0x735f 0x959b 0x3c4 0x3c4 0x755c 0x9568 0x3c4 0x3c4 0x7759 0x953d 0x3cd 0x3cd 0x7956 0x9513 0x3d9 0x3d9 0x7b53 0x94e4 0x3c6 0x3c6 0x7d51 0x94c1 0x3d2 0x3d2 0x7f4e 0x949a 0x3de 0x3de 0x814b 0x9473 0x3e1 0x3e1 0x8348 0x9450 0x3e0 0x3e0 0x8546 0x942e 0x3e9 0x3e9 0x8743 0x9410 0x405 0x405 0x8940 0x93e9 0x40b 0x40b 0x8b3d 0x93ab 0x3e9 0x3e9 0x8d3a 0x935b 0x3bf 0x3bf 0x8f38 0x930b 0x3ae 0x3ae 0x9135 0x92ce 0x3c4 0x3c4 0x9332 0x92a2 0x3c4 0x3c4 0x952f 0x9275 0x3c4 0x3c4 0x972d 0x923e 0x3c4 0x3c4 0x992a 0x920e 0x3ba 0x3ba 0x9b27 0x91e5 0x3c6 0x3c6 0x9d24 0x91be 0x3d3 0x3d3 0x9f21 0x9197 0x3d9 0x3d9 0xa11f 0x9169 0x3e3 0x3e3 0xa31c 0x912d 0x3e7 0x3e7 0xa519 0x90e6 0x3d2 0x3d2 0xa716 0x90a2 0x3c5 0x3c5 0xa913 0x9064 0x3d1 0x3d1 0xab11 0x900d 0x3bb 0x3bb 0xad0e 0x8fd3 0x3a2 0x3a2 0xaf0b 0x8fbd 0x3a4 0x3a4 0xb108 0x8fb2 0x3c7 0x3c7 0xb306 0x8fa6 0x3f3 0x3f3 0xb503 0x8f97 0x423 0x423 0xb700 0x8f78 0x461 0x461 0xb8fd 0x8f20 0x47b 0x47b 0xbafa 0x8e1b 0x408 0x408 0xbcf8 0x8c49 0x3fc 0x3fc 0xbef5 0x89e1 0x42e 0x42e 0xc0f2 0x8685 0x46b 0x46b 0xc2ef 0x8118 0x572 0x572 0xc4ed 0x7f26 0x3036 0x3036>;
			battery0_profile_t0_col = <0x4>;
			battery0_profile_t0_num = <0x64>;
			battery0_profile_t1 = <0x0 0xac85 0x492 0x44c 0x1fd 0xac26 0x495 0x44c 0x3fa 0xabd0 0x4ab 0x44c 0x5f8 0xab73 0x4a5 0x44c 0x7f5 0xab13 0x4aa 0x44c 0x9f2 0xaab3 0x4af 0x44c 0xbef 0xaa51 0x4b5 0x44c 0xded 0xa9e7 0x4b4 0x44c 0xfea 0xa978 0x4a6 0x44c 0x11e7 0xa90c 0x4b2 0x44c 0x13e4 0xa89b 0x4bc 0x44c 0x15e1 0xa81f 0x4ae 0x44c 0x17df 0xa7a8 0x4ba 0x44c 0x19dc 0xa72e 0x4bd 0x44c 0x1bd9 0xa6b2 0x4c5 0x46f 0x1dd6 0xa632 0x4c2 0x480 0x1fd3 0xa5b4 0x4bc 0x480 0x21d1 0xa538 0x4bc 0x47f 0x23ce 0xa4bd 0x4c2 0x481 0x25cb 0xa440 0x4c7 0x481 0x27c8 0xa3c0 0x4bf 0x482 0x29c6 0xa34a 0x4cb 0x482 0x2bc3 0xa2d4 0x4d8 0x483 0x2dc0 0xa258 0x4d8 0x483 0x2fbd 0xa1e1 0x4e2 0x484 0x31ba 0xa16b 0x4e5 0x484 0x33b8 0xa0f5 0x4df 0x485 0x35b5 0xa07e 0x4d9 0x485 0x37b2 0xa00d 0x4e4 0x499 0x39af 0x9fa1 0x4f5 0x4b5 0x3bad 0x9f32 0x4f8 0x4b8 0x3daa 0x9ec8 0x506 0x4c5 0x3fa7 0x9e62 0x51c 0x4db 0x41a4 0x9df1 0x504 0x4c4 0x43a1 0x9d8b 0x524 0x4e2 0x459f 0x9d22 0x536 0x4f3 0x479c 0x9cb7 0x543 0x4ff 0x4999 0x9c53 0x556 0x512 0x4b96 0x9bf9 0x56e 0x529 0x4d93 0x9b9e 0x582 0x53c 0x4f91 0x9b36 0x58c 0x545 0x518e 0x9abc 0x57c 0x536 0x538b 0x9a1d 0x52d 0x4eb 0x5588 0x9974 0x4cb 0x48d 0x5786 0x98f9 0x4b2 0x476 0x5983 0x9896 0x498 0x45e 0x5b80 0x9845 0x49e 0x463 0x5d7d 0x97f6 0x490 0x456 0x5f7a 0x97ae 0x48d 0x453 0x6178 0x976a 0x48d 0x453 0x6375 0x9729 0x48a 0x450 0x6572 0x96ec 0x490 0x455 0x676f 0x96af 0x488 0x44e 0x696d 0x9677 0x492 0x458 0x6b6a 0x963f 0x486 0x44c 0x6d67 0x960c 0x492 0x457 0x6f64 0x95de 0x49e 0x463 0x7161 0x95ac 0x4a0 0x465 0x735f 0x957e 0x4b2 0x476 0x755c 0x9554 0x4c3 0x486 0x7759 0x952a 0x4c9 0x48c 0x7956 0x94ff 0x4cf 0x491 0x7b53 0x94d8 0x4db 0x49d 0x7d51 0x94b7 0x4e5 0x4a7 0x7f4e 0x9495 0x4e5 0x4a6 0x814b 0x946e 0x4db 0x49d 0x8348 0x944b 0x4e4 0x4a5 0x8546 0x942e 0x4f0 0x4b0 0x8743 0x940e 0x4f3 0x4b3 0x8940 0x93e5 0x4e4 0x4a6 0x8b3d 0x93b6 0x4d3 0x495 0x8d3a 0x9383 0x4c5 0x488 0x8f38 0x9352 0x4b9 0x47c 0x9135 0x9326 0x4b4 0x478 0x9332 0x92fe 0x4c9 0x48c 0x952f 0x92d0 0x4bb 0x47e 0x972d 0x929f 0x4b1 0x475 0x992a 0x927b 0x4b9 0x47d 0x9b27 0x925e 0x4d1 0x493 0x9d24 0x923a 0x4d8 0x49a 0x9f21 0x9208 0x4d8 0x49a 0xa11f 0x91c9 0x4d8 0x49a 0xa31c 0x9188 0x4d3 0x495 0xa519 0x914a 0x4cf 0x491 0xa716 0x9109 0x4db 0x49c 0xa913 0x90b9 0x4e1 0x4a3 0xab11 0x9066 0x4bb 0x47f 0xad0e 0x904a 0x4bb 0x47f 0xaf0b 0x903d 0x4c8 0x48b 0xb108 0x9031 0x4e8 0x4a9 0xb306 0x9022 0x505 0x4c5 0xb503 0x900e 0x52e 0x4ec 0xb700 0x8fdb 0x566 0x520 0xb8fd 0x8f23 0x562 0x51d 0xbafa 0x8d92 0x524 0x4e2 0xbcf8 0x8b55 0x541 0x4fe 0xbef5 0x8853 0x57c 0x536 0xc0f2 0x83e2 0x605 0x5b8 0xc2ef 0x7828 0x188e 0x1754 0xc4ed 0x76de 0x1e14 0x1c93>;
			battery0_profile_t1_col = <0x4>;
			battery0_profile_t1_num = <0x64>;
			battery0_profile_t2 = <0x0 0xacbd 0x6b8 0x5dc 0x1fd 0xac51 0x6ba 0x5dc 0x3fa 0xabef 0x701 0x5dc 0x5f8 0xab8e 0x70d 0x5dc 0x7f5 0xab35 0x65c 0x5dc 0x9f2 0xaad9 0x67a 0x5dc 0xbef 0xaa75 0x6ec 0x5dc 0xded 0xaa0b 0x701 0x5dc 0xfea 0xa99f 0x6bc 0x5dc 0x11e7 0xa92f 0x676 0x5dc 0x13e4 0xa8b6 0x6d0 0x5dc 0x15e1 0xa83a 0x6de 0x5dc 0x17df 0xa7c2 0x641 0x5dc 0x19dc 0xa74a 0x657 0x5dc 0x1bd9 0xa6c8 0x6b9 0x5dc 0x1dd6 0xa644 0x6dd 0x5dc 0x1fd3 0xa5ca 0x646 0x5dc 0x21d1 0xa54a 0x642 0x5dc 0x23ce 0xa4ca 0x6ab 0x5dc 0x25cb 0xa44a 0x6ea 0x5dc 0x27c8 0xa3cc 0x69a 0x5dc 0x29c6 0xa356 0x64b 0x60a 0x2bc3 0xa2e1 0x6d7 0x680 0x2dc0 0xa264 0x6fa 0x6a1 0x2fbd 0xa1e6 0x691 0x63d 0x31ba 0xa16f 0x69f 0x64b 0x33b8 0xa0f7 0x702 0x6a8 0x35b5 0xa080 0x72f 0x6d3 0x37b2 0xa011 0x689 0x635 0x39af 0x9fa1 0x6b2 0x65c 0x3bad 0x9f36 0x72c 0x6d0 0x3daa 0x9ecc 0x77b 0x71b 0x3fa7 0x9e62 0x734 0x6d7 0x41a4 0x9df5 0x6ef 0x696 0x43a1 0x9d7e 0x783 0x723 0x459f 0x9d08 0x7a8 0x746 0x479c 0x9c9c 0x743 0x6e6 0x4999 0x9c30 0x739 0x6dc 0x4b96 0x9bc9 0x791 0x730 0x4d93 0x9b5d 0x7b9 0x756 0x4f91 0x9aff 0x729 0x6ce 0x518e 0x9a74 0x6ec 0x694 0x538b 0x99d6 0x6c2 0x66c 0x5588 0x9948 0x69f 0x64a 0x5786 0x98cd 0x607 0x5ba 0x5983 0x9867 0x5a6 0x55d 0x5b80 0x9811 0x616 0x5c8 0x5d7d 0x97c1 0x621 0x5d3 0x5f7a 0x9780 0x637 0x5e7 0x6178 0x9737 0x5b9 0x570 0x6375 0x96f9 0x613 0x5c6 0x6572 0x96b4 0x608 0x5bb 0x676f 0x967e 0x63e 0x5ee 0x696d 0x9646 0x64b 0x5fb 0x6b6a 0x960d 0x63a 0x5ea 0x6d67 0x95dc 0x630 0x5e1 0x6f64 0x95ab 0x630 0x5e1 0x7161 0x957a 0x636 0x5e6 0x735f 0x954d 0x63f 0x5ef 0x755c 0x9521 0x639 0x5e9 0x7759 0x94f9 0x61f 0x5d0 0x7956 0x94d1 0x610 0x5c2 0x7b53 0x94aa 0x65b 0x60a 0x7d51 0x9487 0x680 0x62d 0x7f4e 0x946a 0x602 0x5b5 0x814b 0x9449 0x5f6 0x5aa 0x8348 0x9427 0x64f 0x5fe 0x8546 0x9405 0x67f 0x62c 0x8743 0x93ec 0x63b 0x5eb 0x8940 0x93d2 0x606 0x5b9 0x8b3d 0x93ae 0x62f 0x5e0 0x8d3a 0x9386 0x656 0x605 0x8f38 0x935f 0x62f 0x5e0 0x9135 0x933c 0x5c7 0x57d 0x9332 0x930e 0x5e3 0x597 0x952f 0x92e1 0x63d 0x5ed 0x972d 0x92ad 0x61b 0x5cd 0x992a 0x9284 0x5a7 0x55f 0x9b27 0x926a 0x5d1 0x587 0x9d24 0x9243 0x63c 0x5ec 0x9f21 0x91f9 0x63a 0x5ea 0xa11f 0x91b0 0x5da 0x58f 0xa31c 0x917e 0x5ca 0x580 0xa519 0x9148 0x638 0x5e8 0xa716 0x90f0 0x66d 0x61b 0xa913 0x908b 0x60f 0x5c2 0xab11 0x9066 0x5b0 0x567 0xad0e 0x9060 0x616 0x5c8 0xaf0b 0x904f 0x69f 0x64a 0xb108 0x9029 0x689 0x635 0xb306 0x901d 0x63a 0x5eb 0xb503 0x9003 0x68a 0x636 0xb700 0x8f79 0x714 0x6ba 0xb8fd 0x8e07 0x735 0x6d8 0xbafa 0x8bcb 0x702 0x6a8 0xbcf8 0x88d0 0x73b 0x6de 0xbef5 0x8413 0x93c 0x8c5 0xc0f2 0x7e51 0x1d85 0x1c0b 0xc2ef 0x7e54 0x2e64 0x2c12 0xc4ed 0x7e54 0x2e64 0x2c12>;
			battery0_profile_t2_col = <0x4>;
			battery0_profile_t2_num = <0x64>;
			battery0_profile_t3 = <0x0 0xac34 0xa3c 0x8fc 0x1fd 0xabc4 0xa3a 0x8fc 0x3fa 0xab5e 0xa51 0x8fc 0x5f8 0xab06 0xa60 0x8fc 0x7f5 0xaaa6 0xa4a 0x8fc 0x9f2 0xaa45 0xa3a 0x8fc 0xbef 0xa9e0 0xa2e 0x8fc 0xded 0xa975 0xa1f 0x8fc 0xfea 0xa907 0xa18 0x8fc 0x11e7 0xa891 0x9fe 0x8fc 0x13e4 0xa815 0x9e5 0x8fc 0x15e1 0xa79f 0x9e7 0x8fc 0x17df 0xa724 0x9dc 0x8fc 0x19dc 0xa6a8 0x9e3 0x8fc 0x1bd9 0xa62d 0x9de 0x8fc 0x1dd6 0xa5b2 0x9da 0x8fc 0x1fd3 0xa536 0x9d3 0x8fc 0x21d1 0xa4b8 0x9c6 0x8fc 0x23ce 0xa439 0x9bf 0x8fc 0x25cb 0xa3bd 0x9bd 0x8fc 0x27c8 0xa343 0x9c0 0x8fc 0x29c6 0xa2cd 0x9da 0x8fc 0x2bc3 0xa257 0x9d8 0x8fc 0x2dc0 0xa1e1 0x9e5 0x956 0x2fbd 0xa167 0x9e8 0x969 0x31ba 0xa0f3 0x9f0 0x971 0x33b8 0xa07c 0x9f5 0x975 0x35b5 0xa003 0x9f5 0x975 0x37b2 0x9f91 0xa03 0x983 0x39af 0x9f28 0xa21 0x99f 0x3bad 0x9ec3 0xa31 0x9ae 0x3daa 0x9e57 0xa48 0x9c5 0x3fa7 0x9de1 0xa56 0x9d2 0x41a4 0x9d66 0xa55 0x9d0 0x43a1 0x9cea 0xa61 0x9dc 0x459f 0x9c73 0xa5b 0x9d6 0x479c 0x9bf9 0xa3e 0x9ba 0x4999 0x9b81 0xa1e 0x99c 0x4b96 0x9b09 0x9f4 0x975 0x4d93 0x9a8d 0x9bb 0x93e 0x4f91 0x9a11 0x985 0x90b 0x518e 0x9998 0x94b 0x8d4 0x538b 0x9928 0x924 0x8af 0x5588 0x98b7 0x8e6 0x874 0x5786 0x9851 0x8b3 0x843 0x5983 0x97f5 0x8a0 0x831 0x5b80 0x97a0 0x88b 0x81e 0x5d7d 0x9756 0x889 0x81c 0x5f7a 0x9710 0x889 0x81c 0x6178 0x96c9 0x882 0x815 0x6375 0x9689 0x885 0x818 0x6572 0x9650 0x88f 0x822 0x676f 0x9613 0x891 0x824 0x696d 0x95e1 0x8ac 0x83d 0x6b6a 0x95a9 0x8a0 0x832 0x6d67 0x9575 0x8a9 0x83a 0x6f64 0x954b 0x8bd 0x84d 0x7161 0x951d 0x8be 0x84e 0x735f 0x94ed 0x8c0 0x850 0x755c 0x94c0 0x8c6 0x855 0x7759 0x9497 0x8d2 0x861 0x7956 0x9474 0x8ef 0x87d 0x7b53 0x944d 0x8f1 0x87e 0x7d51 0x9426 0x8f0 0x87d 0x7f4e 0x940a 0x908 0x894 0x814b 0x93ee 0x909 0x896 0x8348 0x93cd 0x915 0x8a1 0x8546 0x93af 0x919 0x8a4 0x8743 0x9397 0x920 0x8ac 0x8940 0x9381 0x92e 0x8b8 0x8b3d 0x9368 0x936 0x8c0 0x8d3a 0x934e 0x93a 0x8c3 0x8f38 0x9337 0x943 0x8cd 0x9135 0x9320 0x944 0x8ce 0x9332 0x9304 0x950 0x8d9 0x952f 0x92dd 0x95d 0x8e5 0x972d 0x92b5 0x95e 0x8e6 0x992a 0x928e 0x972 0x8fa 0x9b27 0x9263 0x982 0x908 0x9d24 0x9233 0x99c 0x921 0x9f21 0x91f8 0x9b6 0x939 0xa11f 0x91b3 0x9cc 0x94e 0xa31c 0x916e 0x9f8 0x979 0xa519 0x9133 0xa37 0x9b4 0xa716 0x90e9 0xa73 0x9ee 0xa913 0x9089 0xa98 0xa10 0xab11 0x904a 0xad5 0xa4a 0xad0e 0x9025 0xb29 0xa9b 0xaf0b 0x9007 0xb8b 0xaf7 0xb108 0x8fef 0xc16 0xb7b 0xb306 0x8fd5 0xce0 0xc3b 0xb503 0x8fad 0xdfd 0xd4a 0xb700 0x8f50 0xf87 0xec0 0xb8fd 0x8e68 0x1187 0x10a6 0xbafa 0x8c88 0x144d 0x1349 0xbcf8 0x89e7 0x1a76 0x1923 0xbef5 0x8611 0x2c40 0x2a0a 0xc0f2 0x85b6 0x3ecc 0x3ba8 0xc2ef 0x85b6 0x3ecc 0x3ba8 0xc4ed 0x85b6 0x3ecc 0x3ba8>;
			battery0_profile_t3_col = <0x4>;
			battery0_profile_t3_num = <0x64>;
			battery0_profile_t4 = <0x0 0xac91 0x14b4 0x12a2 0x1fd 0xac05 0x14b8 0x12a6 0x3fa 0xab88 0x14b8 0x12a6 0x5f8 0xab23 0x14c4 0x12b0 0x7f5 0xaabc 0x14b6 0x12a4 0x9f2 0xaa51 0x1495 0x1286 0xbef 0xa9e6 0x147b 0x126f 0xded 0xa979 0x143d 0x1236 0xfea 0xa909 0x13ec 0x11ee 0x11e7 0xa898 0x1445 0x123f 0x13e4 0xa823 0x142e 0x1229 0x15e1 0xa7b8 0x1422 0x121f 0x17df 0xa74e 0xfe0 0xe4a 0x19dc 0xa6d1 0x1204 0x1037 0x1bd9 0xa64f 0x12e4 0x1101 0x1dd6 0xa5d2 0x12dd 0x10fa 0x1fd3 0xa554 0x12cb 0x10ea 0x21d1 0xa4d5 0x12b1 0x10d3 0x23ce 0xa45a 0x1299 0x10bd 0x25cb 0xa3df 0x127c 0x10a3 0x27c8 0xa369 0x1259 0x1083 0x29c6 0xa2ee 0x124f 0x107a 0x2bc3 0xa277 0x1259 0x1083 0x2dc0 0xa202 0x1271 0x1099 0x2fbd 0xa188 0x1264 0x108d 0x31ba 0xa114 0x126d 0x1095 0x33b8 0xa09a 0x1268 0x1090 0x35b5 0xa01e 0x125a 0x1084 0x37b2 0x9fab 0x125f 0x1089 0x39af 0x9f3a 0x126d 0x1095 0x3bad 0x9eca 0x127c 0x10a3 0x3daa 0x9e59 0x129f 0x10c3 0x3fa7 0x9ddd 0x12ab 0x10cd 0x41a4 0x9d58 0x12a2 0x10c5 0x43a1 0x9cd1 0x117a 0xfbb 0x459f 0x9c4f 0x1244 0x1070 0x479c 0x9bbf 0x119b 0xfd8 0x4999 0x9b31 0x119b 0xfd9 0x4b96 0x9aaf 0x12a5 0x10c7 0x4d93 0x9a37 0x12a2 0x10c5 0x4f91 0x99c8 0x1284 0x10aa 0x518e 0x995e 0x1284 0x10aa 0x538b 0x98f3 0x1282 0x10a9 0x5588 0x98a4 0xce9 0xb9e 0x5786 0x983c 0x1183 0xfc3 0x5983 0x97e3 0x1312 0x112a 0x5b80 0x978f 0x133e 0x1151 0x5d7d 0x973f 0x134b 0x115d 0x5f7a 0x96f6 0x136b 0x1179 0x6178 0x96b0 0x1394 0x119f 0x6375 0x9669 0x13aa 0x11b2 0x6572 0x9627 0x13bc 0x11c3 0x676f 0x95ef 0x13f9 0x11f9 0x696d 0x95b1 0x1413 0x1211 0x6b6a 0x957e 0x144f 0x1247 0x6d67 0x9547 0x146d 0x1262 0x6f64 0x9513 0x1485 0x1278 0x7161 0x94e1 0x14af 0x129e 0x735f 0x94b4 0x14e8 0x12d1 0x755c 0x948d 0x1520 0x1303 0x7759 0x9464 0x1552 0x1330 0x7956 0x9439 0x157f 0x1359 0x7b53 0x9417 0x159a 0x1371 0x7d51 0x93f6 0x15cc 0x139e 0x7f4e 0x93df 0x15fe 0x13cb 0x814b 0x93c4 0x1619 0x13e3 0x8348 0x93b0 0x1650 0x1414 0x8546 0x939c 0x1687 0x1446 0x8743 0x9389 0x16c7 0x1480 0x8940 0x9378 0x1716 0x14c7 0x8b3d 0x9363 0x1769 0x1511 0x8d3a 0x934b 0x17ab 0x154d 0x8f38 0x933e 0x17b9 0x155a 0x9135 0x9321 0x175d 0x1507 0x9332 0x9300 0x1862 0x15f2 0x952f 0x92de 0x18f3 0x1674 0x972d 0x92bc 0x1985 0x16f7 0x992a 0x9292 0x1a12 0x1776 0x9b27 0x9262 0x1aac 0x1801 0x9d24 0x922f 0x1b62 0x18a5 0x9f21 0x91f8 0x1c29 0x1958 0xa11f 0x91ba 0x1cf8 0x1a12 0xa31c 0x917c 0x1dde 0x1ae1 0xa519 0x9137 0x1edc 0x1bc6 0xa716 0x90e8 0x2014 0x1cde 0xa913 0x90a0 0x2159 0x1e04 0xab11 0x9056 0x22bd 0x1f44 0xad0e 0x901b 0x246b 0x20c7 0xaf0b 0x8fe6 0x2693 0x22b7 0xb108 0x8fbe 0x295d 0x253a 0xb306 0x8f97 0x2ce6 0x2869 0xb503 0x8f6a 0x316f 0x2c7e 0xb700 0x8f30 0x3764 0x31da 0xb8fd 0x8ec0 0x3f09 0x38bc 0xbafa 0x8e00 0x4860 0x4123 0xbcf8 0x8dfe 0x5133 0x4914 0xbef5 0x8dfe 0x5133 0x4914 0xc0f2 0x8dfe 0x5133 0x4914 0xc2ef 0x8dfe 0x5133 0x4914 0xc4ed 0x8dfe 0x5133 0x4914>;
			battery0_profile_t4_col = <0x4>;
			battery0_profile_t4_num = <0x64>;
			battery1_profile_t0 = <0x0 0xac60 0x3b6 0x387 0x1fb 0xabe7 0x3b5 0x386 0x3f6 0xab79 0x3c3 0x393 0x5f1 0xab0c 0x3c5 0x395 0x7ec 0xaaa1 0x3c9 0x398 0x9e6 0xaa37 0x3d2 0x3a1 0xbe1 0xa9cb 0x3d8 0x3a7 0xddc 0xa95c 0x3d8 0x3a7 0xfd7 0xa8ea 0x3d8 0x3a7 0x11d2 0xa879 0x3da 0x3a8 0x13cd 0xa804 0x3e1 0x3af 0x15c8 0xa78b 0x3d9 0x3a8 0x17c3 0xa711 0x3d3 0x3a2 0x19be 0xa69a 0x3dd 0x3ac 0x1bb8 0xa621 0x3e4 0x3b2 0x1db3 0xa5a4 0x3e3 0x3b2 0x1fae 0xa529 0x3e1 0x3b0 0x21a9 0xa4b1 0x3e3 0x3b1 0x23a4 0xa437 0x3e5 0x3b3 0x259f 0xa3bb 0x3e3 0x3b1 0x279a 0xa345 0x3ef 0x3bc 0x2995 0xa2cf 0x3ed 0x3ba 0x2b8f 0xa25a 0x3f4 0x3c1 0x2d8a 0xa1e4 0x3f5 0x3c3 0x2f85 0xa173 0x3fa 0x3c7 0x3180 0xa100 0x3fc 0x3c9 0x337b 0xa08d 0x3fc 0x3c9 0x3576 0xa01e 0x3fe 0x3cb 0x3771 0x9fb1 0x404 0x3d1 0x396c 0x9f45 0x40c 0x3d8 0x3b67 0x9edd 0x416 0x3e2 0x3d61 0x9e73 0x410 0x3dc 0x3f5c 0x9e0e 0x410 0x3dc 0x4157 0x9dae 0x42a 0x3f4 0x4352 0x9d4b 0x433 0x3fd 0x454d 0x9cea 0x432 0x3fd 0x4748 0x9c8b 0x43f 0x409 0x4943 0x9c2d 0x454 0x41d 0x4b3e 0x9bd0 0x465 0x42c 0x4d39 0x9b6e 0x477 0x43e 0x4f33 0x9b03 0x47d 0x444 0x512e 0x9a8d 0x47f 0x446 0x5329 0x99e9 0x428 0x3f3 0x5524 0x995a 0x3f1 0x3bf 0x571f 0x98ed 0x3e7 0x3b5 0x591a 0x9893 0x3e4 0x3b2 0x5b15 0x9842 0x3e1 0x3b0 0x5d10 0x97f8 0x3e0 0x3af 0x5f0b 0x97b3 0x3df 0x3ae 0x6105 0x9773 0x3e0 0x3ae 0x6300 0x9734 0x3e1 0x3b0 0x64fb 0x96f9 0x3e1 0x3b0 0x66f6 0x96bf 0x3e1 0x3b0 0x68f1 0x9686 0x3dc 0x3aa 0x6aec 0x9655 0x3e4 0x3b2 0x6ce7 0x9621 0x3e8 0x3b6 0x6ee2 0x95ee 0x3e7 0x3b5 0x70dc 0x95be 0x3ea 0x3b7 0x72d7 0x9592 0x3ef 0x3bc 0x74d2 0x9565 0x3ee 0x3bc 0x76cd 0x953b 0x3ef 0x3bc 0x78c8 0x9515 0x3fc 0x3c9 0x7ac3 0x94ee 0x408 0x3d5 0x7cbe 0x94c9 0x409 0x3d6 0x7eb9 0x94a4 0x40e 0x3da 0x80b4 0x9482 0x41e 0x3ea 0x82ae 0x945b 0x421 0x3ed 0x84a9 0x9434 0x427 0x3f2 0x86a4 0x9404 0x425 0x3f0 0x889f 0x93bb 0x3fd 0x3ca 0x8a9a 0x9364 0x3d8 0x3a7 0x8c95 0x9320 0x3d9 0x3a8 0x8e90 0x92ed 0x3e5 0x3b3 0x908b 0x92b8 0x3e0 0x3ae 0x9286 0x9288 0x3e6 0x3b4 0x9480 0x9257 0x3e8 0x3b6 0x967b 0x9228 0x3ec 0x3ba 0x9876 0x91fc 0x3ef 0x3bc 0x9a71 0x91d4 0x3f4 0x3c1 0x9c6c 0x91a8 0x3fe 0x3cb 0x9e67 0x916f 0x3ff 0x3cc 0xa062 0x912a 0x3ee 0x3bc 0xa25d 0x90e6 0x3ec 0x3ba 0xa458 0x90a9 0x3fa 0x3c7 0xa652 0x905f 0x3fa 0x3c7 0xa84d 0x9012 0x3da 0x3a8 0xaa48 0x8fea 0x3cf 0x39e 0xac43 0x8fdd 0x3e3 0x3b2 0xae3e 0x8fd2 0x400 0x3cd 0xb039 0x8fc3 0x422 0x3ee 0xb234 0x8fae 0x45f 0x427 0xb42f 0x8f7d 0x498 0x45d 0xb629 0x8ed7 0x44e 0x417 0xb824 0x8d3d 0x424 0x3ef 0xba1f 0x8b15 0x440 0x409 0xbc1a 0x882d 0x479 0x43f 0xbe15 0x83d8 0x525 0x4e3 0xc010 0x81bb 0x20eb 0x1f46 0xc20b 0x81ba 0x35ea 0x3338 0xc406 0x81ba 0x35ea 0x3338>;
			battery1_profile_t0_col = <0x4>;
			battery1_profile_t0_num = <0x64>;
			battery1_profile_t1 = <0x0 0xac7f 0x488 0x44e 0x1fb 0xac1a 0x486 0x44c 0x3f6 0xabb6 0x486 0x44c 0x5f1 0xab59 0x48f 0x455 0x7ec 0xaaf8 0x493 0x459 0x9e6 0xaa94 0x48c 0x452 0xbe1 0xaa2c 0x486 0x44c 0xddc 0xa9c4 0x48a 0x450 0xfd7 0xa95d 0x493 0x459 0x11d2 0xa8ed 0x493 0x459 0x13cd 0xa87d 0x493 0x458 0x15c8 0xa807 0x485 0x44b 0x17c3 0xa792 0x485 0x44c 0x19be 0xa718 0x486 0x44c 0x1bb8 0xa6a1 0x48e 0x454 0x1db3 0xa62b 0x49a 0x45f 0x1fae 0xa5b3 0x4a0 0x465 0x21a9 0xa538 0x4a1 0x466 0x23a4 0xa4bd 0x4a2 0x467 0x259f 0xa443 0x4a0 0x465 0x279a 0xa3cd 0x4a0 0x465 0x2995 0xa353 0x494 0x459 0x2b8f 0xa2dc 0x49e 0x463 0x2d8a 0xa267 0x4a0 0x465 0x2f85 0xa1f5 0x4b2 0x476 0x3180 0xa185 0x4c4 0x487 0x337b 0xa113 0x4c5 0x488 0x3576 0xa0a0 0x4b9 0x47c 0x3771 0xa030 0x4b0 0x474 0x396c 0x9fc2 0x4b4 0x478 0x3b67 0x9f5d 0x4cc 0x48e 0x3d61 0x9ef3 0x4da 0x49c 0x3f5c 0x9e89 0x4d8 0x49a 0x4157 0x9e23 0x4d8 0x49a 0x4352 0x9dc2 0x4eb 0x4ac 0x454d 0x9d60 0x4fd 0x4bd 0x4748 0x9cfe 0x509 0x4c8 0x4943 0x9ca1 0x51a 0x4d8 0x4b3e 0x9c45 0x52e 0x4ec 0x4d39 0x9be8 0x53d 0x4fa 0x4f33 0x9b8d 0x554 0x510 0x512e 0x9b22 0x554 0x510 0x5329 0x9a9c 0x523 0x4e1 0x5524 0x99ef 0x4ba 0x47e 0x571f 0x995f 0x485 0x44b 0x591a 0x98ee 0x477 0x43e 0x5b15 0x9893 0x476 0x43d 0x5d10 0x9842 0x46c 0x434 0x5f0b 0x97f9 0x465 0x42d 0x6105 0x97b9 0x471 0x438 0x6300 0x9772 0x45f 0x427 0x64fb 0x973a 0x478 0x43f 0x66f6 0x96fd 0x46c 0x434 0x68f1 0x96c5 0x46b 0x433 0x6aec 0x9691 0x475 0x43c 0x6ce7 0x965b 0x478 0x43f 0x6ee2 0x9626 0x478 0x43f 0x70dc 0x95f6 0x47d 0x444 0x72d7 0x95c7 0x484 0x44a 0x74d2 0x9598 0x48c 0x452 0x76cd 0x9570 0x4a2 0x467 0x78c8 0x9549 0x4b0 0x474 0x7ac3 0x951c 0x4ae 0x472 0x7cbe 0x94fa 0x4c6 0x489 0x7eb9 0x94d9 0x4cb 0x48d 0x80b4 0x94b7 0x4cb 0x48d 0x82ae 0x9492 0x4cb 0x48d 0x84a9 0x9470 0x4d6 0x499 0x86a4 0x9452 0x4e5 0x4a7 0x889f 0x942e 0x4df 0x4a0 0x8a9a 0x9400 0x4c7 0x48a 0x8c95 0x93ce 0x4af 0x473 0x8e90 0x9396 0x4a3 0x468 0x908b 0x9363 0x48a 0x450 0x9286 0x933a 0x49a 0x45f 0x9480 0x930b 0x4a2 0x467 0x967b 0x92d9 0x49a 0x45f 0x9876 0x92ac 0x49f 0x464 0x9a71 0x9286 0x4ae 0x472 0x9c6c 0x9265 0x4b2 0x476 0x9e67 0x923f 0x4bb 0x47f 0xa062 0x9207 0x4b0 0x474 0xa25d 0x91ca 0x4b0 0x474 0xa458 0x9186 0x4a2 0x467 0xa652 0x9151 0x4c0 0x483 0xa84d 0x910e 0x4c1 0x484 0xaa48 0x90bb 0x4b6 0x479 0xac43 0x907a 0x4a8 0x46d 0xae3e 0x9059 0x4a0 0x465 0xb039 0x904a 0x4a9 0x46d 0xb234 0x903d 0x4bf 0x483 0xb42f 0x902c 0x4cd 0x48f 0xb629 0x9016 0x4f5 0x4b5 0xb824 0x8fde 0x533 0x4f0 0xba1f 0x8ee5 0x4f6 0x4b7 0xbc1a 0x8d2d 0x4f8 0x4b8 0xbe15 0x8aca 0x51a 0x4d8 0xc010 0x8778 0x563 0x51e 0xc20b 0x81bb 0x70e 0x6b4 0xc406 0x7c7e 0x2a4f 0x2832>;
			battery1_profile_t1_col = <0x4>;
			battery1_profile_t1_num = <0x64>;
			battery1_profile_t2 = <0x0 0xacb0 0x780 0x6a4 0x1fb 0xac3a 0x77c 0x6a4 0x3f6 0xabd7 0x793 0x6a4 0x5f1 0xab77 0x797 0x6a4 0x7ec 0xab12 0x77c 0x6a4 0x9e6 0xaab0 0x776 0x6a4 0xbe1 0xaa49 0x774 0x6a4 0xddc 0xa9dd 0x768 0x6a4 0xfd7 0xa970 0x75d 0x6a4 0x11d2 0xa900 0x75a 0x6a4 0x13cd 0xa892 0x76c 0x6a4 0x15c8 0xa81a 0x760 0x6a4 0x17c3 0xa79d 0x752 0x6a4 0x19be 0xa726 0x745 0x6a4 0x1bb8 0xa6a4 0x737 0x6a4 0x1db3 0xa627 0x736 0x6a4 0x1fae 0xa5aa 0x737 0x6a4 0x21a9 0xa52d 0x737 0x6a4 0x23a4 0xa4b3 0x73d 0x6a4 0x259f 0xa43a 0x744 0x6a4 0x279a 0xa3bf 0x748 0x6a4 0x2995 0xa346 0x74c 0x6a4 0x2b8f 0xa2ca 0x73a 0x6ae 0x2d8a 0xa253 0x752 0x6f4 0x2f85 0xa1dc 0x760 0x702 0x3180 0xa164 0x75f 0x701 0x337b 0xa0f7 0x776 0x716 0x3576 0xa082 0x771 0x711 0x3771 0xa00f 0x776 0x716 0x396c 0x9fa1 0x77c 0x71c 0x3b67 0x9f35 0x789 0x728 0x3d61 0x9ecb 0x7a7 0x745 0x3f5c 0x9e63 0x7c4 0x761 0x4157 0x9df7 0x7d3 0x76f 0x4352 0x9d8b 0x7ea 0x785 0x454d 0x9d20 0x7f8 0x792 0x4748 0x9cbf 0x805 0x79e 0x4943 0x9c59 0x7ee 0x789 0x4b3e 0x9bf8 0x7e9 0x784 0x4d39 0x9b93 0x7ea 0x785 0x4f33 0x9b1d 0x7d1 0x76c 0x512e 0x9a96 0x793 0x732 0x5329 0x9a00 0x73b 0x6de 0x5524 0x996c 0x6e1 0x689 0x571f 0x98f2 0x6a5 0x650 0x591a 0x988e 0x690 0x63c 0x5b15 0x9836 0x68f 0x63b 0x5d10 0x97ec 0x684 0x631 0x5f0b 0x979c 0x676 0x623 0x6105 0x975d 0x675 0x623 0x6300 0x971e 0x680 0x62d 0x64fb 0x96df 0x683 0x62f 0x66f6 0x96a1 0x672 0x620 0x68f1 0x9669 0x676 0x624 0x6aec 0x9636 0x683 0x62f 0x6ce7 0x9600 0x683 0x62f 0x6ee2 0x95cb 0x683 0x62f 0x70dc 0x959e 0x685 0x632 0x72d7 0x9570 0x690 0x63c 0x74d2 0x9543 0x693 0x63f 0x76cd 0x951b 0x69f 0x64a 0x78c8 0x94f4 0x6a0 0x64b 0x7ac3 0x94cb 0x69e 0x649 0x7cbe 0x94a4 0x6a8 0x653 0x7eb9 0x9480 0x6ad 0x657 0x80b4 0x9461 0x6ad 0x657 0x82ae 0x9445 0x6c0 0x66a 0x84a9 0x9424 0x6d1 0x67a 0x86a4 0x93ff 0x6c8 0x671 0x889f 0x93e2 0x6c5 0x66e 0x8a9a 0x93c0 0x6ba 0x664 0x8c95 0x93a3 0x6ba 0x664 0x8e90 0x9376 0x6ae 0x658 0x908b 0x9349 0x696 0x641 0x9286 0x9316 0x67c 0x629 0x9480 0x92e3 0x675 0x623 0x967b 0x92bb 0x67e 0x62a 0x9876 0x9296 0x684 0x630 0x9a71 0x926c 0x684 0x630 0x9c6c 0x923c 0x68c 0x639 0x9e67 0x9203 0x69e 0x649 0xa062 0x91bf 0x6a2 0x64d 0xa25d 0x917d 0x6ae 0x659 0xa458 0x9149 0x6ca 0x673 0xa652 0x90f4 0x6ca 0x673 0xa84d 0x9094 0x6bc 0x666 0xaa48 0x9068 0x6c5 0x66e 0xac43 0x9053 0x6da 0x682 0xae3e 0x9042 0x70e 0x6b3 0xb039 0x902e 0x73e 0x6e2 0xb234 0x9014 0x76a 0x70b 0xb42f 0x8fe1 0x7a2 0x740 0xb629 0x8f43 0x7d2 0x76e 0xb824 0x8dce 0x7ea 0x785 0xba1f 0x8b88 0x833 0x7ca 0xbc1a 0x8881 0x8d0 0x85f 0xbe15 0x83c8 0x9fd 0x97d 0xc010 0x837c 0x3742 0x347e 0xc20b 0x837c 0x39d9 0x36f4 0xc406 0x837c 0x39d9 0x36f4>;
			battery1_profile_t2_col = <0x4>;
			battery1_profile_t2_num = <0x64>;
			battery1_profile_t3 = <0x0 0xac22 0xb5e 0x9c4 0x1fb 0xab9c 0xb5b 0x9c4 0x3f6 0xab2e 0xb7d 0x9c4 0x5f1 0xaacd 0xb85 0x9c4 0x7ec 0xaa66 0xb75 0x9c4 0x9e6 0xa9ff 0xb62 0x9c4 0xbe1 0xa997 0xb55 0x9c4 0xddc 0xa92d 0xb49 0x9c4 0xfd7 0xa8c2 0xb3a 0x9c4 0x11d2 0xa852 0xb24 0x9c4 0x13cd 0xa7e2 0xb18 0x9c4 0x15c8 0xa76c 0xb0a 0x9c4 0x17c3 0xa6f2 0xaf2 0x9c4 0x19be 0xa677 0xada 0x9c4 0x1bb8 0xa600 0xac9 0x9c4 0x1db3 0xa587 0xabd 0x9c4 0x1fae 0xa50c 0xab0 0x9ec 0x21a9 0xa493 0xaa8 0xa20 0x23a4 0xa41c 0xaa4 0xa1b 0x259f 0xa3a2 0xa9b 0xa14 0x279a 0xa32d 0xaa9 0xa20 0x2995 0xa2b8 0xaa9 0xa20 0x2b8f 0xa23d 0xa91 0xa09 0x2d8a 0xa1c6 0xa98 0xa10 0x2f85 0xa155 0xa9c 0xa14 0x3180 0xa0e2 0xa9c 0xa14 0x337b 0xa06f 0xaa2 0xa19 0x3576 0x9fff 0xaa9 0xa20 0x3771 0x9f91 0xaa9 0xa20 0x396c 0x9f27 0xaad 0xa24 0x3b67 0x9ebc 0xac6 0xa3c 0x3d61 0x9e57 0xaea 0xa5e 0x3f5c 0x9de8 0xaf7 0xa6b 0x4157 0x9d78 0xb05 0xa78 0x4352 0x9d08 0xafe 0xa71 0x454d 0x9c9d 0xafa 0xa6e 0x4748 0x9c30 0xaef 0xa63 0x4943 0x9bc2 0xad6 0xa4b 0x4b3e 0x9b56 0xab9 0xa2f 0x4d39 0x9ae6 0xa96 0xa0f 0x4f33 0x9a75 0xa79 0x9f3 0x512e 0x99f4 0xa3b 0x9b8 0x5329 0x996e 0x9e4 0x965 0x5524 0x98f6 0x9b9 0x93c 0x571f 0x9889 0x98a 0x910 0x591a 0x9826 0x969 0x8f0 0x5b15 0x97ce 0x957 0x8e0 0x5d10 0x977c 0x94a 0x8d3 0x5f0b 0x9733 0x945 0x8cf 0x6105 0x96f5 0x950 0x8d9 0x6300 0x96b3 0x952 0x8da 0x64fb 0x967b 0x95e 0x8e6 0x66f6 0x9638 0x952 0x8db 0x68f1 0x95fe 0x950 0x8d9 0x6aec 0x95cb 0x95a 0x8e2 0x6ce7 0x9599 0x95e 0x8e6 0x6ee2 0x9567 0x965 0x8ec 0x70dc 0x9537 0x971 0x8f8 0x72d7 0x950a 0x97d 0x904 0x74d2 0x94df 0x988 0x90e 0x76cd 0x94b6 0x988 0x90e 0x78c8 0x948a 0x995 0x91b 0x7ac3 0x9463 0x995 0x91b 0x7cbe 0x9441 0x9a0 0x925 0x7eb9 0x9424 0x9b6 0x93a 0x80b4 0x9400 0x9bf 0x942 0x82ae 0x93e0 0x9c0 0x943 0x84a9 0x93c4 0x9cb 0x94e 0x86a4 0x93a6 0x9d1 0x953 0x889f 0x9386 0x9c1 0x944 0x8a9a 0x9371 0x9cf 0x951 0x8c95 0x9360 0x9dc 0x95e 0x8e90 0x934f 0xa0c 0x98c 0x908b 0x9334 0xa10 0x98f 0x9286 0x930f 0xa11 0x990 0x9480 0x92ec 0xa23 0x9a1 0x967b 0x92c1 0xa25 0x9a3 0x9876 0x9291 0xa31 0x9ae 0x9a71 0x9266 0xa5a 0x9d6 0x9c6c 0x923b 0xa89 0xa02 0x9e67 0x9202 0xab5 0xa2c 0xa062 0x91c4 0xafe 0xa71 0xa25d 0x917b 0xb30 0xaa1 0xa458 0x9138 0xb6e 0xadb 0xa652 0x90f4 0xbd4 0xb3d 0xa84d 0x909d 0xc21 0xb85 0xaa48 0x9048 0xc76 0xbd7 0xac43 0x900e 0xce6 0xc41 0xae3e 0x8fec 0xd76 0xcca 0xb039 0x8fd0 0xe30 0xd7a 0xb234 0x8fb3 0xf0d 0xe4c 0xb42f 0x8f8e 0x1018 0xf4a 0xb629 0x8f51 0x1181 0x10a1 0xb824 0x8ebd 0x1362 0x126a 0xba1f 0x8d3e 0x159d 0x1489 0xbc1a 0x8af6 0x19c3 0x1879 0xbe15 0x87c4 0x2402 0x2235 0xc010 0x861a 0x3c9b 0x3993 0xc20b 0x861a 0x3faa 0x3c7b 0xc406 0x861a 0x3faa 0x3c7b>;
			battery1_profile_t3_col = <0x4>;
			battery1_profile_t3_num = <0x64>;
			battery1_profile_t4 = <0x0 0xac8b 0x1432 0x122d 0x1fb 0xabe9 0x142f 0x122a 0x3f6 0xab60 0x1446 0x123f 0x5f1 0xaae2 0x144a 0x1243 0x7ec 0xaa6f 0x1441 0x123b 0x9e6 0xa9fc 0x142e 0x122a 0xbe1 0xa989 0x1421 0x121e 0xddc 0xa917 0x13ee 0x11f0 0xfd7 0xa8a2 0x1394 0x119f 0x11d2 0xa82d 0x13e8 0x11ea 0x13cd 0xa7bd 0x13da 0x11de 0x15c8 0xa759 0x13dc 0x11e0 0x17c3 0xa6f9 0x1060 0xebd 0x19be 0xa67b 0x11d3 0x100b 0x1bb8 0xa5fd 0x12b7 0x10d7 0x1db3 0xa585 0x12b5 0x10d6 0x1fae 0xa50d 0x12a3 0x10c6 0x21a9 0xa494 0x128e 0x10b3 0x23a4 0xa41d 0x127e 0x10a5 0x259f 0xa3a3 0x1264 0x108d 0x279a 0xa32e 0x123f 0x106c 0x2995 0xa2b9 0x123f 0x106c 0x2b8f 0xa249 0x1257 0x1082 0x2d8a 0xa1cf 0x1251 0x107c 0x2f85 0xa158 0x1244 0x1070 0x3180 0xa0e6 0x123f 0x106c 0x337b 0xa076 0x1245 0x1071 0x3576 0xa007 0x1251 0x107c 0x3771 0x9f98 0x1261 0x108a 0x396c 0x9f2d 0x127b 0x10a1 0x3b67 0x9ebd 0x1293 0x10b8 0x3d61 0x9e4d 0x12b9 0x10da 0x3f5c 0x9dd4 0x12c7 0x10e6 0x4157 0x9d58 0x12c9 0x10e8 0x4352 0x9cde 0x11e0 0x1017 0x454d 0x9c6d 0x124e 0x107a 0x4748 0x9bf5 0x1240 0x106c 0x4943 0x9b6e 0x11d8 0x1010 0x4b3e 0x9aed 0x12e7 0x1103 0x4d39 0x9a79 0x12eb 0x1106 0x4f33 0x9a09 0x12c7 0x10e6 0x512e 0x9999 0x12ad 0x10cf 0x5329 0x9924 0x12ae 0x10d0 0x5524 0x98c7 0xe0b 0xca3 0x571f 0x985d 0x10b4 0xf08 0x591a 0x97f4 0x12f7 0x1112 0x5b15 0x9798 0x1321 0x1138 0x5d10 0x9746 0x132d 0x1142 0x5f0b 0x96f8 0x133a 0x114e 0x6105 0x96ab 0x134a 0x115c 0x6300 0x9664 0x1364 0x1174 0x64fb 0x962c 0x1396 0x11a1 0x66f6 0x95e9 0x13b1 0x11b9 0x68f1 0x95b0 0x13d3 0x11d8 0x6aec 0x9578 0x13f9 0x11fa 0x6ce7 0x9544 0x140e 0x120d 0x6ee2 0x9511 0x1427 0x1223 0x70dc 0x94e1 0x144c 0x1244 0x72d7 0x94b6 0x1472 0x1267 0x74d2 0x948e 0x1498 0x1289 0x76cd 0x9462 0x14bd 0x12aa 0x78c8 0x9441 0x14ef 0x12d7 0x7ac3 0x9425 0x1513 0x12f8 0x7cbe 0x9404 0x152f 0x1310 0x7eb9 0x93eb 0x1550 0x132f 0x80b4 0x93d4 0x158d 0x1366 0x82ae 0x93c1 0x15cb 0x139e 0x84a9 0x93b1 0x160e 0x13da 0x86a4 0x939e 0x165d 0x1420 0x889f 0x9387 0x16a3 0x1460 0x8a9a 0x9372 0x1706 0x14b8 0x8c95 0x935b 0x175c 0x1506 0x8e90 0x934f 0x179a 0x153e 0x908b 0x9330 0x1753 0x14fe 0x9286 0x930b 0x1802 0x159b 0x9480 0x92e8 0x18b8 0x163f 0x967b 0x92c0 0x1945 0x16be 0x9876 0x9293 0x19d3 0x173e 0x9a71 0x9264 0x1a74 0x17cf 0x9c6c 0x922f 0x1b2e 0x1876 0x9e67 0x91f1 0x1be9 0x191e 0xa062 0x91ae 0x1ca5 0x19c8 0xa25d 0x9165 0x1d84 0x1a90 0xa458 0x911d 0x1e64 0x1b5a 0xa652 0x90d0 0x1f88 0x1c61 0xa84d 0x9082 0x20ad 0x1d68 0xaa48 0x9030 0x21d8 0x1e76 0xac43 0x8fe7 0x232c 0x1fa7 0xae3e 0x8faf 0x24cd 0x211f 0xb039 0x8f82 0x26ce 0x22ed 0xb234 0x8f57 0x2923 0x2506 0xb42f 0x8f2f 0x2c1e 0x27b4 0xb629 0x8ef7 0x300b 0x2b3e 0xb824 0x8e8c 0x35aa 0x304c 0xba1f 0x8d99 0x3e54 0x3818 0xbc1a 0x8d49 0x4d93 0x45d1 0xbe15 0x8d4a 0x4fa3 0x47ac 0xc010 0x8d4a 0x4fa3 0x47ac 0xc20b 0x8d4a 0x4fa3 0x47ac 0xc406 0x8d4a 0x4fa3 0x47ac>;
			battery1_profile_t4_col = <0x4>;
			battery1_profile_t4_num = <0x64>;
			g_FG_PSEUDO100 = <0x62 0x62 0x64 0x64 0x60 0x60 0x64 0x64 0x5f 0x5f 0x64 0x64 0x5d 0x5d 0x64 0x64 0x5d 0x5d 0x64 0x64 0x64 0x64 0x64 0x64 0x64 0x64 0x64 0x64 0x64 0x64 0x64 0x64 0x64 0x64 0x64 0x64 0x64 0x64 0x64 0x64>;
			g_FG_PSEUDO100_col = <0xa>;
			g_FG_PSEUDO100_row = <0x4>;
			g_PMIC_MIN_VOL = <0x82dc 0x82dc 0x82dc 0x82dc 0x82dc 0x82dc 0x82dc 0x82dc 0x82dc 0x82dc 0x82dc 0x82dc 0x7dc8 0x7dc8 0x7dc8 0x7dc8 0x7918 0x7918 0x7918 0x7918 0x7918 0x7918 0x7918 0x7918 0x7918 0x7918 0x7918 0x7918 0x7918 0x7918 0x7918 0x7918 0x7918 0x7918 0x7918 0x7918 0x7918 0x7918 0x7918 0x79e0>;
			g_PMIC_MIN_VOL_col = <0xa>;
			g_PMIC_MIN_VOL_row = <0x4>;
			g_PON_SYS_IBOOT = <0x1388 0x1388 0x1388 0x1388 0x1388 0x1388 0x1388 0x1388 0x1388 0x1388 0x1388 0x1388 0x1388 0x1388 0x1388 0x1388 0x1388 0x1388 0x1388 0x1388 0x1388 0x1388 0x1388 0x1388 0x1388 0x1388 0x1388 0x1388 0x1388 0x1388 0x1388 0x1388 0x1388 0x1388 0x1388 0x1388 0x1388 0x1388 0x1388 0x1388>;
			g_PON_SYS_IBOOT_col = <0xa>;
			g_PON_SYS_IBOOT_row = <0x4>;
			g_QMAX_SYS_VOL = <0x8408 0x82dc 0x82dc 0x82dc 0x8408 0x82dc 0x82dc 0x82dc 0x82d5 0x82dc 0x82dc 0x82dc 0x80cd 0x8084 0x8084 0x8084 0x80cd 0x8020 0x8020 0x8020 0x8020 0x8020 0x8020 0x8020 0x8020 0x8020 0x8020 0x8020 0x8020 0x8020 0x8020 0x8020 0x8020 0x8020 0x8020 0x8020 0x8020 0x8020 0x8020 0x8020>;
			g_QMAX_SYS_VOL_col = <0xa>;
			g_QMAX_SYS_VOL_row = <0x4>;
		};
	};

	fragment@14 {
		target = <0xffffffff>;

		__overlay__ {
			io-channel-names = "auxadc3-chargeric_temp", "auxadc4-usb_temp_v_l", "auxadc5-usb_temp_v_r";
			io-channels = <0xffffffff 0x3 0xffffffff 0x4 0xffffffff 0x5>;
			pinctrl-0 = <0x3>;
			pinctrl-1 = <0x4>;
			pinctrl-2 = <0x5>;
			pinctrl-names = "default", "dischg_enable", "dischg_disable";
			qcom,batt_capacity_mah = <0x1388>;
			qcom,charger_hv_thr = <0x2710>;
			qcom,charger_lv_thr = <0xd48>;
			qcom,charger_recv_thr = <0x25e4>;
			qcom,check_batt_full_by_sw;
			qcom,chg_ctrl_by_calling;
			qcom,chg_ctrl_by_camera;
			qcom,chg_ctrl_by_lcd;
			qcom,cold_bat_decidegc = <0x14>;
			qcom,cold_vfloat_over_sw_limit = <0xf96>;
			qcom,cold_vfloat_sw_limit = <0xf5a>;
			qcom,cool_bat_decidegc = <0x32>;
			qcom,cool_vfloat_over_sw_limit = <0x115d>;
			qcom,cool_vfloat_sw_limit = <0x1121>;
			qcom,default_iterm_ma = <0xf4>;
			qcom,default_normal_vfloat_over_sw_limit = <0x115d>;
			qcom,default_normal_vfloat_sw_limit = <0x1121>;
			qcom,default_temp_normal_fastchg_current_ma = <0x898>;
			qcom,default_temp_normal_vfloat_mv = <0x1153>;
			qcom,dischg-gpio = <0xffffffff 0x80 0x0>;
			qcom,dual_charger_support = <0x1>;
			qcom,external_gauge;
			qcom,hot_bat_decidegc = <0x212>;
			qcom,input_current_calling_ma = <0x5dc>;
			qcom,input_current_camera_ma = <0x7d0>;
			qcom,input_current_cdp_ma = <0x5dc>;
			qcom,input_current_charger_ma = <0x898>;
			qcom,input_current_led_ma = <0x4b0>;
			qcom,input_current_led_ma_forcmcc = <0x1f4>;
			qcom,input_current_led_ma_high = <0x3e8>;
			qcom,input_current_led_ma_normal = <0x7d0>;
			qcom,input_current_led_ma_warm = <0x5dc>;
			qcom,input_current_usb_ma = <0x1f4>;
			qcom,iterm_disabled = <0x0>;
			qcom,iterm_ma = <0xf4>;
			qcom,little_cold_bat_decidegc = <0x0>;
			qcom,little_cold_vfloat_over_sw_limit = <0x115d>;
			qcom,little_cold_vfloat_sw_limit = <0x1121>;
			qcom,little_cool_bat_decidegc = <0x78>;
			qcom,little_cool_vfloat_over_sw_limit = <0x115d>;
			qcom,little_cool_vfloat_sw_limit = <0x1121>;
			qcom,max_chg_time_sec = <0xf1e0>;
			qcom,new_ui_warning_support;
			qcom,non_normal_vterm_hw_inc = <0x12>;
			qcom,non_standard_fastchg_current_ma = <0x200>;
			qcom,non_standard_vfloat_mv = <0xf8c>;
			qcom,non_standard_vfloat_over_sw_limit = <0xf96>;
			qcom,non_standard_vfloat_sw_limit = <0xf5a>;
			qcom,normal_bat_decidegc = <0xa0>;
			qcom,normal_phase1_bat_decidegc = <0xa0>;
			qcom,normal_phase2_bat_decidegc = <0xdc>;
			qcom,normal_phase3_bat_decidegc = <0x154>;
			qcom,normal_phase4_bat_decidegc = <0x172>;
			qcom,normal_phase5_bat_decidegc = <0x190>;
			qcom,normal_phase6_bat_decidegc = <0x1a4>;
			qcom,normal_vfloat_over_sw_limit = <0x115d>;
			qcom,normal_vfloat_sw_limit = <0x1121>;
			qcom,normal_vterm_hw_inc = <0x12>;
			qcom,overchg_normal_fastchg_ma = <0x2bc>;
			qcom,overchg_normal_vfloat_over_sw_limit = <0x1194>;
			qcom,overchg_normal_vfloat_sw_limit = <0x1162>;
			qcom,overchg_temp_high_decidegc = <0x190>;
			qcom,overchg_temp_normal_vfloat_mv = <0x1194>;
			qcom,overchg_temp_warm_decidegc = <0x15e>;
			qcom,overchg_warm_fastchg_ma = <0x2ee>;
			qcom,qc_input_current_charger_ma = <0x7d0>;
			qcom,qc_temp_cool_fastchg_current_ma_high = <0x992>;
			qcom,qc_temp_cool_fastchg_current_ma_low = <0x992>;
			qcom,qc_temp_little_cold_fastchg_current_ma_high = <0x92e>;
			qcom,qc_temp_little_cold_fastchg_current_ma_low = <0x578>;
			qcom,qc_temp_little_cool_fastchg_current_ma = <0xd48>;
			qcom,qc_temp_little_cool_fastchg_current_ma_high = <0xd48>;
			qcom,qc_temp_little_cool_fastchg_current_ma_low = <0x992>;
			qcom,qc_temp_normal_fastchg_current_ma = <0xd48>;
			qcom,qc_temp_warm_fastchg_current_ma = <0x578>;
			qcom,recharge-mv = <0x64>;
			qcom,removed_bat_decidegc = <0xbe>;
			qcom,short_c_bat_cv_mv = <0x10ea>;
			qcom,short_c_bat_fastchg_current_ma = <0x200>;
			qcom,short_c_bat_vfloat_mv = <0xed8>;
			qcom,short_c_bat_vfloat_sw_limit = <0xea6>;
			qcom,slave_chg_disable_ma = <0x898>;
			qcom,slave_chg_enable_ma = <0x960>;
			qcom,slave_pct = <0x1e>;
			qcom,step1_current_ma = <0xd48>;
			qcom,step1_time = <0x258>;
			qcom,step2_current_ma = <0xc80>;
			qcom,step2_time = <0x384>;
			qcom,step3_current_ma = <0xbb8>;
			qcom,sw_vfloat_over_protect_enable;
			qcom,temp_cold_fastchg_current_ma = <0x15e>;
			qcom,temp_cold_vfloat_mv = <0xf8c>;
			qcom,temp_cool_fastchg_current_ma_high = <0x6a4>;
			qcom,temp_cool_fastchg_current_ma_low = <0x6a4>;
			qcom,temp_cool_vfloat_mv = <0x1153>;
			qcom,temp_little_cold_fastchg_current_ma = <0x6a4>;
			qcom,temp_little_cold_fastchg_current_ma_high = <0x6a4>;
			qcom,temp_little_cold_fastchg_current_ma_low = <0x578>;
			qcom,temp_little_cold_vfloat_mv = <0x1153>;
			qcom,temp_little_cool_fastchg_current_ma = <0x6a4>;
			qcom,temp_little_cool_fastchg_current_ma_high = <0x6a4>;
			qcom,temp_little_cool_fastchg_current_ma_low = <0x6a4>;
			qcom,temp_little_cool_vfloat_mv = <0x1153>;
			qcom,temp_normal_fastchg_current_ma = <0x6a4>;
			qcom,temp_normal_phase1_fastchg_current_ma = <0xd48>;
			qcom,temp_normal_phase1_vfloat_mv = <0x1153>;
			qcom,temp_normal_phase2_fastchg_current_ma_high = <0xd48>;
			qcom,temp_normal_phase2_fastchg_current_ma_low = <0xd48>;
			qcom,temp_normal_phase2_vfloat_mv = <0x1153>;
			qcom,temp_normal_phase3_fastchg_current_ma_high = <0xb54>;
			qcom,temp_normal_phase3_fastchg_current_ma_low = <0xb54>;
			qcom,temp_normal_phase3_vfloat_mv = <0x1153>;
			qcom,temp_normal_phase4_fastchg_current_ma_high = <0xa28>;
			qcom,temp_normal_phase4_fastchg_current_ma_low = <0xa28>;
			qcom,temp_normal_phase4_vfloat_mv = <0x1153>;
			qcom,temp_normal_phase5_fastchg_current_ma = <0x8fc>;
			qcom,temp_normal_phase5_vfloat_mv = <0x1153>;
			qcom,temp_normal_phase6_fastchg_current_ma = <0x578>;
			qcom,temp_normal_phase6_vfloat_mv = <0x1153>;
			qcom,temp_normal_vfloat_mv = <0x1153>;
			qcom,temp_warm_fastchg_current_ma = <0x578>;
			qcom,temp_warm_fastchg_current_ma_led_on = <0x1f4>;
			qcom,temp_warm_vfloat_mv = <0x1022>;
			qcom,vbatt_full_thr = <0x1153>;
			qcom,vbatt_hv_thr = <0x1194>;
			qcom,vbatt_num = <0x1>;
			qcom,vbatt_pdqc_to_5v_thr = <0xd48>;
			qcom,vbatt_power_off = <0xce4>;
			qcom,vbatt_soc_1 = <0xd52>;
			qcom,vfloat_step_mv = <0x8>;
			qcom,warm_bat_decidegc = <0x1c2>;
			qcom,warm_vfloat_over_sw_limit = <0x102c>;
			qcom,warm_vfloat_sw_limit = <0xff0>;
		};
	};

	fragment@15 {
		target = <0xffffffff>;

		__overlay__ {
			FUELGAGUE_APPLY = <0x1>;
		};
	};

	fragment@16 {
		target = <0xffffffff>;

		__overlay__ {
			regulator-enable-ramp-delay = <0xf0>;
			regulator-max-microvolt = <0x2dc6c0>;
			regulator-min-microvolt = <0x2dc6c0>;
			regulator-name = "vio28";
		};
	};

	fragment@17 {
		target = <0xffffffff>;

		__overlay__ {

			dischg_disable {
				phandle = <0x5>;

				pins_cmd_dat {
					bias-pull-down = <0x0>;
					output-low;
					pinmux = <0x8000>;
					slew-rate = <0x1>;
				};
			};

			dischg_enable {
				phandle = <0x4>;

				pins_cmd_dat {
					bias-pull-up = <0x0>;
					output-high;
					pinmux = <0x8000>;
					slew-rate = <0x1>;
				};
			};

			eint0default {
				phandle = <0x3>;
			};
		};
	};

	fragment@18 {
		target = <0xffffffff>;

		__overlay__ {
			pinctrl-0 = <0x6>;
			pinctrl-1 = <0x7>;
			pinctrl-names = "uart0_rx_gpio", "uart0_tx_gpio";
			status = "okay";
		};
	};

	fragment@19 {
		target = <0xffffffff>;

		__overlay__ {

			uart0_rx_gpio@gpio61 {
				phandle = <0x6>;

				pins_cmd_dat {
					bias-disable;
					input-enable;
					pinmux = <0x3d00>;
					slew-rate = <0x0>;
				};
			};

			uart0_tx_gpio@gpio62 {
				phandle = <0x7>;

				pins_cmd_dat {
					bias-disable;
					input-enable;
					pinmux = <0x3e00>;
					slew-rate = <0x0>;
				};
			};
		};
	};

	fragment@2 {
		target = <0xffffffff>;

		__overlay__ {

			kpd_volume_down {
				compatible = "mediatek, VOLUME_DOWN-eint";
				debounce = <0x7d00>;
				interrupt-parent = <0xffffffff>;
				interrupts = <0x50 0x2 0x50 0x0>;
				phandle = <0x59>;
				status = "okay";
			};

			kpd_volume_up {
				compatible = "mediatek, VOLUME_UP-eint";
				debounce = <0x7d00>;
				interrupt-parent = <0xffffffff>;
				interrupts = <0x1 0x2 0x1 0x0>;
				phandle = <0x58>;
				status = "okay";
			};

			led@0 {
				compatible = "mediatek,red";
				data = <0x1>;
				led_mode = <0x0>;
				phandle = <0x50>;
				pwm_config = <0x0 0x0 0x0 0x0 0x0>;
			};

			led@1 {
				compatible = "mediatek,green";
				data = <0x1>;
				led_mode = <0x0>;
				phandle = <0x51>;
				pwm_config = <0x0 0x0 0x0 0x0 0x0>;
			};

			led@2 {
				compatible = "mediatek,blue";
				data = <0x1>;
				led_mode = <0x0>;
				phandle = <0x52>;
				pwm_config = <0x0 0x0 0x0 0x0 0x0>;
			};

			led@3 {
				compatible = "mediatek,jogball-backlight";
				data = <0x1>;
				led_mode = <0x0>;
				phandle = <0x53>;
				pwm_config = <0x0 0x0 0x0 0x0 0x0>;
			};

			led@4 {
				compatible = "mediatek,keyboard-backlight";
				data = <0x1>;
				led_mode = <0x0>;
				phandle = <0x54>;
				pwm_config = <0x0 0x0 0x0 0x0 0x0>;
			};

			led@5 {
				compatible = "mediatek,button-backlight";
				data = <0x1>;
				led_mode = <0x0>;
				phandle = <0x55>;
				pwm_config = <0x0 0x0 0x0 0x0 0x0>;
			};

			led@6 {
				compatible = "mediatek,lcd-backlight";
				data = <0x1>;
				led_mode = <0x4>;
				phandle = <0x56>;
				pwm_config = <0x0 0x1 0x0 0x0 0x0>;
			};

			oppo_devinfo {
				Hw,sim_det = <0xffffffff 0x4d 0x0>;
				compatible = "oppo, device_info";
				phandle = <0x5b>;
			};

			oppo_project {
				compatible = "oppo,oppo_project";
				phandle = <0x5a>;
			};

			vibrator@0 {
				compatible = "mediatek,vibrator";
				phandle = <0x57>;
				vib_limit = <0x0>;
				vib_timer = <0x1e>;
				vib_vol = <0xb>;
			};
		};
	};

	fragment@20 {
		target = <0xffffffff>;

		__overlay__ {
			status = "okay";

			fan53870@35 {
				compatible = "fan53870";
				ldo1_max_vol = <0x16f300>;
				ldo1_min_vol = <0xc3500>;
				ldo1_step_vol = <0x1f40>;
				reg = <0x35>;
			};
		};
	};

	fragment@21 {
		target = <0xffffffff>;

		__overlay__ {

			c1_high {
				phandle = <0x60>;

				pins_cmd_dat {
					output-high;
					pinmux = <0x2900>;
					slew-rate = <0x1>;
				};
			};

			c1_highz {
				phandle = <0x5f>;

				pins_cmd_dat {
					bias-disable;
					pinmux = <0x2900>;
					slew-rate = <0x0>;
				};
			};

			c1_init {
				phandle = <0x5d>;

				pins_cmd_dat {
					output-low;
					pinmux = <0x2900>;
					slew-rate = <0x1>;
				};
			};

			c1_low {
				phandle = <0x5e>;

				pins_cmd_dat {
					output-low;
					pinmux = <0x2900>;
					slew-rate = <0x1>;
				};
			};

			c2_high {
				phandle = <0x64>;

				pins_cmd_dat {
					output-high;
					pinmux = <0x2800>;
					slew-rate = <0x1>;
				};
			};

			c2_highz {
				phandle = <0x63>;

				pins_cmd_dat {
					bias-disable;
					pinmux = <0x2800>;
					slew-rate = <0x0>;
				};
			};

			c2_init {
				phandle = <0x61>;

				pins_cmd_dat {
					output-low;
					pinmux = <0x2800>;
					slew-rate = <0x1>;
				};
			};

			c2_low {
				phandle = <0x62>;

				pins_cmd_dat {
					output-low;
					pinmux = <0x2800>;
					slew-rate = <0x1>;
				};
			};

			u3_sw_dis {
				phandle = <0x68>;
			};

			u3_sw_en {
				phandle = <0x67>;
			};

			u3_sw_sel1 {
				phandle = <0x65>;

				pins_cmd_dat {
					output-low;
					pinmux = <0xb00>;
					slew-rate = <0x1>;
				};
			};

			u3_sw_sel2 {
				phandle = <0x66>;

				pins_cmd_dat {
					output-high;
					pinmux = <0xb00>;
					slew-rate = <0x1>;
				};
			};

			usb_default {
				phandle = <0x5c>;
			};
		};
	};

	fragment@22 {
		target = <0xffffffff>;

		__overlay__ {

			st54spi@0 {
				compatible = "st,st54spi";
				gpio-power = <0x8>;
				gpio-power-std = <0xffffffff 0x8 0x0>;
				reg = <0x0>;
				spi-max-frequency = <0xf4240>;
				status = "okay";
			};
		};
	};

	fragment@23 {
		target = <0xffffffff>;

		__overlay__ {

			consys_default {
				phandle = <0x8>;
			};

			gpslna@0 {
				phandle = <0x9>;

				pins_cmd_dat {
					output-low;
					pinmux = <0x5700>;
				};
			};

			gpslna@1 {
				phandle = <0xa>;

				pins_cmd_dat {
					pinmux = <0x5702>;
				};
			};

			gpslna@2 {
				phandle = <0xb>;

				pins_cmd_dat {
					output-low;
					pinmux = <0x5700>;
				};
			};
		};
	};

	fragment@24 {
		target = <0xffffffff>;

		__overlay__ {
			pinctrl-0 = <0x8>;
			pinctrl-1 = <0x9>;
			pinctrl-2 = <0xa>;
			pinctrl-3 = <0xb>;
			pinctrl-names = "default", "gps_lna_state_init", "gps_lna_state_oh", "gps_lna_state_ol";
			status = "okay";
		};
	};

	fragment@25 {
		target = <0xffffffff>;

		__overlay__ {
			status = "okay";

			touchscreen@0 {
				black_gesture_support;
				black_gesture_test_support;
				charger_pump_support;
				chip-name = "NF_NT36525B";
				compatible = "novatek,nf_nt36525b";
				esd_handle_support;
				fw_edge_limit_support;
				fw_update_app_support;
				game_switch_support;
				headset_pump_support;
				incell_screen;
				interrupt-parent = <0xffffffff>;
				interrupts = <0xe 0x2 0xe 0x0>;
				irq-gpio = <0xffffffff 0xe 0x2002>;
				irq_need_dev_resume_ok;
				lcd_trigger_load_tp_fw_support;
				noflash_support;
				pinctrl-0 = <0xc>;
				pinctrl-names = "default";
				pressure_report_support;
				reg = <0x0>;
				reset-gpio = <0xffffffff 0x21 0x0>;
				smart_gesture_support;
				spi-max-frequency = <0x927c00>;
				status = "ok";
				touchpanel,button-type = <0x4>;
				touchpanel,display-coords = <0x2d0 0x640>;
				touchpanel,max-num-support = <0xa>;
				touchpanel,panel-coords = <0x2d0 0x640>;
				touchpanel,touchmajor-limit = <0x0 0x36>;
				touchpanel,tx-rx-num = <0x12 0x20>;
			};
		};
	};

	fragment@26 {
		target = <0xffffffff>;

		__overlay__ {
			clock-frequency = <0x61a80>;
			pinctrl-0 = <0xd>;
			pinctrl-1 = <0xe>;
			pinctrl-2 = <0xf>;
			pinctrl-3 = <0x10>;
			pinctrl-4 = <0x11>;
			pinctrl-5 = <0x12>;
			pinctrl-names = "default", "ts_int_active", "ts_reset_active", "ts_int_suspend", "ts_reset_suspend", "ts_i2c_mode";

			gt9886@5d {
				black_gesture_support;
				black_gesture_test_support;
				charger_pump_support;
				compatible = "goodix,gt9886";
				esd_handle_support;
				fw_edge_limit_support;
				fw_update_app_support;
				fw_update_in_probe_with_headfile;
				game_switch_support;
				headset_pump_support;
				incell_screen;
				interrupt-parent = <0xffffffff>;
				interrupts = <0xe 0x2 0xe 0x0>;
				irq-gpio = <0xffffffff 0xe 0x2002>;
				lcd_trigger_load_tp_fw_support;
				noflash_support;
				pinctrl-0 = <0x13 0x14 0x15>;
				pinctrl-1 = <0x16 0x17>;
				pinctrl-names = "default", "suspend";
				pressure_report_support;
				reg = <0x5d>;
				reset-gpio = <0xffffffff 0x2b 0x0>;
				smart_gesture_support;
				spi-max-frequency = <0x927c00>;
				status = "ok";
				touchpanel,button-type = <0x4>;
				touchpanel,display-coords = <0x438 0x960>;
				touchpanel,max-num-support = <0xa>;
				touchpanel,panel-coords = <0x438 0x960>;
				touchpanel,touchmajor-limit = <0x0 0x36>;
				touchpanel,tx-rx-num = <0x10 0x24>;
			};
		};
	};

	fragment@27 {
		target = <0xffffffff>;

		__overlay__ {

			eintdefault {
				phandle = <0xd>;
			};

			i2cmode_default {
				phandle = <0x12>;

				pins_cmd_dat {
					pinmux = <0x6101 0x6201>;
				};
			};

			int1_active {
				phandle = <0x13>;

				pins_cmd_dat {
					bias-pull-up = <0xb>;
					pinmux = <0xe00>;
					slew-rate = <0x0>;
				};
			};

			int1_suspend {
				phandle = <0x16>;

				pins_cmd_dat {
					output-low;
					pinmux = <0xe00>;
					slew-rate = <0x1>;
				};
			};

			int_active {
				phandle = <0xe>;

				pins_cmd_dat {
					bias-pull-up = <0xb>;
					pinmux = <0xe00>;
					slew-rate = <0x0>;
				};
			};

			int_suspend {
				phandle = <0x10>;

				pins_cmd_dat {
					output-low;
					pinmux = <0xe00>;
					slew-rate = <0x1>;
				};
			};

			pins_default {
				phandle = <0x69>;
			};

			reset1_active {
				phandle = <0x14>;

				pins_cmd_dat {
					output-high;
					pinmux = <0x2100>;
					slew-rate = <0x1>;
				};
			};

			reset1_suspend {
				phandle = <0x17>;

				pins_cmd_dat {
					output-low;
					pinmux = <0x2100>;
					slew-rate = <0x1>;
				};
			};

			reset_active {
				phandle = <0xf>;

				pins_cmd_dat {
					output-high;
					pinmux = <0x2b00>;
					slew-rate = <0x1>;
				};
			};

			reset_suspend {
				phandle = <0x11>;

				pins_cmd_dat {
					output-low;
					pinmux = <0x2b00>;
					slew-rate = <0x1>;
				};
			};

			spimode_default {
				phandle = <0x15>;

				pins_cmd_dat {
					drive-strength = <0x4>;
					pinmux = <0xc02 0xd02 0x6102 0x6202>;
				};
			};
		};
	};

	fragment@28 {
		target = <0xffffffff>;

		__overlay__ {

			ctp_novatek_spi_mode {
				phandle = <0xc>;

				pins_cmd_dat {
					drive-strength = <0x4>;
					pinmux = <0xc02 0xd02 0x6102 0x6202>;
				};
			};
		};
	};

	fragment@29 {
		target = <0xffffffff>;

		__overlay__ {

			mediatek,speaker-codec {
				sound-dai = <0x18>;
			};
		};
	};

	fragment@3 {
		target = <0xffffffff>;

		__overlay__ {
			compatible = "mediatek,phy_tuning";
			host_u2_enhance = <0x2>;
			host_u2_term_ref = <0x6>;
			host_u2_vrt_ref = <0x6>;
			u2_enhance = <0x3>;
			u2_term_ref = <0x7>;
			u2_vrt_ref = <0x7>;
		};
	};

	fragment@30 {
		target = <0xffffffff>;

		__overlay__ {

			speaker_amp@34 {
				#sound-dai-cells = <0x0>;
				compatible = "mediatek,speaker_amp";
				phandle = <0x18>;
				reg = <0x34>;
				status = "okay";
			};
		};
	};

	fragment@31 {
		target = <0xffffffff>;

		__overlay__ {
			compatible = "mediatek, swtp-eint";
			debounce = <0x7d000>;
		};
	};

	fragment@32 {
		target = <0xffffffff>;

		__overlay__ {

			cam0@0 {
				phandle = <0x1a>;

				pins_cmd_dat {
					output-low;
					pinmux = <0x3600>;
					slew-rate = <0x1>;
				};
			};

			cam0@1 {
				phandle = <0x1b>;

				pins_cmd_dat {
					output-high;
					pinmux = <0x3600>;
					slew-rate = <0x1>;
				};
			};

			cam0@vcam2 {
				phandle = <0x22>;

				pins_cmd_dat {
					output-low;
					pinmux = <0x5b00>;
					slew-rate = <0x1>;
				};
			};

			cam0@vcam3 {
				phandle = <0x23>;

				pins_cmd_dat {
					output-high;
					pinmux = <0x5b00>;
					slew-rate = <0x1>;
				};
			};

			cam1@0 {
				phandle = <0x1c>;

				pins_cmd_dat {
					output-low;
					pinmux = <0x3c00>;
					slew-rate = <0x1>;
				};
			};

			cam1@1 {
				phandle = <0x1d>;

				pins_cmd_dat {
					output-high;
					pinmux = <0x3c00>;
					slew-rate = <0x1>;
				};
			};

			cam1@vcam2 {
				phandle = <0x24>;

				pins_cmd_dat {
					output-low;
					pinmux = <0x5b00>;
					slew-rate = <0x1>;
				};
			};

			cam1@vcam3 {
				phandle = <0x25>;

				pins_cmd_dat {
					output-high;
					pinmux = <0x5b00>;
					slew-rate = <0x1>;
				};
			};

			cam2@0 {
				phandle = <0x1e>;

				pins_cmd_dat {
					output-low;
					pinmux = <0x3500>;
					slew-rate = <0x1>;
				};
			};

			cam2@1 {
				phandle = <0x1f>;

				pins_cmd_dat {
					output-high;
					pinmux = <0x3500>;
					slew-rate = <0x1>;
				};
			};

			cam2@vcam2 {
				phandle = <0x26>;

				pins_cmd_dat {
					output-low;
					pinmux = <0x5b00>;
					slew-rate = <0x1>;
				};
			};

			cam2@vcam3 {
				phandle = <0x27>;

				pins_cmd_dat {
					output-high;
					pinmux = <0x5b00>;
					slew-rate = <0x1>;
				};
			};

			cam3@0 {
				phandle = <0x20>;

				pins_cmd_dat {
					output-low;
					pinmux = <0x3a00>;
					slew-rate = <0x1>;
				};
			};

			cam3@1 {
				phandle = <0x21>;

				pins_cmd_dat {
					output-high;
					pinmux = <0x3a00>;
					slew-rate = <0x1>;
				};
			};

			cam3@vcam2 {
				phandle = <0x28>;

				pins_cmd_dat {
					output-low;
					pinmux = <0x5b00>;
					slew-rate = <0x1>;
				};
			};

			cam3@vcam3 {
				phandle = <0x29>;

				pins_cmd_dat {
					output-high;
					pinmux = <0x5b00>;
					slew-rate = <0x1>;
				};
			};

			camdefault {
				phandle = <0x19>;
			};

			camera_pins_cam0_mclk_2ma {
				phandle = <0x2b>;

				pins_cmd_dat {
					drive-strength = <0x0>;
					pinmux = <0x3101>;
				};
			};

			camera_pins_cam0_mclk_4ma {
				phandle = <0x2c>;

				pins_cmd_dat {
					drive-strength = <0x1>;
					pinmux = <0x3101>;
				};
			};

			camera_pins_cam0_mclk_6ma {
				phandle = <0x2d>;

				pins_cmd_dat {
					drive-strength = <0x2>;
					pinmux = <0x3101>;
				};
			};

			camera_pins_cam0_mclk_8ma {
				phandle = <0x2e>;

				pins_cmd_dat {
					drive-strength = <0x3>;
					pinmux = <0x3101>;
				};
			};

			camera_pins_cam0_mclk_off {
				phandle = <0x2a>;

				pins_cmd_dat {
					drive-strength = <0x1>;
					pinmux = <0x3100>;
				};
			};

			camera_pins_cam1_mclk_2ma {
				phandle = <0x30>;

				pins_cmd_dat {
					drive-strength = <0x0>;
					pinmux = <0x3401>;
				};
			};

			camera_pins_cam1_mclk_4ma {
				phandle = <0x31>;

				pins_cmd_dat {
					drive-strength = <0x1>;
					pinmux = <0x3401>;
				};
			};

			camera_pins_cam1_mclk_6ma {
				phandle = <0x32>;

				pins_cmd_dat {
					drive-strength = <0x2>;
					pinmux = <0x3401>;
				};
			};

			camera_pins_cam1_mclk_8ma {
				phandle = <0x33>;

				pins_cmd_dat {
					drive-strength = <0x3>;
					pinmux = <0x3401>;
				};
			};

			camera_pins_cam1_mclk_off {
				phandle = <0x2f>;

				pins_cmd_dat {
					drive-strength = <0x1>;
					pinmux = <0x3400>;
				};
			};

			camera_pins_cam2_mclk_2ma {
				phandle = <0x35>;

				pins_cmd_dat {
					drive-strength = <0x0>;
					pinmux = <0x3301>;
				};
			};

			camera_pins_cam2_mclk_4ma {
				phandle = <0x36>;

				pins_cmd_dat {
					drive-strength = <0x1>;
					pinmux = <0x3301>;
				};
			};

			camera_pins_cam2_mclk_6ma {
				phandle = <0x37>;

				pins_cmd_dat {
					drive-strength = <0x2>;
					pinmux = <0x3301>;
				};
			};

			camera_pins_cam2_mclk_8ma {
				phandle = <0x38>;

				pins_cmd_dat {
					drive-strength = <0x3>;
					pinmux = <0x3301>;
				};
			};

			camera_pins_cam2_mclk_off {
				phandle = <0x34>;

				pins_cmd_dat {
					drive-strength = <0x1>;
					pinmux = <0x3300>;
				};
			};

			camera_pins_cam3_mclk_2ma {
				phandle = <0x3a>;

				pins_cmd_dat {
					drive-strength = <0x0>;
					pinmux = <0x3201>;
				};
			};

			camera_pins_cam3_mclk_4ma {
				phandle = <0x3b>;

				pins_cmd_dat {
					drive-strength = <0x1>;
					pinmux = <0x3201>;
				};
			};

			camera_pins_cam3_mclk_6ma {
				phandle = <0x3c>;

				pins_cmd_dat {
					drive-strength = <0x2>;
					pinmux = <0x3201>;
				};
			};

			camera_pins_cam3_mclk_8ma {
				phandle = <0x3d>;

				pins_cmd_dat {
					drive-strength = <0x3>;
					pinmux = <0x3201>;
				};
			};

			camera_pins_cam3_mclk_off {
				phandle = <0x39>;

				pins_cmd_dat {
					drive-strength = <0x1>;
					pinmux = <0x3200>;
				};
			};
		};
	};

	fragment@33 {
		target = <0xffffffff>;

		__overlay__ {
			cam0_enable_sensor = "cake_ov13b10_mipi_raw";
			cam0_vcamd-supply = <0xffffffff>;
			cam0_vcamio-supply = <0xffffffff>;
			cam1_enable_sensor = "cake_s5k4h7_mipi_raw";
			cam1_vcamd-supply = <0xffffffff>;
			cam1_vcamio-supply = <0xffffffff>;
			cam2_enable_sensor = "cake_gc02m1b_mipi_mono";
			cam2_vcama-supply = <0xffffffff>;
			cam2_vcamio-supply = <0xffffffff>;
			cam3_enable_sensor = "cake_gc02k0_mipi_raw";
			cam3_vcamio-supply = <0xffffffff>;
			pinctrl-0 = <0x19>;
			pinctrl-1 = <0x1a>;
			pinctrl-10 = <0x23>;
			pinctrl-11 = <0x24>;
			pinctrl-12 = <0x25>;
			pinctrl-13 = <0x26>;
			pinctrl-14 = <0x27>;
			pinctrl-15 = <0x28>;
			pinctrl-16 = <0x29>;
			pinctrl-17 = <0x2a>;
			pinctrl-18 = <0x2b>;
			pinctrl-19 = <0x2c>;
			pinctrl-2 = <0x1b>;
			pinctrl-20 = <0x2d>;
			pinctrl-21 = <0x2e>;
			pinctrl-22 = <0x2f>;
			pinctrl-23 = <0x30>;
			pinctrl-24 = <0x31>;
			pinctrl-25 = <0x32>;
			pinctrl-26 = <0x33>;
			pinctrl-27 = <0x34>;
			pinctrl-28 = <0x35>;
			pinctrl-29 = <0x36>;
			pinctrl-3 = <0x1c>;
			pinctrl-30 = <0x37>;
			pinctrl-31 = <0x38>;
			pinctrl-32 = <0x39>;
			pinctrl-33 = <0x3a>;
			pinctrl-34 = <0x3b>;
			pinctrl-35 = <0x3c>;
			pinctrl-36 = <0x3d>;
			pinctrl-4 = <0x1d>;
			pinctrl-5 = <0x1e>;
			pinctrl-6 = <0x1f>;
			pinctrl-7 = <0x20>;
			pinctrl-8 = <0x21>;
			pinctrl-9 = <0x22>;
			pinctrl-names = "default", "cam0_rst0", "cam0_rst1", "cam1_rst0", "cam1_rst1", "cam2_rst0", "cam2_rst1", "cam3_rst0", "cam3_rst1", "cam0_ldo_vcama_0", "cam0_ldo_vcama_1", "cam1_ldo_vcama_0", "cam1_ldo_vcama_1", "cam2_ldo_vcama_0", "cam2_ldo_vcama_1", "cam3_ldo_vcama_0", "cam3_ldo_vcama_1", "cam0_mclk_off", "cam0_mclk_2mA", "cam0_mclk_4mA", "cam0_mclk_6mA", "cam0_mclk_8mA", "cam1_mclk_off", "cam1_mclk_2mA", "cam1_mclk_4mA", "cam1_mclk_6mA", "cam1_mclk_8mA", "cam2_mclk_off", "cam2_mclk_2mA", "cam2_mclk_4mA", "cam2_mclk_6mA", "cam2_mclk_8mA", "cam3_mclk_off", "cam3_mclk_2mA", "cam3_mclk_4mA", "cam3_mclk_6mA", "cam3_mclk_8mA";
			status = "okay";
			vcammainaf-supply = <0xffffffff>;
		};
	};

	fragment@34 {
		target = <0xffffffff>;

		__overlay__ {

			camera_eeprom0@50 {
				compatible = "mediatek,camera_eeprom";
				phandle = <0x6a>;
				reg = <0x50>;
				status = "okay";
			};
		};
	};

	fragment@35 {
		target = <0xffffffff>;

		__overlay__ {

			camera_eeprom3@52 {
				compatible = "mediatek,camera_eeprom";
				phandle = <0x6b>;
				reg = <0x52>;
				status = "okay";
			};
		};
	};

	fragment@36 {
		target = <0xffffffff>;

		__overlay__ {

			adc_channel@ {
				compatible = "mediatek,adc_channel";
				mediatek,adc_fdd_rf_params_dynamic_custom_ch = <0x2>;
				mediatek,temperature0 = <0x0>;
				mediatek,temperature1 = <0x1>;
				status = "okay";
			};
		};
	};

	fragment@37 {
		target = <0xffffffff>;

		__overlay__ {
			io-channels = <0xffffffff 0x2>;
		};
	};

	fragment@38 {
		target = <0xffffffff>;

		__overlay__ {
			mediatek,clkbuf-config = <0x2 0x1 0x1 0x2 0x0 0x0 0x1>;
			mediatek,clkbuf-controls-for-desense = <0x0 0x4 0x0 0x4 0x0 0x0 0x0>;
			mediatek,clkbuf-output-impedance = <0x6 0x4 0x4 0x4 0x0 0x0 0x4>;
			mediatek,clkbuf-quantity = <0x7>;
			status = "okay";
		};
	};

	fragment@39 {
		target = <0xffffffff>;

		__overlay__ {
			#address-cells = <0x1>;
			#size-cells = <0x0>;
			clock-frequency = <0x61a80>;
			mediatek,use-open-drain;
		};
	};

	fragment@4 {
		target = <0xffffffff>;

		__overlay__ {
			keypad,volume-down = <0xffffffff 0x50 0x0>;
			keypad,volume-up = <0xffffffff 0x1 0x0>;
			pinctrl-0 = <0x1>;
			pinctrl-1 = <0x2>;
			pinctrl-names = "volume_up_as_int", "volume_down_as_int";
			status = "okay";
		};
	};

	fragment@40 {
		target = <0xffffffff>;

		__overlay__ {
			#address-cells = <0x1>;
			#size-cells = <0x0>;
			clock-frequency = <0x61a80>;
			mediatek,use-open-drain;
		};
	};

	fragment@41 {
		target = <0xffffffff>;

		__overlay__ {
			#address-cells = <0x1>;
			#size-cells = <0x0>;
			clock-frequency = <0x61a80>;
			mediatek,use-open-drain;

			camera_main@6c {
				compatible = "mediatek,camera_main";
				phandle = <0x6e>;
				reg = <0x6c>;
				status = "okay";
			};

			camera_main_af@18 {
				compatible = "mediatek,camera_main_af";
				phandle = <0x6f>;
				reg = <0x18>;
				status = "okay";
			};

			camera_main_three@1b {
				compatible = "mediatek,camera_main_three";
				phandle = <0x6c>;
				reg = <0x1b>;
				status = "okay";
			};

			camera_sub_two@6e {
				compatible = "mediatek,camera_sub_two";
				phandle = <0x6d>;
				reg = <0x6e>;
				status = "okay";
			};
		};
	};

	fragment@42 {
		target = <0xffffffff>;

		__overlay__ {
			#address-cells = <0x1>;
			#size-cells = <0x0>;
			clock-frequency = <0x61a80>;
			mediatek,use-open-drain;

			nfc@08 {
				compatible = "mediatek,nfc";
				phandle = <0x70>;
				reg = <0x8>;
				status = "okay";
			};

			strobe_main@63 {
				compatible = "mediatek,strobe_main";
				phandle = <0x71>;
				reg = <0x63>;
				status = "okay";
			};
		};
	};

	fragment@43 {
		target = <0xffffffff>;

		__overlay__ {
			#address-cells = <0x1>;
			#size-cells = <0x0>;
			clock-frequency = <0x61a80>;
			mediatek,use-open-drain;

			camera_main_two@6e {
				compatible = "mediatek,camera_main_two";
				phandle = <0x72>;
				reg = <0x6e>;
				status = "okay";
			};

			camera_sub@20 {
				compatible = "mediatek,camera_sub";
				phandle = <0x73>;
				reg = <0x20>;
				status = "okay";
			};
		};
	};

	fragment@44 {
		target = <0xffffffff>;

		__overlay__ {
			#address-cells = <0x1>;
			#size-cells = <0x0>;
			clock-frequency = <0x33e140>;
			mediatek,use-push-pull;

			subpmic@34 {
				compatible = "mediatek,subpmic";
				phandle = <0x74>;
				reg = <0x34>;
				status = "okay";
			};

			subpmic_ldo@64 {
				compatible = "mediatek,subpmic_ldo";
				phandle = <0x77>;
				reg = <0x64>;
				status = "okay";
			};

			subpmic_pmic@1a {
				compatible = "mediatek,subpmic_pmic";
				phandle = <0x76>;
				reg = <0x1a>;
				status = "okay";
			};

			usb_type_c@4e {
				compatible = "mediatek,usb_type_c";
				phandle = <0x75>;
				reg = <0x4e>;
				status = "okay";
			};
		};
	};

	fragment@45 {
		target = <0xffffffff>;

		__overlay__ {
			#address-cells = <0x1>;
			#size-cells = <0x0>;
			clock-frequency = <0x61a80>;
			mediatek,use-open-drain;

			i2c_lcd_bias@3e {
				compatible = "mediatek,i2c_lcd_bias";
				phandle = <0x78>;
				reg = <0x3e>;
				status = "okay";
			};
		};
	};

	fragment@46 {
		target = <0xffffffff>;

		__overlay__ {
			#address-cells = <0x1>;
			#size-cells = <0x0>;
			clock-frequency = <0x61a80>;
			mediatek,use-open-drain;
		};
	};

	fragment@47 {
		target = <0xffffffff>;

		__overlay__ {
			#address-cells = <0x1>;
			#size-cells = <0x0>;
			clock-frequency = <0x61a80>;
			mediatek,use-open-drain;
		};
	};

	fragment@48 {
		target = <0xffffffff>;

		__overlay__ {
			#address-cells = <0x1>;
			#size-cells = <0x0>;
			clock-frequency = <0x61a80>;
			mediatek,use-open-drain;

			fan53870@35 {
				compatible = "mediatek,fan53870";
				phandle = <0x79>;
				reg = <0x35>;
				status = "okay";
			};
		};
	};

	fragment@49 {
		target = <0xffffffff>;

		__overlay__ {
			GPIO_FDD_BAND_SUPPORT_DETECT_1ST_PIN = <0xffffffff 0xa6 0x0>;
			GPIO_FDD_BAND_SUPPORT_DETECT_2ND_PIN = <0xffffffff 0xa7 0x0>;
			GPIO_FDD_BAND_SUPPORT_DETECT_3RD_PIN = <0xffffffff 0xa8 0x0>;
			GPIO_FDD_BAND_SUPPORT_DETECT_4TH_PIN = <0xffffffff 0xa9 0x0>;
			GPIO_RF_PWREN_RST_PIN = <0xffffffff 0xab 0x0>;
			GPIO_SIM1_HOT_PLUG = <0xffffffff 0x4d 0x0>;
			GPIO_SIM1_SCLK = <0xffffffff 0x7c 0x0>;
			GPIO_SIM1_SIO = <0xffffffff 0x7a 0x0>;
			GPIO_SIM1_SRST = <0xffffffff 0x7b 0x0>;
			GPIO_SIM2_SCLK = <0xffffffff 0x77 0x0>;
			GPIO_SIM2_SIO = <0xffffffff 0x79 0x0>;
			GPIO_SIM2_SRST = <0xffffffff 0x78 0x0>;
		};
	};

	fragment@5 {
		target = <0xffffffff>;

		__overlay__ {

			volume_down@0 {
				phandle = <0x2>;

				pins_cmd_dat {
					input-enable;
					pinmux = <0x5000>;
					slew-rate = <0x0>;
				};
			};

			volume_up@0 {
				phandle = <0x1>;

				pins_cmd_dat {
					input-enable;
					pinmux = <0x100>;
					slew-rate = <0x0>;
				};
			};
		};
	};

	fragment@50 {
		target = <0xffffffff>;

		__overlay__ {
			gpio_init_default = <0x0 0x0 0x0 0x0 0x1 0x0 0x1 0x1 0x0 0x0 0x0 0x1 0x1 0x1 0x2 0x0 0x0 0x0 0x1 0x1 0x1 0x3 0x0 0x0 0x0 0x1 0x0 0x1 0x4 0x0 0x0 0x0 0x1 0x1 0x1 0x5 0x0 0x0 0x0 0x1 0x0 0x1 0x6 0x0 0x1 0x0 0x1 0x0 0x1 0x7 0x0 0x0 0x0 0x1 0x0 0x1 0x8 0x0 0x1 0x0 0x1 0x0 0x1 0x9 0x0 0x0 0x0 0x1 0x1 0x1 0xa 0x0 0x0 0x0 0x1 0x1 0x1 0xb 0x0 0x1 0x0 0x1 0x0 0x1 0xc 0x2 0x0 0x0 0x1 0x0 0x1 0xd 0x2 0x0 0x0 0x1 0x0 0x1 0xe 0x0 0x0 0x0 0x1 0x1 0x1 0xf 0x0 0x0 0x0 0x1 0x1 0x1 0x10 0x7 0x0 0x0 0x1 0x0 0x1 0x11 0x7 0x0 0x0 0x1 0x0 0x1 0x12 0x7 0x0 0x0 0x1 0x0 0x1 0x13 0x7 0x0 0x0 0x1 0x0 0x1 0x14 0x1 0x0 0x0 0x0 0x0 0x1 0x15 0x1 0x0 0x0 0x0 0x0 0x1 0x16 0x1 0x0 0x0 0x1 0x0 0x1 0x17 0x1 0x0 0x0 0x1 0x1 0x1 0x18 0x2 0x0 0x0 0x0 0x0 0x1 0x19 0x2 0x0 0x0 0x0 0x0 0x1 0x1a 0x2 0x0 0x0 0x0 0x0 0x1 0x1b 0x2 0x0 0x0 0x1 0x0 0x1 0x1c 0x1 0x0 0x0 0x0 0x0 0x1 0x1d 0x0 0x1 0x0 0x0 0x0 0x1 0x1e 0x1 0x0 0x0 0x0 0x0 0x1 0x1f 0x1 0x0 0x0 0x1 0x1 0x1 0x20 0x0 0x1 0x0 0x1 0x0 0x1 0x21 0x1 0x0 0x0 0x0 0x0 0x1 0x22 0x0 0x1 0x0 0x1 0x0 0x0 0x23 0x1 0x0 0x0 0x1 0x0 0x1 0x24 0x1 0x0 0x0 0x0 0x0 0x1 0x25 0x0 0x0 0x0 0x1 0x0 0x1 0x26 0x0 0x1 0x0 0x1 0x0 0x0 0x27 0x0 0x1 0x0 0x1 0x0 0x1 0x28 0x0 0x1 0x0 0x1 0x0 0x1 0x29 0x0 0x0 0x0 0x1 0x1 0x1 0x2a 0x7 0x0 0x0 0x1 0x0 0x1 0x2b 0x0 0x1 0x1 0x1 0x0 0x1 0x2c 0x7 0x0 0x0 0x1 0x0 0x1 0x2d 0x7 0x0 0x0 0x0 0x0 0x1 0x2e 0x7 0x0 0x0 0x1 0x0 0x1 0x2f 0x7 0x0 0x0 0x1 0x0 0x1 0x30 0x7 0x0 0x0 0x1 0x0 0x1 0x31 0x0 0x1 0x0 0x1 0x0 0x0 0x32 0x0 0x1 0x0 0x1 0x0 0x0 0x33 0x0 0x1 0x0 0x1 0x0 0x0 0x34 0x1 0x0 0x0 0x0 0x0 0x0 0x35 0x0 0x1 0x0 0x1 0x0 0x1 0x36 0x0 0x1 0x0 0x1 0x0 0x0 0x37 0x0 0x1 0x0 0x1 0x0 0x1 0x38 0x0 0x1 0x0 0x1 0x0 0x0 0x39 0x0 0x1 0x0 0x1 0x0 0x0 0x3a 0x0 0x1 0x0 0x1 0x0 0x0 0x3b 0x0 0x1 0x0 0x1 0x0 0x0 0x3c 0x0 0x1 0x0 0x1 0x0 0x0 0x3d 0x1 0x0 0x0 0x1 0x1 0x0 0x3e 0x1 0x0 0x0 0x0 0x0 0x0 0x3f 0x0 0x1 0x0 0x1 0x0 0x0 0x40 0x0 0x1 0x0 0x1 0x0 0x0 0x48 0x0 0x0 0x0 0x1 0x1 0x1 0x4c 0x0 0x1 0x0 0x1 0x0 0x1 0x4d 0x1 0x0 0x0 0x1 0x1 0x1 0x4e 0x0 0x0 0x0 0x1 0x0 0x1 0x4f 0x1 0x0 0x0 0x1 0x1 0x1 0x50 0x1 0x0 0x0 0x1 0x1 0x1 0x51 0x3 0x0 0x0 0x1 0x0 0x1 0x52 0x0 0x1 0x0 0x1 0x0 0x1 0x53 0x1 0x0 0x0 0x0 0x0 0x1 0x54 0x1 0x0 0x0 0x1 0x0 0x1 0x55 0x1 0x0 0x0 0x0 0x0 0x1 0x56 0x0 0x1 0x0 0x1 0x0 0x1 0x57 0x2 0x0 0x0 0x1 0x0 0x1 0x58 0x0 0x0 0x0 0x1 0x0 0x1 0x59 0x0 0x0 0x0 0x1 0x0 0x1 0x5a 0x1 0x0 0x0 0x0 0x0 0x1 0x5b 0x0 0x1 0x0 0x1 0x0 0x1 0x5c 0x0 0x1 0x0 0x1 0x0 0x1 0x5d 0x0 0x1 0x0 0x1 0x0 0x1 0x5e 0x0 0x1 0x0 0x1 0x0 0x1 0x5f 0x1 0x0 0x0 0x1 0x0 0x1 0x60 0x1 0x0 0x0 0x1 0x0 0x1 0x61 0x2 0x0 0x0 0x1 0x0 0x1 0x62 0x2 0x0 0x0 0x1 0x0 0x1 0x63 0x2 0x0 0x0 0x1 0x1 0x1 0x64 0x2 0x0 0x0 0x1 0x1 0x1 0x65 0x1 0x0 0x0 0x1 0x1 0x1 0x66 0x1 0x0 0x0 0x1 0x1 0x1 0x67 0x1 0x0 0x0 0x1 0x1 0x1 0x68 0x1 0x0 0x0 0x1 0x1 0x1 0x69 0x1 0x0 0x0 0x1 0x1 0x1 0x6a 0x1 0x0 0x0 0x1 0x1 0x1 0x6b 0x1 0x0 0x0 0x1 0x1 0x1 0x6c 0x1 0x0 0x0 0x1 0x1 0x1 0x6d 0x1 0x0 0x0 0x1 0x1 0x1 0x6e 0x1 0x0 0x0 0x1 0x1 0x1 0x6f 0x1 0x0 0x0 0x1 0x1 0x1 0x70 0x1 0x0 0x0 0x1 0x1 0x1 0x71 0x1 0x0 0x0 0x1 0x1 0x1 0x72 0x1 0x0 0x0 0x1 0x1 0x1 0x73 0x1 0x0 0x0 0x0 0x0 0x1 0x74 0x1 0x0 0x0 0x0 0x0 0x1 0x75 0x1 0x0 0x0 0x0 0x0 0x1 0x76 0x1 0x0 0x0 0x0 0x0 0x1 0x77 0x1 0x0 0x0 0x0 0x0 0x1 0x78 0x1 0x0 0x0 0x0 0x0 0x1 0x79 0x1 0x0 0x0 0x1 0x1 0x1 0x7a 0x1 0x0 0x0 0x1 0x1 0x1 0x7b 0x1 0x0 0x0 0x0 0x0 0x1 0x7c 0x1 0x0 0x0 0x0 0x0 0x1 0x7d 0x1 0x0 0x0 0x0 0x0 0x1 0x7e 0x1 0x0 0x0 0x1 0x1 0x1 0x7f 0x1 0x0 0x0 0x1 0x1 0x1 0x80 0x0 0x1 0x0 0x1 0x0 0x1 0x81 0x1 0x0 0x0 0x1 0x1 0x1 0x82 0x1 0x0 0x0 0x1 0x1 0x1 0x83 0x0 0x1 0x0 0x1 0x0 0x1 0x84 0x0 0x1 0x0 0x1 0x0 0x1 0x85 0x0 0x1 0x0 0x1 0x0 0x1 0x86 0x0 0x1 0x0 0x1 0x0 0x1 0x87 0x0 0x1 0x0 0x1 0x0 0x1 0x88 0x0 0x1 0x0 0x1 0x0 0x1 0x89 0x0 0x1 0x0 0x0 0x0 0x1 0x8a 0x0 0x1 0x0 0x0 0x0 0x1 0x8b 0x0 0x1 0x0 0x1 0x0 0x1 0x8c 0x0 0x1 0x1 0x1 0x0 0x1 0x8d 0x1 0x0 0x0 0x1 0x1 0x1 0x8e 0x1 0x0 0x0 0x1 0x1 0x1 0x8f 0x1 0x0 0x0 0x0 0x0 0x1 0x90 0x1 0x0 0x0 0x0 0x0 0x1 0x91 0x1 0x0 0x0 0x0 0x0 0x1 0x92 0x1 0x0 0x0 0x0 0x0 0x1 0x93 0x1 0x0 0x0 0x0 0x0 0x1 0x94 0x1 0x0 0x0 0x0 0x0 0x1 0x95 0x1 0x0 0x0 0x1 0x0 0x1 0x96 0x1 0x0 0x0 0x1 0x0 0x1 0x97 0x1 0x0 0x0 0x1 0x0 0x1 0x98 0x1 0x0 0x0 0x0 0x0 0x1 0x99 0x1 0x0 0x0 0x0 0x0 0x1 0x9a 0x1 0x0 0x0 0x0 0x0 0x1 0x9b 0x1 0x0 0x0 0x0 0x0 0x1 0x9c 0x1 0x0 0x0 0x0 0x0 0x1 0x9d 0x1 0x0 0x0 0x0 0x0 0x1 0x9e 0x1 0x0 0x0 0x0 0x0 0x1 0x9f 0x1 0x0 0x0 0x1 0x0 0x1 0xa0 0x1 0x0 0x0 0x1 0x0 0x1 0xa1 0x1 0x0 0x0 0x1 0x0 0x1 0xa2 0x1 0x0 0x0 0x0 0x0 0x0 0xa3 0x1 0x0 0x0 0x1 0x0 0x0 0xa4 0x1 0x0 0x0 0x1 0x0 0x1 0xa5 0x1 0x0 0x0 0x1 0x0 0x1 0xa6 0x0 0x0 0x0 0x1 0x0 0x0 0xa7 0x0 0x0 0x0 0x1 0x0 0x0 0xa8 0x0 0x0 0x0 0x1 0x0 0x0 0xa9 0x0 0x0 0x0 0x1 0x0 0x0 0xaa 0x1 0x0 0x0 0x0 0x0 0x1 0xab 0x0 0x1 0x1 0x1 0x0 0x1 0xac 0x1 0x0 0x0 0x0 0x0 0x1 0xad 0x1 0x0 0x0 0x0 0x0 0x1 0xae 0x1 0x0 0x0 0x0 0x0 0x1 0xaf 0x1 0x0 0x0 0x0 0x0 0x1 0xb0 0x1 0x0 0x0 0x0 0x0 0x1 0xb1 0x1 0x0 0x0 0x0 0x0 0x1 0xb2 0x1 0x0 0x0 0x0 0x0 0x1 0xb3 0x1 0x0 0x0 0x0 0x0 0x1 0xb4 0x1 0x0 0x0 0x0 0x0 0x1 0xb5 0x1 0x0 0x0 0x0 0x0 0x1 0xb6 0x1 0x0 0x0 0x0 0x0 0x1 0xb7 0x1 0x0 0x0 0x0 0x0 0x1 0xb8 0x1 0x0 0x0 0x0 0x0 0x1 0xb9 0x1 0x0 0x0 0x0 0x0 0x1 0xba 0x1 0x0 0x0 0x0 0x0 0x1 0xbb 0x1 0x0 0x0 0x0 0x0 0x1 0xbc 0x1 0x0 0x0 0x0 0x0 0x0 0xbd 0x1 0x0 0x0 0x1 0x0 0x0 0xbe 0x1 0x0 0x0 0x0 0x0 0x0 0xbf 0x1 0x0 0x0 0x1 0x0 0x0 0xc0 0x0 0x0 0x0 0x1 0x0 0x1 0xc1 0x0 0x0 0x0 0x1 0x0 0x1 0xc2 0x0 0x0 0x0 0x1 0x0 0x1 0xc3 0x0 0x0 0x0 0x1 0x0 0x1 0xc4 0x0 0x0 0x0 0x1 0x0 0x1 0xc5 0x0 0x0 0x0 0x1 0x0 0x1 0xc6 0x0 0x0 0x0 0x1 0x0 0x1 0xc7 0x0 0x0 0x0 0x1 0x0 0x1 0xc8 0x0 0x0 0x0 0x1 0x0 0x1 0xc9 0x0 0x0 0x0 0x1 0x0 0x1 0xca 0x0 0x0 0x0 0x1 0x0 0x1 0xcb 0x0 0x0 0x0 0x1 0x0 0x0 0xcc 0x0 0x0 0x0 0x1 0x0 0x0 0xcd 0x0 0x0 0x0 0x1 0x0 0x0 0xce 0x0 0x0 0x0 0x1 0x0 0x0 0xcf 0x0 0x0 0x0 0x1 0x0 0x0 0xd0 0x0 0x0 0x0 0x1 0x0 0x0 0xd1 0x0 0x0 0x0 0x1 0x0 0x0 0xd2 0x0 0x0 0x0 0x1 0x0 0x0 0xd3 0x0 0x0 0x0 0x1 0x0 0x0>;
		};
	};

	fragment@51 {
		target = <0xffffffff>;

		__overlay__ {
			deb-gpios = <0xffffffff 0x1 0x0>;
			debounce = <0x7d000>;
			interrupt-parent = <0xffffffff>;
			interrupts = <0x1 0x8>;
			status = "okay";
		};
	};

	fragment@52 {
		target = <0xffffffff>;

		__overlay__ {
			interrupt-parent = <0xffffffff>;
			interrupts = <0x5 0x4>;
			status = "okay";
		};
	};

	fragment@53 {
		target = <0xffffffff>;

		__overlay__ {
			interrupt-parent = <0xffffffff>;
			interrupts = <0x7 0x1>;
			status = "okay";
		};
	};

	fragment@54 {
		target = <0xffffffff>;

		__overlay__ {
			interrupt-parent = <0xffffffff>;
			interrupts = <0x9 0x2>;
			status = "okay";
		};
	};

	fragment@55 {
		target = <0xffffffff>;

		__overlay__ {
			interrupt-parent = <0xffffffff>;
			interrupts = <0xa 0x2>;
			status = "okay";
		};
	};

	fragment@56 {
		target = <0xffffffff>;

		__overlay__ {
			deb-gpios = <0xffffffff 0x48 0x0>;
			interrupt-parent = <0xffffffff>;
			interrupts = <0x48 0x4>;
			status = "okay";
		};
	};

	fragment@57 {
		target = <0xffffffff>;

		__overlay__ {
			interrupt-parent = <0xffffffff>;
			interrupts = <0x54 0x1>;
			status = "okay";
		};
	};

	fragment@58 {
		target = <0xffffffff>;

		__overlay__ {
			compatible = "mediatek,md1_sim1_hot_plug_eint-eint";
			debounce = <0x0 0xc350>;
			dedicated = <0x0 0x0>;
			interrupts = <0x0 0x8>;
			sockettype = <0x0 0x0>;
			src_pin = <0x0 0x1>;
			status = "okay";
		};
	};

	fragment@59 {
		target = <0xffffffff>;

		__overlay__ {
			regulator-default-on = <0x0>;
			regulator-name = "vcamio";
			status = "okay";
		};
	};

	fragment@6 {
		target = <0xffffffff>;

		__overlay__ {
			compatible = "mediatek,snd_audio_dsp";
			mtk_dsp_a2dp = <0x0 0xffffffff 0xffffffff 0xffffffff 0x40000>;
			mtk_dsp_call_final = <0x1 0x4 0x10 0x14 0x18000>;
			mtk_dsp_capture1 = <0x1 0xffffffff 0xd 0x13 0x20000>;
			mtk_dsp_dataprovider = <0x0 0xffffffff 0xf 0xffffffff 0x30000>;
			mtk_dsp_deep = <0x5 0x3 0xffffffff 0xffffffff 0x30000>;
			mtk_dsp_fast = <0x5 0x2 0xffffffff 0xffffffff 0x5000>;
			mtk_dsp_ktv = <0x1 0x8 0x12 0xffffffff 0x10000>;
			mtk_dsp_music = <0x1 0xffffffff 0xffffffff 0xffffffff 0x0>;
			mtk_dsp_offload = <0x0 0x6 0xffffffff 0xffffffff 0x400000>;
			mtk_dsp_playback = <0x1 0x4 0x10 0x14 0x30000>;
			mtk_dsp_primary = <0x1f 0x0 0xffffffff 0xffffffff 0x30000>;
			mtk_dsp_ver = <0x1>;
			mtk_dsp_voip = <0x1f 0x1 0xffffffff 0xffffffff 0x30000>;
			swdsp_smartpa_process_enable = <0x1 0x40000>;
		};
	};

	fragment@60 {
		target = <0xffffffff>;

		__overlay__ {
			regulator-default-on = <0x1>;
			regulator-name = "vtp";
			status = "okay";
		};
	};

	fragment@61 {
		target = <0xffffffff>;

		__overlay__ {
			status = "okay";
			vcamio-supply = <0xffffffff>;
		};
	};

	fragment@62 {
		target = <0xffffffff>;

		__overlay__ {
			status = "okay";
			vtouch-supply = <0xffffffff>;
		};
	};

	fragment@63 {
		target = <0xffffffff>;

		__overlay__ {
			mediatek,kpd-hw-dl-key0 = <0x11>;
			mediatek,kpd-hw-dl-key1 = <0x1>;
			mediatek,kpd-hw-dl-key2 = <0x8>;
			mediatek,kpd-hw-factory-key = <0x1>;
			mediatek,kpd-hw-init-map = <0x0 0x72 0x0 0x0 0x0 0x0 0x0 0x0 0x0 0x0 0x0 0x0 0x0 0x0 0x0 0x0 0x0 0x0 0x0 0x0 0x0 0x0 0x0 0x0 0x0 0x0 0x0 0x0 0x0 0x0 0x0 0x0 0x0 0x0 0x0 0x0 0x0 0x0 0x0 0x0 0x0 0x0 0x0 0x0 0x0 0x0 0x0 0x0 0x0 0x0 0x0 0x0 0x0 0x0 0x0 0x0 0x0 0x0 0x0 0x0 0x0 0x0 0x0 0x0 0x0 0x0 0x0 0x0 0x0 0x0 0x0 0x0>;
			mediatek,kpd-hw-map-num = <0x48>;
			mediatek,kpd-hw-pwrkey = <0x8>;
			mediatek,kpd-hw-recovery-key = <0x11>;
			mediatek,kpd-hw-rstkey = <0x11>;
			mediatek,kpd-key-debounce = <0x400>;
			mediatek,kpd-pwkey-gpio-din = <0x0>;
			mediatek,kpd-pwrkey-eint-gpio = <0x0>;
			mediatek,kpd-sw-pwrkey = <0x74>;
			mediatek,kpd-sw-rstkey = <0x73>;
			mediatek,kpd-use-extend-type = <0x0>;
			status = "okay";
		};
	};

	fragment@64 {
		target = <0xffffffff>;

		__overlay__ {

			lcd_bias_enn0_gpio {
				phandle = <0x46>;

				pins_cmd_dat {
					output-low;
					pinmux = <0x8a00>;
					slew-rate = <0x1>;
				};
			};

			lcd_bias_enn1_gpio {
				phandle = <0x45>;

				pins_cmd_dat {
					output-high;
					pinmux = <0x8a00>;
					slew-rate = <0x1>;
				};
			};

			lcd_bias_enp0_gpio {
				phandle = <0x44>;

				pins_cmd_dat {
					output-low;
					pinmux = <0x8900>;
					slew-rate = <0x1>;
				};
			};

			lcd_bias_enp1_gpio {
				phandle = <0x43>;

				pins_cmd_dat {
					output-high;
					pinmux = <0x8900>;
					slew-rate = <0x1>;
				};
			};

			lcm_dsi_te {
				phandle = <0x40>;

				pins_cmd_dat {
					pinmux = <0x5401>;
				};
			};

			lcm_rst_out0_gpio {
				phandle = <0x3f>;

				pins_cmd_dat {
					output-low;
					pinmux = <0x5600>;
					slew-rate = <0x1>;
				};
			};

			lcm_rst_out1_gpio {
				phandle = <0x3e>;

				pins_cmd_dat {
					output-high;
					pinmux = <0x5600>;
					slew-rate = <0x1>;
				};
			};
		};
	};

	fragment@65 {
		target = <0xffffffff>;

		__overlay__ {
			pinctrl-0 = <0x3e>;
			pinctrl-1 = <0x3f>;
			pinctrl-2 = <0x40>;
			pinctrl-names = "lcm_rst_out1_gpio", "lcm_rst_out0_gpio", "mode_te_te";
			status = "okay";
		};
	};

	fragment@66 {
		target = <0xffffffff>;

		__overlay__ {
			#address-cells = <0x1>;
			#size-cells = <0x0>;
			status = "okay";
			switch_fps = <0x0>;

			panel1@0 {
				bias-gpios = <0xffffffff 0x89 0x0 0xffffffff 0x8a 0x0>;
				compatible = "jdi,nt36672c,dphy,vdo";
				lcd-1p8-gpios = <0xffffffff 0x88 0x0>;
				pinctrl-names = "default";
				pm-enable-gpios = <0xffffffff 0x29 0x0>;
				reg = <0x0>;
				reset-gpios = <0xffffffff 0x56 0x0>;

				port {

					endpoint {
						phandle = <0x42>;
						remote-endpoint = <0x41>;
					};
				};
			};

			panel2@0 {
				bias-gpios = <0xffffffff 0x89 0x0 0xffffffff 0x8a 0x0>;
				compatible = "boe,hlt,b8,nt35625b,dphy,vdo";
				lcd-1p8-gpios = <0xffffffff 0x88 0x0>;
				pinctrl-names = "default";
				pm-enable-gpios = <0xffffffff 0x29 0x0>;
				reg = <0x1>;
				reset-gpios = <0xffffffff 0x56 0x0>;

				port {

					endpoint {
						phandle = <0x7a>;
						remote-endpoint = <0x41>;
					};
				};
			};

			ports {

				port {

					endpoint {
						phandle = <0x41>;
						remote-endpoint = <0x42>;
					};
				};
			};
		};
	};

	fragment@67 {
		target = <0xffffffff>;

		__overlay__ {
			pinctrl-0 = <0x43>;
			pinctrl-1 = <0x44>;
			pinctrl-2 = <0x45>;
			pinctrl-3 = <0x46>;
			pinctrl-4 = <0x3e>;
			pinctrl-5 = <0x3f>;
			pinctrl-6 = <0x40>;
			pinctrl-names = "lcd_bias_enp1_gpio", "lcd_bias_enp0_gpio", "lcd_bias_enn1_gpio", "lcd_bias_enn0_gpio", "lcm_rst_out1_gpio", "lcm_rst_out0_gpio", "mode_te_te";
			status = "okay";
		};
	};

	fragment@68 {
		target = <0xffffffff>;

		__overlay__ {
			accdet-mic-mode = <0x2>;
			accdet-mic-vol = <0x8>;
			accdet-plugout-debounce = <0x1>;
			eint_detect_mode = <0x5>;
			eint_use_ext_res = <0x0>;
			headset-four-key-threshold = <0x0 0x3a 0x79 0xc0 0x190>;
			headset-mode-setting = <0x500 0x500 0x1 0x1f0 0x2000 0x800 0x2000 0x44 0x0 0x7 0x5 0x9 0x9 0xd 0xe>;
			headset-three-key-threshold = <0x0 0x52 0xaa 0x132>;
			headset-three-key-threshold-CDD = <0x0 0x79 0xc0 0x258>;
			moisture-external-r = <0x1e8480>;
			moisture-internal-r = <0xb798>;
			moisture-water-r = <0x2710>;
			moisture_comp_vref2 = <0x2>;
			moisture_comp_vth = <0x2>;
			moisture_detect_enable = <0x1>;
			moisture_detect_mode = <0x5>;
			moisture_use_ext_res = <0x0>;
			status = "okay";
		};
	};

	fragment@69 {
		target = <0xffffffff>;

		__overlay__ {
			pinctrl-0 = <0x47>;
			pinctrl-1 = <0x48>;
			pinctrl-names = "irtx_gpio_led_default", "irtx_gpio_led_set";
			status = "okay";
		};
	};

	fragment@7 {
		target = <0xffffffff>;

		__overlay__ {
			mt6360,intr_gpio = <0xffffffff 0xa 0x0>;
			mt6360,intr_gpio_num = <0xa>;
		};
	};

	fragment@70 {
		target = <0xffffffff>;

		__overlay__ {

			irtx_gpio_led_def@gpio57 {
				phandle = <0x47>;

				pins_cmd_dat {
					bias-disable;
					input-schmitt-enable = <0x0>;
					output-low;
					pinmux = <0x3900>;
					slew-rate = <0x1>;
				};
			};

			irtx_gpio_led_set@gpio57 {
				phandle = <0x48>;

				pins_cmd_dat {
					output-high;
					pinmux = <0x3907>;
					slew-rate = <0x1>;
				};
			};
		};
	};

	fragment@71 {
		target = <0xffffffff>;

		__overlay__ {
			oppo,fp_gpio = <0x29>;
			oppo,fp_gpio_id = <0xffffffff 0x29 0x0>;
			pinctrl-0 = <0x49>;
			pinctrl-names = "default";

			silead_capacity {
				chip-name = "S_6150";
				eng-menu = "-1,-1";
				oppo,fp-id = <0x0>;
				vendor-chip = <0x12>;
			};
		};
	};

	fragment@72 {
		target = <0xffffffff>;

		__overlay__ {

			gpio_id0_default {
				phandle = <0x49>;

				pins_cmd_dat {
					bias-pull-up = <0x0>;
					input-enable;
					pinmux = <0x2900>;
					slew-rate = <0x0>;
				};
			};
		};
	};

	fragment@73 {
		target = <0xffffffff>;

		__overlay__ {
			#address-cells = <0x1>;
			#size-cells = <0x0>;
			status = "okay";

			fingerprint@0 {
				compatible = "sil,silead-fp";
				phandle = <0x7b>;
				reg = <0x0>;
				spi-id = <0x5>;
				spi-irq = <0x27>;
				spi-max-frequency = <0x7a1200>;
				spi-reg = <0xa822f8>;
				status = "okay";
			};
		};
	};

	fragment@74 {
		target = <0xffffffff>;

		__overlay__ {

			fp_default {
				phandle = <0x4e>;

				pins_cmd1_dat {
					bias-pull-down = <0x0>;
					pinmux = <0x1c01>;
					slew-rate = <0x1>;
				};

				pins_cmd2_dat {
					bias-pull-down = <0x0>;
					pinmux = <0x1f01>;
					slew-rate = <0x0>;
				};

				pins_cmd3_dat {
					bias-pull-down = <0x0>;
					pinmux = <0x1e01>;
					slew-rate = <0x1>;
				};

				pins_cmd_dat {
					bias-pull-up = <0x0>;
					pinmux = <0x1d01>;
					slew-rate = <0x1>;
				};
			};
		};
	};

	fragment@75 {
		target = <0xffffffff>;

		__overlay__ {
			pinctrl-0 = <0x4a>;
			pinctrl-1 = <0x4b>;
			pinctrl-2 = <0x4c>;
			pinctrl-3 = <0x4d>;
			pinctrl-4 = <0x4e>;
			pinctrl-5 = <0x4f>;
			pinctrl-names = "default", "rst-low", "rst-high", "irq-init", "spi-default", "irq_low";
			status = "okay";
		};
	};

	fragment@76 {
		target = <0xffffffff>;

		__overlay__ {

			fp_eint@7 {
				phandle = <0x4d>;

				pins_cmd_dat {
					bias-pull-down = <0x0>;
					pinmux = <0x700>;
					slew-rate = <0x0>;
				};
			};

			silfp_irq_low {
				phandle = <0x4f>;

				pins_cmd_dat {
					output-low;
					pinmux = <0x700>;
					slew-rate = <0x1>;
				};
			};

			silfpdefault {
				phandle = <0x4a>;
			};

			state_reset_high {
				phandle = <0x4c>;

				pins_cmd_dat {
					output-high;
					pinmux = <0x600>;
					slew-rate = <0x1>;
				};
			};

			state_reset_low {
				phandle = <0x4b>;

				pins_cmd_dat {
					output-low;
					pinmux = <0x600>;
					slew-rate = <0x1>;
				};
			};
		};
	};

	fragment@77 {
		target = <0xffffffff>;

		__overlay__ {

			power_helper {
				compatible = "oplus,power-helper";
			};
		};
	};

	fragment@8 {
		target = <0xffffffff>;

		__overlay__ {
			pwr_off_seq = <0x4000002>;
		};
	};

	fragment@9 {
		target = <0xffffffff>;

		__overlay__ {
			mt6360pd,intr_gpio = <0xffffffff 0x9 0x0>;
			mt6360pd,intr_gpio_num = <0x9>;
		};
	};
};
