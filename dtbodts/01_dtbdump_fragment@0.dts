/dts-v1/;

/ {

	__fixups__ {
		accdet = "/fragment@24:target:0";
		apuart0 = "/fragment@59:target:0";
		auxadc = "/fragment@5/__overlay__/oppo_devinfo:io-channels:0", "/fragment@52/__overlay__:io-channels:0", "/fragment@52/__overlay__:io-channels:8", "/fragment@52/__overlay__:io-channels:16", "/fragment@65:target:0", "/fragment@66/__overlay__:io-channels:0";
		bat_gm30 = "/fragment@23:target:0";
		charger = "/fragment@52:target:0";
		chosen = "/fragment@3:target:0";
		dbmdx = "/fragment@62:target:0";
		dispsys_config = "/fragment@22:target:0";
		dsi0 = "/fragment@47:target:0";
		dsi_te = "/fragment@86:target:0";
		flashlights_mt6360 = "/fragment@13:target:0";
		goodix_fp = "/fragment@34:target:0";
		gpio = "/fragment@79:target:0";
		gpio_usage_mapping = "/fragment@78:target:0";
		gps = "/fragment@41:target:0";
		i2c0 = "/fragment@8:target:0", "/fragment@42:target:0", "/fragment@68:target:0";
		i2c1 = "/fragment@69:target:0";
		i2c2 = "/fragment@9:target:0", "/fragment@12:target:0", "/fragment@70:target:0";
		i2c3 = "/fragment@16:target:0", "/fragment@71:target:0";
		i2c4 = "/fragment@10:target:0", "/fragment@11:target:0", "/fragment@72:target:0";
		i2c5 = "/fragment@73:target:0";
		i2c6 = "/fragment@14:target:0", "/fragment@74:target:0";
		i2c7 = "/fragment@54:target:0", "/fragment@56:target:0", "/fragment@75:target:0";
		i2c8 = "/fragment@17:target:0", "/fragment@76:target:0";
		i2c9 = "/fragment@53:target:0", "/fragment@77:target:0";
		irq_nfc = "/fragment@81:target:0";
		irtx_pwm = "/fragment@26:target:0";
		kd_camera_hw1 = "/fragment@46:target:0", "/fragment@91:target:0";
		keypad = "/fragment@6:target:0", "/fragment@93:target:0";
		lk_charger = "/fragment@48:target:0";
		md1_sim1_hot_plug_eint = "/fragment@88:target:0";
		md_auxadc = "/fragment@66:target:0";
		mmc0 = "/fragment@4:target:0";
		mmc_fixed_1v8_io = "/fragment@1:target:0", "/fragment@4/__overlay__:vqmmc-supply:0";
		mmc_fixed_3v3 = "/fragment@0:target:0", "/fragment@4/__overlay__:vmmc-supply:0";
		mrdump_ext_rst = "/fragment@80:target:0";
		mt6360_ldo = "/fragment@31:target:0";
		mt6360_pmic = "/fragment@29:target:0";
		mt6360_pmu = "/fragment@28:target:0";
		mt6360_typec = "/fragment@30:target:0", "/fragment@51:target:0";
		mt_pmic_vcamio_ldo_reg = "/fragment@46/__overlay__:cam0_vcamio-supply:0", "/fragment@46/__overlay__:cam1_vcamio-supply:0", "/fragment@46/__overlay__:cam2_vcamio-supply:0", "/fragment@46/__overlay__:cam3_vcamio-supply:0", "/fragment@46/__overlay__:cam4_vcamio-supply:0", "/fragment@89:target:0", "/fragment@91/__overlay__:vcamio-supply:0", "/fragment@91/__overlay__:vcamio_sub-supply:0", "/fragment@91/__overlay__:vcamio_main2-supply:0", "/fragment@91/__overlay__:vcamio_sub2-supply:0", "/fragment@91/__overlay__:vcamio_main3-supply:0";
		mt_pmic_vfp_ldo_reg = "/fragment@37:target:0";
		mt_pmic_vio28_ldo_reg = "/fragment@38:target:0";
		mt_pmic_vmc_ldo_reg = "/fragment@47/__overlay__/panel1@0:ldo3-supply:0", "/fragment@47/__overlay__/panel2@0:ldo3-supply:0";
		mt_pmic_vmch_ldo_reg = "/fragment@35/__overlay__/fingerprint@0:avdd-supply:0";
		mt_pmic_vtp_ldo_reg = "/fragment@8/__overlay__/s6sy771_20601@48:vdd_2v8-supply:0", "/fragment@8/__overlay__/synaptics_20601@4B:vdd_2v8-supply:0", "/fragment@90:target:0", "/fragment@92/__overlay__:vtouch-supply:0";
		mtkfb = "/fragment@21:target:0";
		odm = "/fragment@5:target:0", "/fragment@49:target:0", "/fragment@63:target:0";
		oppo_fp_common = "/fragment@32:target:0";
		phy_tuning = "/fragment@50:target:0";
		pio = "/fragment@5/__overlay__/kpd_volume_down:interrupt-parent:0", "/fragment@5/__overlay__/oppo_devinfo:Hw,sim_det:0", "/fragment@6/__overlay__:keypad,volume-up:0", "/fragment@6/__overlay__:keypad,volume-down:0", "/fragment@7:target:0", "/fragment@8/__overlay__/s6sy771_20601@48:interrupt-parent:0", "/fragment@8/__overlay__/s6sy771_20601@48:irq-gpio:0", "/fragment@8/__overlay__/s6sy771_20601@48:reset-gpio:0", "/fragment@8/__overlay__/synaptics_20601@4B:interrupt-parent:0", "/fragment@8/__overlay__/synaptics_20601@4B:irq-gpio:0", "/fragment@8/__overlay__/synaptics_20601@4B:reset-gpio:0", "/fragment@14/__overlay__/tfa98xx@34:reset-gpio:0", "/fragment@14/__overlay__/tfa98xx@35:reset-gpio:0", "/fragment@14/__overlay__/fsa4480@42:fsa4480,hs-det-gpio:0", "/fragment@15:target:0", "/fragment@16/__overlay__/nfc_nxp@28:nxp,pn544-irq:0", "/fragment@16/__overlay__/nfc_nxp@28:nxp,pn544-ven:0", "/fragment@16/__overlay__/nfc_nxp@28:nxp,pn544-fw-dwnld:0", "/fragment@16/__overlay__/nfc_nxp@28:nxp,pn544-clkreq:0", "/fragment@16/__overlay__/nfc_nxp@28:interrupt-parent:0", "/fragment@16/__overlay__/nfc_st21@8:gpio-irq-std:0", "/fragment@16/__overlay__/nfc_st21@8:gpio-rst-std:0", "/fragment@16/__overlay__/nfc_st21@8:gpio-clkreq-std:0", "/fragment@18/__overlay__/st54spi@5:gpio-power-std:0", "/fragment@19:target:0", "/fragment@20:target:0", "/fragment@27:target:0", "/fragment@28/__overlay__:mt6360,intr_gpio:0", "/fragment@30/__overlay__:mt6360pd,intr_gpio:0", "/fragment@33:target:0", "/fragment@34/__overlay__:goodix,gpio_irq:0", "/fragment@34/__overlay__:goodix,gpio_reset:0", "/fragment@34/__overlay__:goodix,gpio_cs:0", "/fragment@36:target:0", "/fragment@39:target:0", "/fragment@40:target:0", "/fragment@43:target:0", "/fragment@44:target:0", "/fragment@45:target:0", "/fragment@47/__overlay__/panel1@0:pm-enable-gpios:0", "/fragment@47/__overlay__/panel1@0:reset-gpios:0", "/fragment@47/__overlay__/panel1@0:bias-gpio:0", "/fragment@47/__overlay__/panel2@0:pm-enable-gpios:0", "/fragment@47/__overlay__/panel2@0:reset-gpios:0", "/fragment@47/__overlay__/panel2@0:bias-gpio:0", "/fragment@52/__overlay__:qcom,chargerid_switch-gpio:0", "/fragment@52/__overlay__:qcom,ship-gpio:0", "/fragment@52/__overlay__:qcom,dischg-gpio:0", "/fragment@52/__overlay__:qcom,chgvin:0", "/fragment@52/__overlay__:qcom,ccdetect-gpio:0", "/fragment@53/__overlay__/aw8697_haptic@5A:reset-gpio:0", "/fragment@53/__overlay__/aw8697_haptic@5A:irq-gpio:0", "/fragment@55:target:0", "/fragment@56/__overlay__/mp2650-charger@5c:qcom,mps_otg_en-gpio:0", "/fragment@56/__overlay__/rk826_fastcg@0a:qcom,charging_switch1-gpio:0", "/fragment@56/__overlay__/rk826_fastcg@0a:qcom,charging_switch1_ctr1-gpio:0", "/fragment@56/__overlay__/rk826_fastcg@0a:qcom,charging_reset-gpio:0", "/fragment@56/__overlay__/rk826_fastcg@0a:qcom,charging_clock-gpio:0", "/fragment@56/__overlay__/rk826_fastcg@0a:qcom,charging_data-gpio:0", "/fragment@56/__overlay__/rk826_fastcg@0a:qcom,vooc_asic_id-gpio:0", "/fragment@57:target:0", "/fragment@58:target:0", "/fragment@60:target:0", "/fragment@62/__overlay__:reset-gpio:0", "/fragment@62/__overlay__:sv-gpio:0", "/fragment@62/__overlay__:wakeup-gpio:0", "/fragment@62/__overlay__:ldo-gpio:0", "/fragment@78/__overlay__:GPIO_SIM1_HOT_PLUG:0", "/fragment@78/__overlay__:GPIO_SIM2_SCLK:0", "/fragment@78/__overlay__:GPIO_SIM2_SRST:0", "/fragment@78/__overlay__:GPIO_SIM2_SIO:0", "/fragment@78/__overlay__:GPIO_SIM1_SIO:0", "/fragment@78/__overlay__:GPIO_SIM1_SRST:0", "/fragment@78/__overlay__:GPIO_SIM1_SCLK:0", "/fragment@78/__overlay__:GPIO_FDD_BAND_SUPPORT_DETECT_1ST_PIN:0", "/fragment@78/__overlay__:GPIO_FDD_BAND_SUPPORT_DETECT_2ND_PIN:0", "/fragment@78/__overlay__:GPIO_FDD_BAND_SUPPORT_DETECT_3RD_PIN:0", "/fragment@78/__overlay__:GPIO_FDD_BAND_SUPPORT_DETECT_4TH_PIN:0", "/fragment@80/__overlay__:interrupt-parent:0", "/fragment@80/__overlay__:deb-gpios:0", "/fragment@81/__overlay__:interrupt-parent:0", "/fragment@82/__overlay__:interrupt-parent:0", "/fragment@83/__overlay__:interrupt-parent:0", "/fragment@84/__overlay__:interrupt-parent:0", "/fragment@85/__overlay__:interrupt-parent:0", "/fragment@86/__overlay__:interrupt-parent:0", "/fragment@87/__overlay__:interrupt-parent:0", "/fragment@87/__overlay__:deb-gpios:0";
		pmic_clock_buffer_ctrl = "/fragment@67:target:0";
		reserved_memory = "/fragment@2:target:0";
		smart_pa = "/fragment@85:target:0";
		sound = "/fragment@25:target:0";
		spi1 = "/fragment@35:target:0";
		spi4 = "/fragment@61:target:0";
		spi5 = "/fragment@18:target:0";
		subpmic_pmu_eint = "/fragment@83:target:0";
		swtp = "/fragment@64:target:0", "/fragment@87:target:0";
		tcpc_pd = "/fragment@84:target:0";
		touch = "/fragment@82:target:0", "/fragment@92:target:0";
	};

	__local_fixups__ {

		fragment@14 {

			__overlay__ {

				fsa4480@42 {
					pinctrl-0 = <0x0>;
				};
			};
		};

		fragment@21 {

			__overlay__ {
				pinctrl-0 = <0x0>;
				pinctrl-1 = <0x0>;
				pinctrl-2 = <0x0>;
				pinctrl-3 = <0x0>;
				pinctrl-4 = <0x0>;
				pinctrl-5 = <0x0>;
				pinctrl-6 = <0x0>;
			};
		};

		fragment@22 {

			__overlay__ {
				pinctrl-0 = <0x0>;
				pinctrl-1 = <0x0>;
				pinctrl-2 = <0x0>;
			};
		};

		fragment@26 {

			__overlay__ {
				pinctrl-0 = <0x0>;
				pinctrl-1 = <0x0>;
			};
		};

		fragment@32 {

			__overlay__ {
				pinctrl-0 = <0x0>;
			};
		};

		fragment@34 {

			__overlay__ {
				pinctrl-0 = <0x0 0x4>;
				pinctrl-1 = <0x0 0x4 0x8 0xc>;
				pinctrl-2 = <0x0>;
			};
		};

		fragment@41 {

			__overlay__ {
				pinctrl-0 = <0x0>;
				pinctrl-1 = <0x0>;
				pinctrl-2 = <0x0>;
				pinctrl-3 = <0x0>;
				pinctrl-4 = <0x0>;
				pinctrl-5 = <0x0>;
				pinctrl-6 = <0x0>;
			};
		};

		fragment@46 {

			__overlay__ {
				cam0_vcama1-supply = <0x0>;
				cam0_vcamaf-supply = <0x0>;
				cam1_vcama-supply = <0x0>;
				cam2_vcama-supply = <0x0>;
				cam3_vcama-supply = <0x0>;
				cam3_vcamd-supply = <0x0>;
				cam4_vcama-supply = <0x0>;
				pinctrl-0 = <0x0>;
				pinctrl-1 = <0x0>;
				pinctrl-10 = <0x0>;
				pinctrl-11 = <0x0>;
				pinctrl-12 = <0x0>;
				pinctrl-13 = <0x0>;
				pinctrl-14 = <0x0>;
				pinctrl-15 = <0x0>;
				pinctrl-16 = <0x0>;
				pinctrl-17 = <0x0>;
				pinctrl-18 = <0x0>;
				pinctrl-19 = <0x0>;
				pinctrl-2 = <0x0>;
				pinctrl-20 = <0x0>;
				pinctrl-21 = <0x0>;
				pinctrl-22 = <0x0>;
				pinctrl-23 = <0x0>;
				pinctrl-24 = <0x0>;
				pinctrl-25 = <0x0>;
				pinctrl-26 = <0x0>;
				pinctrl-27 = <0x0>;
				pinctrl-28 = <0x0>;
				pinctrl-29 = <0x0>;
				pinctrl-3 = <0x0>;
				pinctrl-30 = <0x0>;
				pinctrl-31 = <0x0>;
				pinctrl-32 = <0x0>;
				pinctrl-33 = <0x0>;
				pinctrl-34 = <0x0>;
				pinctrl-35 = <0x0>;
				pinctrl-36 = <0x0>;
				pinctrl-37 = <0x0>;
				pinctrl-38 = <0x0>;
				pinctrl-39 = <0x0>;
				pinctrl-4 = <0x0>;
				pinctrl-40 = <0x0>;
				pinctrl-41 = <0x0>;
				pinctrl-42 = <0x0>;
				pinctrl-43 = <0x0>;
				pinctrl-44 = <0x0>;
				pinctrl-45 = <0x0>;
				pinctrl-5 = <0x0>;
				pinctrl-6 = <0x0>;
				pinctrl-7 = <0x0>;
				pinctrl-8 = <0x0>;
				pinctrl-9 = <0x0>;
			};
		};

		fragment@47 {

			__overlay__ {

				panel1@0 {
					pm8008ldo1-supply = <0x0>;

					port {

						endpoint {
							remote-endpoint = <0x0>;
						};
					};
				};

				panel2@0 {
					pm8008ldo1-supply = <0x0>;

					port {

						endpoint {
							remote-endpoint = <0x0>;
						};
					};
				};

				ports {

					port {

						endpoint {
							remote-endpoint = <0x0>;
						};
					};
				};
			};
		};

		fragment@5 {

			__overlay__ {

				usb_c_pinctrl {
					pinctrl-0 = <0x0>;
					pinctrl-1 = <0x0>;
					pinctrl-10 = <0x0>;
					pinctrl-11 = <0x0>;
					pinctrl-12 = <0x0>;
					pinctrl-2 = <0x0>;
					pinctrl-3 = <0x0>;
					pinctrl-4 = <0x0>;
					pinctrl-5 = <0x0>;
					pinctrl-6 = <0x0>;
					pinctrl-7 = <0x0>;
					pinctrl-8 = <0x0>;
					pinctrl-9 = <0x0>;
				};
			};
		};

		fragment@52 {

			__overlay__ {
				pinctrl-0 = <0x0>;
				pinctrl-1 = <0x0>;
				pinctrl-10 = <0x0>;
				pinctrl-2 = <0x0>;
				pinctrl-3 = <0x0>;
				pinctrl-4 = <0x0>;
				pinctrl-5 = <0x0>;
				pinctrl-6 = <0x0>;
				pinctrl-7 = <0x0>;
				pinctrl-8 = <0x0>;
				pinctrl-9 = <0x0>;
			};
		};

		fragment@53 {

			__overlay__ {

				aw8697_haptic@5A {
					pinctrl-0 = <0x0>;
				};
			};
		};

		fragment@54 {

			__overlay__ {
				pinctrl-0 = <0x0>;
				pinctrl-1 = <0x0>;
			};
		};

		fragment@56 {

			__overlay__ {

				mp2650-charger@5c {
					pinctrl-0 = <0x0>;
					pinctrl-1 = <0x0>;
					pinctrl-2 = <0x0>;
				};

				rk826_fastcg@0a {
					pinctrl-0 = <0x0>;
					pinctrl-1 = <0x0>;
					pinctrl-10 = <0x0>;
					pinctrl-11 = <0x0>;
					pinctrl-12 = <0x0>;
					pinctrl-13 = <0x0>;
					pinctrl-14 = <0x0>;
					pinctrl-15 = <0x0>;
					pinctrl-2 = <0x0>;
					pinctrl-3 = <0x0>;
					pinctrl-4 = <0x0>;
					pinctrl-5 = <0x0>;
					pinctrl-6 = <0x0>;
					pinctrl-7 = <0x0>;
					pinctrl-8 = <0x0>;
					pinctrl-9 = <0x0>;
				};
			};
		};

		fragment@59 {

			__overlay__ {
				pinctrl-0 = <0x0>;
				pinctrl-1 = <0x0>;
			};
		};

		fragment@6 {

			__overlay__ {
				pinctrl-0 = <0x0>;
				pinctrl-1 = <0x0>;
			};
		};

		fragment@62 {

			__overlay__ {
				cd-interfaces = <0x0>;
			};
		};

		fragment@8 {

			__overlay__ {
				pinctrl-0 = <0x0>;
				pinctrl-1 = <0x0>;
				pinctrl-2 = <0x0>;
				pinctrl-3 = <0x0>;
				pinctrl-4 = <0x0>;

				s6sy771_20601@48 {
					pinctrl-0 = <0x0>;
					pinctrl-1 = <0x0>;
				};

				synaptics_20601@4B {
					pinctrl-0 = <0x0>;
					pinctrl-1 = <0x0>;
				};
			};
		};
	};

	__symbols__ {
		L1P = "/fragment@17/__overlay__/qcom,pm8008@9/qcom,pm8008-regulator/qcom,pm8008-l1@4000";
		L2P = "/fragment@17/__overlay__/qcom,pm8008@9/qcom,pm8008-regulator/qcom,pm8008-l2@4100";
		L3P = "/fragment@17/__overlay__/qcom,pm8008@9/qcom,pm8008-regulator/qcom,pm8008-l3@4200";
		L4P = "/fragment@17/__overlay__/qcom,pm8008@9/qcom,pm8008-regulator/qcom,pm8008-l4@4300";
		L5P = "/fragment@17/__overlay__/qcom,pm8008@9/qcom,pm8008-regulator/qcom,pm8008-l5@4400";
		L6P = "/fragment@17/__overlay__/qcom,pm8008@9/qcom,pm8008-regulator/qcom,pm8008-l6@4400";
		L7P = "/fragment@17/__overlay__/qcom,pm8008@9/qcom,pm8008-regulator/qcom,pm8008-l7@4400";
		aw_irq_gpio_default = "/fragment@43/__overlay__/aw_irq_gpio_default";
		bq27411_gauge_mtk = "/fragment@75/__overlay__/bq27411_gauge@55";
		camera0_mclk_2ma = "/fragment@45/__overlay__/camera0_mclk_2ma@gpio150";
		camera0_mclk_4ma = "/fragment@45/__overlay__/camera0_mclk_4ma@gpio150";
		camera0_mclk_6ma = "/fragment@45/__overlay__/camera0_mclk_6ma@gpio150";
		camera0_mclk_8ma = "/fragment@45/__overlay__/camera0_mclk_8ma@gpio150";
		camera0_mclk_off = "/fragment@45/__overlay__/camera0_mclk_gpio_mode@gpio150";
		camera0_rst_high = "/fragment@45/__overlay__/camera0_rst_output_high@gpio144";
		camera0_rst_low = "/fragment@45/__overlay__/camera0_rst_output_low@gpio144";
		camera0_vcama_off = "/fragment@45/__overlay__/camera0_vcama_off";
		camera0_vcama_on = "/fragment@45/__overlay__/camera0_vcama_on";
		camera0_vcamd_off = "/fragment@45/__overlay__/camera0_vcamd_output_low@gpio147";
		camera0_vcamd_on = "/fragment@45/__overlay__/camera0_vcamd_output_high@gpio147";
		camera1_mclk_2ma = "/fragment@45/__overlay__/camera1_mclk_2ma@gpio149";
		camera1_mclk_4ma = "/fragment@45/__overlay__/camera1_mclk_4ma@gpio149";
		camera1_mclk_6ma = "/fragment@45/__overlay__/camera1_mclk_6ma@gpio149";
		camera1_mclk_8ma = "/fragment@45/__overlay__/camera1_mclk_8ma@gpio149";
		camera1_mclk_off = "/fragment@45/__overlay__/camera1_mclk_gpio_mode@gpio149";
		camera1_rst_high = "/fragment@45/__overlay__/camera1_rst_output_high@gpio143";
		camera1_rst_low = "/fragment@45/__overlay__/camera1_rst_output_low@gpio143";
		camera1_vcamd_off = "/fragment@45/__overlay__/camera1_vcamd_output_low@gpio147";
		camera1_vcamd_on = "/fragment@45/__overlay__/camera1_vcamd_output_high@gpio147";
		camera2_mclk_2ma = "/fragment@45/__overlay__/camera2_mclk_2ma@gpio151";
		camera2_mclk_4ma = "/fragment@45/__overlay__/camera2_mclk_4ma@gpio151";
		camera2_mclk_6ma = "/fragment@45/__overlay__/camera2_mclk_6ma@gpio151";
		camera2_mclk_8ma = "/fragment@45/__overlay__/camera2_mclk_8ma@gpio151";
		camera2_mclk_off = "/fragment@45/__overlay__/camera2_mclk_gpio_mode@gpio151";
		camera2_rst_high = "/fragment@45/__overlay__/camera2_rst_output_high@gpio145";
		camera2_rst_low = "/fragment@45/__overlay__/camera2_rst_output_low@gpio145";
		camera2_vcamd_off = "/fragment@45/__overlay__/camera2_vcamd_output_low@gpio146";
		camera2_vcamd_on = "/fragment@45/__overlay__/camera2_vcamd_output_high@gpio146";
		camera3_mclk_2ma = "/fragment@45/__overlay__/camera3_mclk_2ma@gpio136";
		camera3_mclk_4ma = "/fragment@45/__overlay__/camera3_mclk_4ma@gpio136";
		camera3_mclk_6ma = "/fragment@45/__overlay__/camera3_mclk_6ma@gpio136";
		camera3_mclk_8ma = "/fragment@45/__overlay__/camera3_mclk_8ma@gpio136";
		camera3_mclk_off = "/fragment@45/__overlay__/camera3_mclk_gpio_mode@gpio136";
		camera3_rst_high = "/fragment@45/__overlay__/camera3_rst_output_high@gpio130";
		camera3_rst_low = "/fragment@45/__overlay__/camera3_rst_output_low@gpio130";
		camera4_mclk_2ma = "/fragment@45/__overlay__/camera4_mclk_2ma@gpio137";
		camera4_mclk_4ma = "/fragment@45/__overlay__/camera4_mclk_4ma@gpio137";
		camera4_mclk_6ma = "/fragment@45/__overlay__/camera4_mclk_6ma@gpio137";
		camera4_mclk_8ma = "/fragment@45/__overlay__/camera4_mclk_8ma@gpio137";
		camera4_mclk_off = "/fragment@45/__overlay__/camera4_mclk_gpio_mode@gpio137";
		camera4_rst_high = "/fragment@45/__overlay__/camera4_rst_output_high@gpio131";
		camera4_rst_low = "/fragment@45/__overlay__/camera4_rst_output_low@gpio131";
		camera_main_af_mtk = "/fragment@70/__overlay__/camera_main_af@72";
		camera_main_eeprom_mtk = "/fragment@70/__overlay__/camera_main_eeprom@a0";
		camera_main_mtk = "/fragment@70/__overlay__/camera_main@1c";
		camera_main_three_mtk = "/fragment@70/__overlay__/camera_main_three@13";
		camera_main_two_af_mtk = "/fragment@72/__overlay__/camera_main_two_af@0c";
		camera_main_two_eeprom_mtk = "/fragment@72/__overlay__/camera_main_two_eeprom@51";
		camera_main_two_mtk = "/fragment@72/__overlay__/camera_main_two@10";
		camera_pins_default = "/fragment@45/__overlay__/camdefault";
		camera_sub_eeprom_mtk = "/fragment@72/__overlay__/camera_sub_eeprom@54";
		camera_sub_mtk = "/fragment@72/__overlay__/camera_sub@1a";
		camera_sub_two_mtk = "/fragment@72/__overlay__/camera_sub_two@53";
		ccdetect_active = "/fragment@57/__overlay__/ccdetect_active";
		ccdetect_sleep = "/fragment@57/__overlay__/ccdetect_sleep";
		charger_pins_default = "/fragment@57/__overlay__/eint0default";
		charger_pins_eint_output0 = "/fragment@57/__overlay__/charger_gpio_as_output_low";
		charger_pins_eint_output1 = "/fragment@57/__overlay__/charger_gpio_as_output_high";
		charging_clock_active = "/fragment@58/__overlay__/charging_clock_active";
		charging_clock_sleep = "/fragment@58/__overlay__/charging_clock_sleep";
		charging_data_active = "/fragment@58/__overlay__/charging_data_active";
		charging_data_sleep = "/fragment@58/__overlay__/charging_data_sleep";
		charging_reset_active = "/fragment@58/__overlay__/charging_reset_active";
		charging_reset_sleep = "/fragment@58/__overlay__/charging_reset_sleep";
		charging_switch1_active = "/fragment@58/__overlay__/charging_switch1_active";
		charging_switch1_ctr1_active = "/fragment@58/__overlay__/charging_switch1_ctr1_active";
		charging_switch1_ctr1_sleep = "/fragment@58/__overlay__/charging_switch1_ctr1_sleep";
		charging_switch1_sleep = "/fragment@58/__overlay__/charging_switch1_sleep";
		chgvin_disable = "/fragment@57/__overlay__/chgvin_disable";
		chgvin_enable = "/fragment@57/__overlay__/chgvin_enable";
		ctp_pins_default = "/fragment@19/__overlay__/eintdefault";
		ctp_ts_int_active = "/fragment@19/__overlay__/int_active";
		ctp_ts_int_suspend = "/fragment@19/__overlay__/int_suspend";
		ctp_ts_reset_active = "/fragment@19/__overlay__/reset_active";
		ctp_ts_reset_suspend = "/fragment@19/__overlay__/reset_suspend";
		dbmd4_spi = "/fragment@61/__overlay__/dbmd4_interface@0";
		dischg_disable = "/fragment@57/__overlay__/dischg_disable";
		dischg_enable = "/fragment@57/__overlay__/dischg_enable";
		dp_switch_mtk = "/fragment@74/__overlay__/dp_switch@50";
		dsi_out = "/fragment@47/__overlay__/ports/port/endpoint";
		ext_buck_vmddr_mtk = "/fragment@74/__overlay__/ext_buck_vmddr@51";
		ext_buck_vufs12_mtk = "/fragment@14/__overlay__/ext_buck_vufs12@56";
		external_pmic_mtk = "/fragment@76/__overlay__/external_pmic@09";
		fan53870_gpio_disable = "/fragment@45/__overlay__/fan53870_gpio_disable@gpio29";
		fan53870_gpio_enable = "/fragment@45/__overlay__/fan53870_gpio_enable@gpio29";
		fan53870_mtk = "/fragment@76/__overlay__/fan53870@35";
		fsa4480 = "/fragment@14/__overlay__/fsa4480@42";
		fsa_hs_det = "/fragment@15/__overlay__/fsa_hs_det";
		gpio_goodix_clk_6mA = "/fragment@36/__overlay__/gpio_goodix_clk_6mA";
		gpio_goodix_cs_6mA = "/fragment@36/__overlay__/gpio_goodix_cs_6mA";
		gpio_goodix_cs_func = "/fragment@36/__overlay__/gpio_goodix_cs_func";
		gpio_goodix_irq_default = "/fragment@36/__overlay__/gpio_goodix_irq_default";
		gpio_goodix_miso_6mA = "/fragment@36/__overlay__/gpio_goodix_miso_6mA";
		gpio_goodix_mosi_6mA = "/fragment@36/__overlay__/gpio_goodix_mosi_6mA";
		gpio_goodix_reset_default = "/fragment@36/__overlay__/gpio_goodix_reset_default";
		gpio_id0_default = "/fragment@33/__overlay__/gpio_id0_default";
		gpio_redriver_c1_high = "/fragment@39/__overlay__/c1_high";
		gpio_redriver_c1_hiz = "/fragment@39/__overlay__/c1_highz";
		gpio_redriver_c1_init = "/fragment@39/__overlay__/c1_init";
		gpio_redriver_c1_low = "/fragment@39/__overlay__/c1_low";
		gpio_redriver_c2_high = "/fragment@39/__overlay__/c2_high";
		gpio_redriver_c2_hiz = "/fragment@39/__overlay__/c2_highz";
		gpio_redriver_c2_init = "/fragment@39/__overlay__/c2_init";
		gpio_redriver_c2_low = "/fragment@39/__overlay__/c2_low";
		gpio_u3_switch_disable = "/fragment@39/__overlay__/u3_sw_dis";
		gpio_u3_switch_enable = "/fragment@39/__overlay__/u3_sw_en";
		gpio_u3_switch_sel1 = "/fragment@39/__overlay__/u3_sw_sel1";
		gpio_u3_switch_sel2 = "/fragment@39/__overlay__/u3_sw_sel2";
		gps_l1_lna_pins_dsp_ctrl = "/fragment@40/__overlay__/gps_l1_lna@1";
		gps_l1_lna_pins_oh = "/fragment@40/__overlay__/gps_l1_lna@2";
		gps_l1_lna_pins_ol = "/fragment@40/__overlay__/gps_l1_lna@0";
		gps_l5_lna_pins_dsp_ctrl = "/fragment@40/__overlay__/gps_l5_lna@1";
		gps_l5_lna_pins_oh = "/fragment@40/__overlay__/gps_l5_lna@2";
		gps_l5_lna_pins_ol = "/fragment@40/__overlay__/gps_l5_lna@0";
		gps_pins_default = "/fragment@40/__overlay__/gps_default";
		i2c7_i2c_state = "/fragment@55/__overlay__/i2c7_sda_i2c_state";
		i2c7_output_low_state = "/fragment@55/__overlay__/i2c7_sda_output_low_state";
		i2c_lcd_bias_mtk = "/fragment@68/__overlay__/i2c_lcd_bias@3e";
		irtx_gpio_led_default = "/fragment@27/__overlay__/irtx_gpio_led_def@gpio127";
		irtx_gpio_led_set = "/fragment@27/__overlay__/irtx_gpio_led_set@gpio127";
		kpd_volume_down = "/fragment@5/__overlay__/kpd_volume_down";
		led0 = "/fragment@5/__overlay__/led@0";
		led1 = "/fragment@5/__overlay__/led@1";
		led2 = "/fragment@5/__overlay__/led@2";
		led3 = "/fragment@5/__overlay__/led@3";
		led4 = "/fragment@5/__overlay__/led@4";
		led5 = "/fragment@5/__overlay__/led@5";
		led6 = "/fragment@5/__overlay__/led@6";
		mps_otg_en_active = "/fragment@58/__overlay__/mps_otg_en_active";
		mps_otg_en_default = "/fragment@58/__overlay__/mps_otg_en_default";
		mps_otg_en_sleep = "/fragment@58/__overlay__/mps_otg_en_sleep";
		mtk_camera_eeprom0 = "/fragment@9/__overlay__/camera_eeprom0@59";
		mtk_camera_eeprom1 = "/fragment@11/__overlay__/camera_eeprom1@54";
		mtk_camera_eeprom2 = "/fragment@10/__overlay__/camera_eeprom2@51";
		mtk_camera_eeprom4 = "/fragment@12/__overlay__/camera_eeprom4@52";
		mtkfb_pins_lcd_bias_enn0 = "/fragment@20/__overlay__/lcd_bias_enn0_gpio";
		mtkfb_pins_lcd_bias_enn1 = "/fragment@20/__overlay__/lcd_bias_enn1_gpio";
		mtkfb_pins_lcd_bias_enp0 = "/fragment@20/__overlay__/lcd_bias_enp0_gpio";
		mtkfb_pins_lcd_bias_enp1 = "/fragment@20/__overlay__/lcd_bias_enp1_gpio";
		mtkfb_pins_lcm_dsi_te = "/fragment@20/__overlay__/lcm_dsi_te";
		mtkfb_pins_lcm_rst_out0_gpio = "/fragment@20/__overlay__/lcm_rst_out0_gpio";
		mtkfb_pins_lcm_rst_out1_gpio = "/fragment@20/__overlay__/lcm_rst_out1_gpio";
		oppo_devinfo = "/fragment@5/__overlay__/oppo_devinfo";
		oppo_fp = "/fragment@35/__overlay__/fingerprint@0";
		oppo_project = "/fragment@5/__overlay__/oppo_project";
		panel_in = "/fragment@47/__overlay__/panel1@0/port/endpoint";
		panel_in2 = "/fragment@47/__overlay__/panel2@0/port/endpoint";
		pm8008_regulators = "/fragment@17/__overlay__/qcom,pm8008@9/qcom,pm8008-regulator";
		ship_active_gpio = "/fragment@57/__overlay__/ship_active";
		ship_sleep_gpio = "/fragment@57/__overlay__/ship_sleep";
		speaker_amp_mtk = "/fragment@74/__overlay__/speaker_amp@34";
		spidev5 = "/fragment@18/__overlay__/p61@5";
		strobe_main_mtk = "/fragment@71/__overlay__/strobe_main@63";
		subpmic_ldo_mtk = "/fragment@73/__overlay__/subpmic_ldo@64";
		subpmic_mtk = "/fragment@73/__overlay__/subpmic@34";
		subpmic_pmic_mtk = "/fragment@73/__overlay__/subpmic_pmic@1a";
		ts_active = "/fragment@44/__overlay__/ts_active1";
		ts_suspend = "/fragment@44/__overlay__/ts_suspend1";
		uart0_rx_gpio_input = "/fragment@60/__overlay__/uart0_rx_gpio@gpio92";
		uart0_tx_gpio_input = "/fragment@60/__overlay__/uart0_tx_gpio@gpio93";
		usb_c_pinctrl = "/fragment@5/__overlay__/usb_c_pinctrl";
		usb_default = "/fragment@39/__overlay__/usb_default";
		usb_type_c_mtk = "/fragment@73/__overlay__/usb_type_c@4e";
		vibrator0 = "/fragment@5/__overlay__/vibrator@0";
		volume_down_gpio_eint = "/fragment@7/__overlay__/volume_down@0";
		volume_up_gpio_eint = "/fragment@7/__overlay__/volume_up@0";
		vooc_ap_data = "/fragment@49/__overlay__/vooc_ap_data";
		vooc_ap_data_new_function = "/fragment@49/__overlay__/vooc_ap_data_new_function";
		vooc_asic_id_active = "/fragment@58/__overlay__/vooc_asic_id_active";
		vooc_asic_id_sleep = "/fragment@58/__overlay__/vooc_asic_id_sleep";
	};

	fragment@0 {
		target = <0xffffffff>;

		__overlay__ {
			enable-active-high;
			regulator-always-on;
			regulator-max-microvolt = <0x325aa0>;
			regulator-min-microvolt = <0x325aa0>;
			regulator-name = "mmc_power";
			status = "okay";
		};
	};

	fragment@1 {
		target = <0xffffffff>;

		__overlay__ {
			enable-active-high;
			regulator-always-on;
			regulator-max-microvolt = <0x1b7740>;
			regulator-min-microvolt = <0x1b7740>;
			regulator-name = "mmc_io";
			status = "okay";
		};
	};

	fragment@10 {
		target = <0xffffffff>;

		__overlay__ {

			camera_eeprom2@51 {
				compatible = "mediatek,camera_eeprom";
				phandle = <0x93>;
				reg = <0x51>;
				status = "okay";
			};
		};
	};

	fragment@11 {
		target = <0xffffffff>;

		__overlay__ {

			camera_eeprom1@54 {
				compatible = "mediatek,camera_eeprom";
				phandle = <0x94>;
				reg = <0x54>;
				status = "okay";
			};
		};
	};

	fragment@12 {
		target = <0xffffffff>;

		__overlay__ {

			camera_eeprom4@52 {
				compatible = "mediatek,camera_eeprom";
				phandle = <0x95>;
				reg = <0x52>;
				status = "okay";
			};
		};
	};

	fragment@13 {
		target = <0xffffffff>;

		__overlay__ {

			channel@2 {
				ct = <0x1>;
				part = <0x0>;
				type = <0x0>;
			};
		};
	};

	fragment@14 {
		target = <0xffffffff>;

		__overlay__ {

			ext_buck_vufs12@56 {
				compatible = "mediatek,ext_buck_vufs12";
				phandle = <0x96>;
				reg = <0x56>;
				regulator-max-microvolt = <0x13d620>;
				regulator-min-microvolt = <0x493e0>;
				regulator-name = "ext_buck_vufs12";
				status = "okay";
			};

			fsa4480@42 {
				compatible = "qcom,fsa4480-i2c";
				fsa4480,hs-det-gpio = <0xffffffff 0x36 0x0>;
				phandle = <0x97>;
				pinctrl-0 = <0x17>;
				pinctrl-names = "default";
				reg = <0x42>;
			};

			tfa98xx@34 {
				compatible = "nxp,tfa98xx";
				reg = <0x34>;
				reset-gpio = <0xffffffff 0xc1 0x0>;
				status = "okay";
				tfa_max_range = <0x1f40>;
				tfa_min_range = <0x1388>;
			};

			tfa98xx@35 {
				compatible = "nxp,tfa98xx";
				reg = <0x35>;
				reset-gpio = <0xffffffff 0x94 0x0>;
				status = "okay";
				tfa_max_range = <0x1f40>;
				tfa_min_range = <0x1388>;
			};
		};
	};

	fragment@15 {
		target = <0xffffffff>;

		__overlay__ {

			fsa_hs_det {
				phandle = <0x17>;

				pins_cmd_dat {
					output-high;
					pinmux = <0x3600>;
					slew-rate = <0x1>;
				};
			};
		};
	};

	fragment@16 {
		target = <0xffffffff>;

		__overlay__ {
			status = "okay";

			nfc_nxp@28 {
				compatible = "nxp,pn544";
				interrupt-parent = <0xffffffff>;
				nxp,pn544-clkreq = <0xffffffff 0x11 0x0>;
				nxp,pn544-fw-dwnld = <0xffffffff 0x6 0x0>;
				nxp,pn544-irq = <0xffffffff 0x7 0x0>;
				nxp,pn544-ven = <0xffffffff 0x10 0x0>;
				reg = <0x28>;
			};

			nfc_st21@8 {
				compatible = "st,st21nfc";
				gpio-clkreq-std = <0xffffffff 0x11 0x0>;
				gpio-irq-std = <0xffffffff 0x7 0x0>;
				gpio-rst-std = <0xffffffff 0x10 0x0>;
				reg = <0x8>;
			};
		};
	};

	fragment@17 {
		target = <0xffffffff>;

		__overlay__ {
			status = "okay";

			fan53870@35 {
				compatible = "fan53870";
				ldo1_max_vol = <0x16f300>;
				ldo1_min_vol = <0xc3500>;
				ldo1_step_vol = <0x1f40>;
				reg = <0x35>;
			};

			qcom,pm8008@9 {
				#address-cells = <0x1>;
				#size-cells = <0x0>;
				compatible = "mediatek,external_pmic";
				reg = <0x9>;

				qcom,pm8008-regulator {
					compatible = "qcom,pm8008-regulator";
					phandle = <0x98>;

					qcom,pm8008-l1@4000 {
						phandle = <0x63>;
						qcom,hpm-min-load = <0x2710>;
						qcom,min-dropout-voltage = <0x36ee8>;
						reg = [40 00];
						regulator-max-microvolt = <0x16f300>;
						regulator-min-microvolt = <0x124f80>;
						regulator-name = "pm8008_l1";
					};

					qcom,pm8008-l2@4100 {
						phandle = <0x61>;
						qcom,hpm-min-load = <0x2710>;
						qcom,min-dropout-voltage = <0x36ee8>;
						reg = [41 00];
						regulator-max-microvolt = <0x16f300>;
						regulator-min-microvolt = <0x80e80>;
						regulator-name = "pm8008_l2";
					};

					qcom,pm8008-l3@4200 {
						phandle = <0x99>;
						qcom,hpm-min-load = <0x2710>;
						qcom,min-dropout-voltage = <0x30d40>;
						reg = [42 00];
						regulator-max-microvolt = <0x33e140>;
						regulator-min-microvolt = <0x16e360>;
						regulator-name = "pm8008_l3";
					};

					qcom,pm8008-l4@4300 {
						phandle = <0x5f>;
						qcom,hpm-min-load = <0x2710>;
						qcom,min-dropout-voltage = <0x30d40>;
						reg = [43 00];
						regulator-max-microvolt = <0x33e140>;
						regulator-min-microvolt = <0x16e360>;
						regulator-name = "pm8008_l4";
					};

					qcom,pm8008-l5@4400 {
						phandle = <0x60>;
						qcom,hpm-min-load = <0x2710>;
						qcom,min-dropout-voltage = <0x493e0>;
						reg = [44 00];
						regulator-max-microvolt = <0x33e140>;
						regulator-min-microvolt = <0x16e360>;
						regulator-name = "pm8008_l5";
					};

					qcom,pm8008-l6@4400 {
						phandle = <0x62>;
						qcom,hpm-min-load = <0x2710>;
						qcom,min-dropout-voltage = <0x493e0>;
						reg = [45 00];
						regulator-max-microvolt = <0x33e140>;
						regulator-min-microvolt = <0x16e360>;
						regulator-name = "pm8008_l6";
					};

					qcom,pm8008-l7@4400 {
						phandle = <0x5e>;
						qcom,hpm-min-load = <0x2710>;
						qcom,min-dropout-voltage = <0x493e0>;
						reg = [46 00];
						regulator-max-microvolt = <0x33e140>;
						regulator-min-microvolt = <0x16e360>;
						regulator-name = "pm8008_l7";
					};
				};
			};
		};
	};

	fragment@18 {
		target = <0xffffffff>;

		__overlay__ {
			#address-cells = <0x1>;
			#size-cells = <0x0>;
			status = "okay";

			p61@5 {
				compatible = "nxp,p61";
				phandle = <0x9a>;
				reg = <0x0>;
				spi-max-frequency = <0x124f800>;
				status = "disable";
			};

			st54spi@5 {
				compatible = "st,st54spi";
				gpio-power = <0x6>;
				gpio-power-std = <0xffffffff 0x6 0x0>;
				reg = <0x0>;
				spi-max-frequency = <0xf4240>;
				status = "okay";
			};
		};
	};

	fragment@19 {
		target = <0xffffffff>;

		__overlay__ {

			eintdefault {
				phandle = <0x10>;
			};

			int_active {
				phandle = <0x11>;

				pins_cmd_dat {
					bias-pull-up = <0xb>;
					pinmux = <0x1500>;
					slew-rate = <0x0>;
				};
			};

			int_suspend {
				phandle = <0x13>;

				pins_cmd_dat {
					output-low;
					pinmux = <0x1500>;
					slew-rate = <0x1>;
				};
			};

			reset_active {
				phandle = <0x12>;

				pins_cmd_dat {
					output-high;
					pinmux = <0x1400>;
					slew-rate = <0x1>;
				};
			};

			reset_suspend {
				phandle = <0x14>;

				pins_cmd_dat {
					output-low;
					pinmux = <0x1400>;
					slew-rate = <0x1>;
				};
			};
		};
	};

	fragment@2 {
		target = <0xffffffff>;

		__overlay__ {
		};
	};

	fragment@20 {
		target = <0xffffffff>;

		__overlay__ {

			lcd_bias_enn0_gpio {
				phandle = <0x1b>;

				pins_cmd_dat {
					output-low;
					pinmux = <0x8100>;
					slew-rate = <0x1>;
				};
			};

			lcd_bias_enn1_gpio {
				phandle = <0x1a>;

				pins_cmd_dat {
					output-high;
					pinmux = <0x8100>;
					slew-rate = <0x1>;
				};
			};

			lcd_bias_enp0_gpio {
				phandle = <0x19>;

				pins_cmd_dat {
					output-low;
					pinmux = <0x8000>;
					slew-rate = <0x1>;
				};
			};

			lcd_bias_enp1_gpio {
				phandle = <0x18>;

				pins_cmd_dat {
					output-high;
					pinmux = <0x8000>;
					slew-rate = <0x1>;
				};
			};

			lcm_dsi_te {
				phandle = <0x1e>;

				pins_cmd_dat {
					pinmux = <0x2901>;
				};
			};

			lcm_rst_out0_gpio {
				phandle = <0x1d>;

				pins_cmd_dat {
					output-low;
					pinmux = <0x2a00>;
					slew-rate = <0x1>;
				};
			};

			lcm_rst_out1_gpio {
				phandle = <0x1c>;

				pins_cmd_dat {
					output-high;
					pinmux = <0x2a00>;
					slew-rate = <0x1>;
				};
			};
		};
	};

	fragment@21 {
		target = <0xffffffff>;

		__overlay__ {
			pinctrl-0 = <0x18>;
			pinctrl-1 = <0x19>;
			pinctrl-2 = <0x1a>;
			pinctrl-3 = <0x1b>;
			pinctrl-4 = <0x1c>;
			pinctrl-5 = <0x1d>;
			pinctrl-6 = <0x1e>;
			pinctrl-names = "lcd_bias_enp1_gpio", "lcd_bias_enp0_gpio", "lcd_bias_enn1_gpio", "lcd_bias_enn0_gpio", "lcm_rst_out1_gpio", "lcm_rst_out0_gpio", "mode_te_te";
			status = "okay";
		};
	};

	fragment@22 {
		target = <0xffffffff>;

		__overlay__ {
			pinctrl-0 = <0x1c>;
			pinctrl-1 = <0x1d>;
			pinctrl-2 = <0x1e>;
			pinctrl-names = "lcm_rst_out1_gpio", "lcm_rst_out0_gpio", "mode_te_te";
			status = "okay";
		};
	};

	fragment@23 {
		target = <0xffffffff>;

		__overlay__ {
			DISABLE_MTKBATTERY = <0x1>;
		};
	};

	fragment@24 {
		target = <0xffffffff>;

		__overlay__ {
			accdet-mic-mode = <0x2>;
			accdet-mic-vol = <0x8>;
			accdet-plugout-debounce = <0x1>;
			eint_detect_mode = <0x5>;
			eint_use_ext_res = <0x0>;
			headset-four-key-threshold = <0x0 0x3a 0x79 0xc0 0x190>;
			headset-mode-setting = <0x500 0x500 0x1 0x1f0 0x2000 0x800 0x2000 0x44 0x0 0x7 0x5 0x9 0x9 0xd 0xe>;
			headset-three-key-threshold = <0x0 0x52 0xaa 0x132>;
			headset-three-key-threshold-CDD = <0x0 0x79 0xc0 0x258>;
			moisture-external-r = <0x1e8480>;
			moisture-internal-r = <0xb798>;
			moisture-water-r = <0x2710>;
			moisture_comp_vref2 = <0x0>;
			moisture_comp_vth = <0x2>;
			moisture_detect_enable = <0x1>;
			moisture_detect_mode = <0x5>;
			moisture_use_ext_res = <0x0>;
			status = "okay";
		};
	};

	fragment@25 {
		target = <0xffffffff>;

		__overlay__ {
			mtk_spk_i2s_in = <0x9>;
		};
	};

	fragment@26 {
		target = <0xffffffff>;

		__overlay__ {
			pinctrl-0 = <0x1f>;
			pinctrl-1 = <0x20>;
			pinctrl-names = "irtx_gpio_led_default", "irtx_gpio_led_set";
			status = "okay";
		};
	};

	fragment@27 {
		target = <0xffffffff>;

		__overlay__ {

			irtx_gpio_led_def@gpio127 {
				phandle = <0x1f>;

				pins_cmd_dat {
					bias-disable;
					input-schmitt-enable = <0x0>;
					output-low;
					pinmux = <0x7f00>;
					slew-rate = <0x1>;
				};
			};

			irtx_gpio_led_set@gpio127 {
				phandle = <0x20>;

				pins_cmd_dat {
					output-high;
					pinmux = <0x7f02>;
					slew-rate = <0x1>;
				};
			};
		};
	};

	fragment@28 {
		target = <0xffffffff>;

		__overlay__ {
			disable_lpsd = <0x1>;
			mt6360,intr_gpio = <0xffffffff 0x18 0x0>;
			mt6360,intr_gpio_num = <0x18>;
		};
	};

	fragment@29 {
		target = <0xffffffff>;

		__overlay__ {
			pwr_off_seq = <0x4000202>;
		};
	};

	fragment@3 {
		target = <0xffffffff>;

		__overlay__ {
			atag,videolfb-fb_base_h = <0x0>;
			atag,videolfb-fb_base_l = <0x7e020000>;
			atag,videolfb-fps = <0x1770>;
			atag,videolfb-islcm_inited = <0x0>;
			atag,videolfb-islcmfound = <0x1>;
			atag,videolfb-lcmname = "nt35595_fhd_dsi_cmd_truly_nt50358_drv";
			atag,videolfb-vramSize = <0x1be0000>;
		};
	};

	fragment@30 {
		target = <0xffffffff>;

		__overlay__ {
			mt6360pd,intr_gpio = <0xffffffff 0x19 0x0>;
			mt6360pd,intr_gpio_num = <0x19>;
		};
	};

	fragment@31 {
		target = <0xffffffff>;

		__overlay__ {
			sdcard_det_en = <0x0>;
		};
	};

	fragment@32 {
		target = <0xffffffff>;

		__overlay__ {
			oppo,fp_gpio = <0xbe>;
			pinctrl-0 = <0x21>;
			pinctrl-names = "default";

			goodix_optical {
				chip-name = "G_OPTICAL_G6_7";
				eng-menu = "-1,-1";
				oppo,fp-id = <0x0>;
				vendor-chip = <0xb>;
			};
		};
	};

	fragment@33 {
		target = <0xffffffff>;

		__overlay__ {

			gpio_id0_default {
				phandle = <0x21>;

				pins_cmd_dat {
					bias-pull-up = <0x0>;
					input-enable;
					pinmux = <0xbe00>;
					slew-rate = <0x0>;
				};
			};
		};
	};

	fragment@34 {
		target = <0xffffffff>;

		__overlay__ {
			goodix,gpio_cs = <0xffffffff 0x9d 0x0>;
			goodix,gpio_irq = <0xffffffff 0xf 0x0>;
			goodix,gpio_reset = <0xffffffff 0xe 0x0>;
			pinctrl-0 = <0x22 0x23>;
			pinctrl-1 = <0x24 0x25 0x26 0x27>;
			pinctrl-2 = <0x28>;
			pinctrl-names = "default", "gf_spi_drive_6mA", "gf_cs_func";
			status = "okay";
		};
	};

	fragment@35 {
		target = <0xffffffff>;

		__overlay__ {
			#address-cells = <0x1>;
			#size-cells = <0x0>;
			status = "okay";

			fingerprint@0 {
				avdd-config = <0x325aa0 0x325aa0 0x249f0>;
				avdd-supply = <0xffffffff>;
				compatible = "oppo,oppo_fp";
				notify_tpinfo_flag = <0x1>;
				phandle = <0x9b>;
				reg = <0x0>;
				spi-id = <0x1>;
				spi-irq = <0x27>;
				spi-max-frequency = <0x7a1200>;
				spi-reg = <0xa7ffd0>;
				status = "okay";

				power_source_1 {
					delay-time = <0x0>;
					power-config = "avdd-config";
					power-mode = <0x1>;
					power-name = "avdd";
				};
			};
		};
	};

	fragment@36 {
		target = <0xffffffff>;

		__overlay__ {

			gpio_goodix_clk_6mA {
				phandle = <0x24>;

				pins_cmd_dat {
					drive-strength = <0x2>;
					pinmux = <0x9c01>;
				};
			};

			gpio_goodix_cs_6mA {
				phandle = <0x27>;

				pins_cmd_dat {
					drive-strength = <0x2>;
					pinmux = <0x9d01>;
				};
			};

			gpio_goodix_cs_func {
				phandle = <0x28>;

				pins_cmd_dat {
					drive-strength = <0x2>;
					pinmux = <0x9d01>;
				};
			};

			gpio_goodix_irq_default {
				phandle = <0x22>;

				pins_cmd_dat {
					bias-pull-down;
					pinmux = <0xf00>;
					slew-rate = <0x0>;
				};
			};

			gpio_goodix_miso_6mA {
				phandle = <0x26>;

				pins_cmd_dat {
					drive-strength = <0x3>;
					pinmux = <0x9e01>;
				};
			};

			gpio_goodix_mosi_6mA {
				phandle = <0x25>;

				pins_cmd_dat {
					drive-strength = <0x2>;
					pinmux = <0x9f01>;
				};
			};

			gpio_goodix_reset_default {
				phandle = <0x23>;

				pins_cmd_dat {
					output-low;
					pinmux = <0xe00>;
					slew-rate = <0x1>;
				};
			};
		};
	};

	fragment@37 {
		target = <0xffffffff>;

		__overlay__ {
			regulator-always-on;
			regulator-boot-on;
		};
	};

	fragment@38 {
		target = <0xffffffff>;

		__overlay__ {
			regulator-enable-ramp-delay = <0xf0>;
			regulator-max-microvolt = <0x2dc6c0>;
			regulator-min-microvolt = <0x2dc6c0>;
			regulator-name = "vio28";
		};
	};

	fragment@39 {
		target = <0xffffffff>;

		__overlay__ {

			c1_high {
				phandle = <0x5>;

				pins_cmd_dat {
					output-high;
					pinmux = <0x7100>;
					slew-rate = <0x1>;
				};
			};

			c1_highz {
				phandle = <0x4>;

				pins_cmd_dat {
					bias-disable;
					pinmux = <0x7100>;
					slew-rate = <0x0>;
				};
			};

			c1_init {
				phandle = <0x2>;

				pins_cmd_dat {
					output-low;
					pinmux = <0x7100>;
					slew-rate = <0x1>;
				};
			};

			c1_low {
				phandle = <0x3>;

				pins_cmd_dat {
					output-low;
					pinmux = <0x7100>;
					slew-rate = <0x1>;
				};
			};

			c2_high {
				phandle = <0x9>;

				pins_cmd_dat {
					output-high;
					pinmux = <0x7000>;
					slew-rate = <0x1>;
				};
			};

			c2_highz {
				phandle = <0x8>;

				pins_cmd_dat {
					bias-disable;
					pinmux = <0x7000>;
					slew-rate = <0x0>;
				};
			};

			c2_init {
				phandle = <0x6>;

				pins_cmd_dat {
					output-low;
					pinmux = <0x7000>;
					slew-rate = <0x1>;
				};
			};

			c2_low {
				phandle = <0x7>;

				pins_cmd_dat {
					output-low;
					pinmux = <0x7000>;
					slew-rate = <0x1>;
				};
			};

			u3_sw_dis {
				phandle = <0xd>;
			};

			u3_sw_en {
				phandle = <0xc>;
			};

			u3_sw_sel1 {
				phandle = <0xa>;

				pins_cmd_dat {
					output-low;
					pinmux = <0x6f00>;
					slew-rate = <0x1>;
				};
			};

			u3_sw_sel2 {
				phandle = <0xb>;

				pins_cmd_dat {
					output-high;
					pinmux = <0x6f00>;
					slew-rate = <0x1>;
				};
			};

			usb_default {
				phandle = <0x1>;
			};
		};
	};

	fragment@4 {
		target = <0xffffffff>;

		__overlay__ {
			bus-width = <0x8>;
			cap-mmc-highspeed;
			max-frequency = <0x4c4b40>;
			no-sd;
			no-sdio;
			non-removable;
			status = "okay";
			vmmc-supply = <0xffffffff>;
			vqmmc-supply = <0xffffffff>;
		};
	};

	fragment@40 {
		target = <0xffffffff>;

		__overlay__ {

			gps_default {
				phandle = <0x29>;
			};

			gps_l1_lna@0 {
				phandle = <0x2a>;

				pins_cmd_dat {
					output-low;
					pinmux = <0xa200>;
				};
			};

			gps_l1_lna@1 {
				phandle = <0x2b>;

				pins_cmd_dat {
					pinmux = <0xa202>;
				};
			};

			gps_l1_lna@2 {
				phandle = <0x2c>;

				pins_cmd_dat {
					output-high;
					pinmux = <0xa200>;
				};
			};

			gps_l5_lna@0 {
				phandle = <0x2d>;

				pins_cmd_dat {
					output-low;
					pinmux = <0xa300>;
				};
			};

			gps_l5_lna@1 {
				phandle = <0x2e>;

				pins_cmd_dat {
					pinmux = <0xa302>;
				};
			};

			gps_l5_lna@2 {
				phandle = <0x2f>;

				pins_cmd_dat {
					output-high;
					pinmux = <0xa300>;
				};
			};
		};
	};

	fragment@41 {
		target = <0xffffffff>;

		__overlay__ {
			pinctrl-0 = <0x29>;
			pinctrl-1 = <0x2a>;
			pinctrl-2 = <0x2b>;
			pinctrl-3 = <0x2c>;
			pinctrl-4 = <0x2d>;
			pinctrl-5 = <0x2e>;
			pinctrl-6 = <0x2f>;
			pinctrl-names = "default", "gps_l1_lna_disable", "gps_l1_lna_dsp_ctrl", "gps_l1_lna_enable", "gps_l5_lna_disable", "gps_l5_lna_dsp_ctrl", "gps_l5_lna_enable";
			status = "okay";
		};
	};

	fragment@42 {
		target = <0xffffffff>;

		__overlay__ {
			status = "ok";
		};
	};

	fragment@43 {
		target = <0xffffffff>;

		__overlay__ {

			aw_irq_gpio_default {
				phandle = <0x71>;

				pins_cmd_dat {
					bias-pull-up = <0xb>;
					input-enable;
					pinmux = <0x8700>;
					slew-rate = <0x0>;
				};
			};
		};
	};

	fragment@44 {
		target = <0xffffffff>;

		__overlay__ {

			ts_active1 {
				phandle = <0x15>;

				pins_cmd_dat {
					output-high;
					pinmux = <0x200>;
					slew-rate = <0x1>;
				};
			};

			ts_suspend1 {
				phandle = <0x16>;

				pins_cmd_dat {
					output-low;
					pinmux = <0x200>;
					slew-rate = <0x1>;
				};
			};
		};
	};

	fragment@45 {
		target = <0xffffffff>;

		__overlay__ {

			camdefault {
				phandle = <0x30>;
			};

			camera0_mclk_2ma@gpio150 {
				phandle = <0x44>;

				pins_cmd_dat {
					drive-strength = <0x0>;
					pinmux = <0x9601>;
				};
			};

			camera0_mclk_4ma@gpio150 {
				phandle = <0x45>;

				pins_cmd_dat {
					drive-strength = <0x1>;
					pinmux = <0x9601>;
				};
			};

			camera0_mclk_6ma@gpio150 {
				phandle = <0x46>;

				pins_cmd_dat {
					drive-strength = <0x2>;
					pinmux = <0x9601>;
				};
			};

			camera0_mclk_8ma@gpio150 {
				phandle = <0x47>;

				pins_cmd_dat {
					drive-strength = <0x3>;
					pinmux = <0x9601>;
				};
			};

			camera0_mclk_gpio_mode@gpio150 {
				phandle = <0x43>;

				pins_cmd_dat {
					drive-strength = <0x1>;
					pinmux = <0x9600>;
				};
			};

			camera0_rst_output_high@gpio144 {
				phandle = <0x32>;

				pins_cmd_dat {
					output-high;
					pinmux = <0x9000>;
				};
			};

			camera0_rst_output_low@gpio144 {
				phandle = <0x31>;

				pins_cmd_dat {
					output-low;
					pinmux = <0x9000>;
				};
			};

			camera0_vcama_off {
				phandle = <0x3b>;

				pins_cmd_dat {
					output-low;
					pinmux = <0x8700>;
				};
			};

			camera0_vcama_on {
				phandle = <0x3c>;

				pins_cmd_dat {
					output-high;
					pinmux = <0x8700>;
				};
			};

			camera0_vcamd_output_high@gpio147 {
				phandle = <0x3e>;

				pins_cmd_dat {
					output-high;
					pinmux = <0x9300>;
				};
			};

			camera0_vcamd_output_low@gpio147 {
				phandle = <0x3d>;

				pins_cmd_dat {
					output-low;
					pinmux = <0x9300>;
					slew-rate = <0x1>;
				};
			};

			camera1_mclk_2ma@gpio149 {
				phandle = <0x49>;

				pins_cmd_dat {
					drive-strength = <0x0>;
					pinmux = <0x9501>;
				};
			};

			camera1_mclk_4ma@gpio149 {
				phandle = <0x4a>;

				pins_cmd_dat {
					drive-strength = <0x1>;
					pinmux = <0x9501>;
				};
			};

			camera1_mclk_6ma@gpio149 {
				phandle = <0x4b>;

				pins_cmd_dat {
					drive-strength = <0x2>;
					pinmux = <0x9501>;
				};
			};

			camera1_mclk_8ma@gpio149 {
				phandle = <0x4c>;

				pins_cmd_dat {
					drive-strength = <0x3>;
					pinmux = <0x9501>;
				};
			};

			camera1_mclk_gpio_mode@gpio149 {
				phandle = <0x48>;

				pins_cmd_dat {
					drive-strength = <0x1>;
					pinmux = <0x9500>;
				};
			};

			camera1_rst_output_high@gpio143 {
				phandle = <0x34>;

				pins_cmd_dat {
					output-high;
					pinmux = <0x8f00>;
				};
			};

			camera1_rst_output_low@gpio143 {
				phandle = <0x33>;

				pins_cmd_dat {
					output-low;
					pinmux = <0x8f00>;
				};
			};

			camera1_vcamd_output_high@gpio147 {
				phandle = <0x40>;

				pins_cmd_dat {
					output-high;
					pinmux = <0x9300>;
				};
			};

			camera1_vcamd_output_low@gpio147 {
				phandle = <0x3f>;

				pins_cmd_dat {
					output-low;
					pinmux = <0x9300>;
					slew-rate = <0x1>;
				};
			};

			camera2_mclk_2ma@gpio151 {
				phandle = <0x4e>;

				pins_cmd_dat {
					drive-strength = <0x0>;
					pinmux = <0x9701>;
				};
			};

			camera2_mclk_4ma@gpio151 {
				phandle = <0x4f>;

				pins_cmd_dat {
					drive-strength = <0x1>;
					pinmux = <0x9701>;
				};
			};

			camera2_mclk_6ma@gpio151 {
				phandle = <0x50>;

				pins_cmd_dat {
					drive-strength = <0x2>;
					pinmux = <0x9701>;
				};
			};

			camera2_mclk_8ma@gpio151 {
				phandle = <0x51>;

				pins_cmd_dat {
					drive-strength = <0x3>;
					pinmux = <0x9701>;
				};
			};

			camera2_mclk_gpio_mode@gpio151 {
				phandle = <0x4d>;

				pins_cmd_dat {
					drive-strength = <0x1>;
					pinmux = <0x9700>;
				};
			};

			camera2_rst_output_high@gpio145 {
				phandle = <0x36>;

				pins_cmd_dat {
					output-high;
					pinmux = <0x9100>;
				};
			};

			camera2_rst_output_low@gpio145 {
				phandle = <0x35>;

				pins_cmd_dat {
					output-low;
					pinmux = <0x9100>;
				};
			};

			camera2_vcamd_output_high@gpio146 {
				phandle = <0x42>;

				pins_cmd_dat {
					output-high;
					pinmux = <0x9200>;
				};
			};

			camera2_vcamd_output_low@gpio146 {
				phandle = <0x41>;

				pins_cmd_dat {
					output-low;
					pinmux = <0x9200>;
				};
			};

			camera3_mclk_2ma@gpio136 {
				phandle = <0x53>;

				pins_cmd_dat {
					drive-strength = <0x0>;
					pinmux = <0x8801>;
				};
			};

			camera3_mclk_4ma@gpio136 {
				phandle = <0x54>;

				pins_cmd_dat {
					drive-strength = <0x1>;
					pinmux = <0x8801>;
				};
			};

			camera3_mclk_6ma@gpio136 {
				phandle = <0x55>;

				pins_cmd_dat {
					drive-strength = <0x2>;
					pinmux = <0x8801>;
				};
			};

			camera3_mclk_8ma@gpio136 {
				phandle = <0x56>;

				pins_cmd_dat {
					drive-strength = <0x3>;
					pinmux = <0x8801>;
				};
			};

			camera3_mclk_gpio_mode@gpio136 {
				phandle = <0x52>;

				pins_cmd_dat {
					drive-strength = <0x1>;
					pinmux = <0x8800>;
				};
			};

			camera3_rst_output_high@gpio130 {
				phandle = <0x38>;

				pins_cmd_dat {
					output-high;
					pinmux = <0x8200>;
				};
			};

			camera3_rst_output_low@gpio130 {
				phandle = <0x37>;

				pins_cmd_dat {
					output-low;
					pinmux = <0x8200>;
				};
			};

			camera4_mclk_2ma@gpio137 {
				phandle = <0x58>;

				pins_cmd_dat {
					drive-strength = <0x0>;
					pinmux = <0x8901>;
				};
			};

			camera4_mclk_4ma@gpio137 {
				phandle = <0x59>;

				pins_cmd_dat {
					drive-strength = <0x1>;
					pinmux = <0x8901>;
				};
			};

			camera4_mclk_6ma@gpio137 {
				phandle = <0x5a>;

				pins_cmd_dat {
					drive-strength = <0x2>;
					pinmux = <0x8901>;
				};
			};

			camera4_mclk_8ma@gpio137 {
				phandle = <0x5b>;

				pins_cmd_dat {
					drive-strength = <0x3>;
					pinmux = <0x8901>;
				};
			};

			camera4_mclk_gpio_mode@gpio137 {
				phandle = <0x57>;

				pins_cmd_dat {
					drive-strength = <0x1>;
					pinmux = <0x8900>;
				};
			};

			camera4_rst_output_high@gpio131 {
				phandle = <0x3a>;

				pins_cmd_dat {
					output-high;
					pinmux = <0x8300>;
				};
			};

			camera4_rst_output_low@gpio131 {
				phandle = <0x39>;

				pins_cmd_dat {
					output-low;
					pinmux = <0x8300>;
				};
			};

			fan53870_gpio_disable@gpio29 {
				phandle = <0x5d>;

				pins_cmd_dat {
					output-low;
					pinmux = <0x1d00>;
				};
			};

			fan53870_gpio_enable@gpio29 {
				phandle = <0x5c>;

				pins_cmd_dat {
					output-high;
					pinmux = <0x1d00>;
				};
			};
		};
	};

	fragment@46 {
		target = <0xffffffff>;

		__overlay__ {
			cam0_enable_sensor = "imx586_mipi_raw imx686_mipi_raw";
			cam0_vcama1-supply = <0x5e>;
			cam0_vcamaf-supply = <0x62>;
			cam0_vcamio-supply = <0xffffffff>;
			cam1_enable_sensor = "imx616_mipi_raw ov32a1q_mipi_raw imx471_mipi_raw";
			cam1_vcama-supply = <0x5e>;
			cam1_vcamio-supply = <0xffffffff>;
			cam2_enable_sensor = "hi846_mipi_raw";
			cam2_vcama-supply = <0x5f>;
			cam2_vcamio-supply = <0xffffffff>;
			cam3_enable_sensor = "gc02m1b_mipi_mono s5k3m5sx_mipi_raw";
			cam3_vcama-supply = <0x60>;
			cam3_vcamd-supply = <0x61>;
			cam3_vcamio-supply = <0xffffffff>;
			cam4_enable_sensor = "gc2385_mipi_raw ov02b1b_mipi_raw";
			cam4_vcama-supply = <0x5f>;
			cam4_vcamio-supply = <0xffffffff>;
			pinctrl-0 = <0x30>;
			pinctrl-1 = <0x31>;
			pinctrl-10 = <0x3a>;
			pinctrl-11 = <0x3b>;
			pinctrl-12 = <0x3c>;
			pinctrl-13 = <0x3d>;
			pinctrl-14 = <0x3e>;
			pinctrl-15 = <0x3f>;
			pinctrl-16 = <0x40>;
			pinctrl-17 = <0x41>;
			pinctrl-18 = <0x42>;
			pinctrl-19 = <0x43>;
			pinctrl-2 = <0x32>;
			pinctrl-20 = <0x44>;
			pinctrl-21 = <0x45>;
			pinctrl-22 = <0x46>;
			pinctrl-23 = <0x47>;
			pinctrl-24 = <0x48>;
			pinctrl-25 = <0x49>;
			pinctrl-26 = <0x4a>;
			pinctrl-27 = <0x4b>;
			pinctrl-28 = <0x4c>;
			pinctrl-29 = <0x4d>;
			pinctrl-3 = <0x33>;
			pinctrl-30 = <0x4e>;
			pinctrl-31 = <0x4f>;
			pinctrl-32 = <0x50>;
			pinctrl-33 = <0x51>;
			pinctrl-34 = <0x52>;
			pinctrl-35 = <0x53>;
			pinctrl-36 = <0x54>;
			pinctrl-37 = <0x55>;
			pinctrl-38 = <0x56>;
			pinctrl-39 = <0x57>;
			pinctrl-4 = <0x34>;
			pinctrl-40 = <0x58>;
			pinctrl-41 = <0x59>;
			pinctrl-42 = <0x5a>;
			pinctrl-43 = <0x5b>;
			pinctrl-44 = <0x5c>;
			pinctrl-45 = <0x5d>;
			pinctrl-5 = <0x35>;
			pinctrl-6 = <0x36>;
			pinctrl-7 = <0x37>;
			pinctrl-8 = <0x38>;
			pinctrl-9 = <0x39>;
			pinctrl-names = "default", "cam0_rst0", "cam0_rst1", "cam1_rst0", "cam1_rst1", "cam2_rst0", "cam2_rst1", "cam3_rst0", "cam3_rst1", "cam4_rst0", "cam4_rst1", "cam0_ldo_vcama_0", "cam0_ldo_vcama_1", "cam0_ldo_vcamd_0", "cam0_ldo_vcamd_1", "cam1_ldo_vcamd_0", "cam1_ldo_vcamd_1", "cam2_ldo_vcamd_0", "cam2_ldo_vcamd_1", "cam0_mclk_off", "cam0_mclk_2mA", "cam0_mclk_4mA", "cam0_mclk_6mA", "cam0_mclk_8mA", "cam1_mclk_off", "cam1_mclk_2mA", "cam1_mclk_4mA", "cam1_mclk_6mA", "cam1_mclk_8mA", "cam2_mclk_off", "cam2_mclk_2mA", "cam2_mclk_4mA", "cam2_mclk_6mA", "cam2_mclk_8mA", "cam3_mclk_off", "cam3_mclk_2mA", "cam3_mclk_4mA", "cam3_mclk_6mA", "cam3_mclk_8mA", "cam4_mclk_off", "cam4_mclk_2mA", "cam4_mclk_4mA", "cam4_mclk_6mA", "cam4_mclk_8mA", "fan53870_chip_enable", "fan53870_chip_disable";
			status = "okay";
		};
	};

	fragment@47 {
		target = <0xffffffff>;

		__overlay__ {
			#address-cells = <0x1>;
			#size-cells = <0x0>;
			status = "okay";

			panel1@0 {
				bias-gpio = <0xffffffff 0x1d 0x0>;
				compatible = "oppo20601_samsung_sofe03f_m_1080p_dsi_cmd";
				ldo3-supply = <0xffffffff>;
				pinctrl-names = "default";
				pm-enable-gpios = <0xffffffff 0x29 0x0>;
				pm8008ldo1-supply = <0x63>;
				reg = <0x0>;
				reset-gpios = <0xffffffff 0x2a 0x0>;

				port {

					endpoint {
						phandle = <0x65>;
						remote-endpoint = <0x64>;
					};
				};
			};

			panel2@0 {
				bias-gpio = <0xffffffff 0x1d 0x0>;
				compatible = "oppo19040_samsung_ana6705_1080p_dsi_cmd";
				ldo3-supply = <0xffffffff>;
				pinctrl-names = "default";
				pm-enable-gpios = <0xffffffff 0x29 0x0>;
				pm8008ldo1-supply = <0x63>;
				reg = <0x1>;
				reset-gpios = <0xffffffff 0x2a 0x0>;

				port {

					endpoint {
						phandle = <0x9c>;
						remote-endpoint = <0x64>;
					};
				};
			};

			ports {

				port {

					endpoint {
						phandle = <0x64>;
						remote-endpoint = <0x65>;
					};
				};
			};
		};
	};

	fragment@48 {
		target = <0xffffffff>;

		__overlay__ {
			charger_by_buckboost;
			chgic_id = <0x0>;
		};
	};

	fragment@49 {
		target = <0xffffffff>;

		__overlay__ {

			vooc_ap_data {
				compatible = "mediatek, VOOC_AP_DATA-eint";
				interrupts = <0x5e 0x2 0x5e 0x0>;
				phandle = <0x9d>;
			};

			vooc_ap_data_new_function {
				compatible = "mediatek, VOOC_EINT_NEW_FUNCTION";
				phandle = <0x9e>;
			};
		};
	};

	fragment@5 {
		target = <0xffffffff>;

		__overlay__ {

			kpd_volume_down {
				compatible = "mediatek, VOLUME_DOWN-eint";
				debounce = <0x7d00>;
				interrupt-parent = <0xffffffff>;
				interrupts = <0x9b 0x2 0x9b 0x0>;
				phandle = <0x8f>;
				status = "okay";
			};

			led@0 {
				compatible = "mediatek,red";
				data = <0x1>;
				led_mode = <0x0>;
				phandle = <0x86>;
				pwm_config = <0x0 0x0 0x0 0x0 0x0>;
			};

			led@1 {
				compatible = "mediatek,green";
				data = <0x1>;
				led_mode = <0x0>;
				phandle = <0x87>;
				pwm_config = <0x0 0x0 0x0 0x0 0x0>;
			};

			led@2 {
				compatible = "mediatek,blue";
				data = <0x1>;
				led_mode = <0x0>;
				phandle = <0x88>;
				pwm_config = <0x0 0x0 0x0 0x0 0x0>;
			};

			led@3 {
				compatible = "mediatek,jogball-backlight";
				data = <0x1>;
				led_mode = <0x0>;
				phandle = <0x89>;
				pwm_config = <0x0 0x0 0x0 0x0 0x0>;
			};

			led@4 {
				compatible = "mediatek,keyboard-backlight";
				data = <0x1>;
				led_mode = <0x0>;
				phandle = <0x8a>;
				pwm_config = <0x0 0x0 0x0 0x0 0x0>;
			};

			led@5 {
				compatible = "mediatek,button-backlight";
				data = <0x1>;
				led_mode = <0x0>;
				phandle = <0x8b>;
				pwm_config = <0x0 0x0 0x0 0x0 0x0>;
			};

			led@6 {
				compatible = "mediatek,lcd-backlight";
				data = <0x1>;
				led_mode = <0x4>;
				phandle = <0x8c>;
				pwm_config = <0x0 0x1 0x0 0x0 0x0>;
			};

			oppo_devinfo {
				Hw,sim_det = <0xffffffff 0x2b 0x0>;
				compatible = "oppo, device_info";
				io-channel-names = "auxadc3-name";
				io-channels = <0xffffffff 0x3>;
				phandle = <0x91>;
			};

			oppo_project {
				compatible = "oppo,oppo_project";
				phandle = <0x90>;
			};

			usb_c_pinctrl {
				compatible = "mediatek,usb_c_pinctrl";
				phandle = <0x8e>;
				pinctrl-0 = <0x1>;
				pinctrl-1 = <0x2>;
				pinctrl-10 = <0xb>;
				pinctrl-11 = <0xc>;
				pinctrl-12 = <0xd>;
				pinctrl-2 = <0x3>;
				pinctrl-3 = <0x4>;
				pinctrl-4 = <0x5>;
				pinctrl-5 = <0x6>;
				pinctrl-6 = <0x7>;
				pinctrl-7 = <0x8>;
				pinctrl-8 = <0x9>;
				pinctrl-9 = <0xa>;
				pinctrl-names = "usb_default", "redrv_c1_init", "redrv_c1_low", "redrv_c1_hiz", "redrv_c1_high", "redrv_c2_init", "redrv_c2_low", "redrv_c2_hiz", "redrv_c2_high", "switch_sel1", "switch_sel2", "switch_enable", "switch_disable";
				status = "okay";

				usb_switch-data {
					c1_pin_num = <0x71>;
					c1_pin_val = <0x2>;
					c2_pin_num = <0x70>;
					c2_pin_val = <0x1>;
					en_pin_num = <0x0>;
					en_pin_val = <0x0>;
					sel_pin_num = <0x6f>;
					sel_pin_val = <0x1>;
				};
			};

			vibrator@0 {
				compatible = "mediatek,vibrator";
				phandle = <0x8d>;
				vib_limit = <0x0>;
				vib_timer = <0x1e>;
				vib_vol = <0xb>;
			};
		};
	};

	fragment@50 {
		target = <0xffffffff>;

		__overlay__ {
			compatible = "mediatek,phy_tuning";
			host_u2_enhance = <0x2>;
			host_u2_term_ref = <0x6>;
			host_u2_vrt_ref = <0x6>;
			u2_enhance = <0x3>;
			u2_term_ref = <0x7>;
			u2_vrt_ref = <0x7>;
		};
	};

	fragment@51 {
		target = <0xffffffff>;

		__overlay__ {
			mt-tcpc,role_def = <0x4>;
		};
	};

	fragment@52 {
		target = <0xffffffff>;

		__overlay__ {
			io-channel-names = "auxadc3-chargeric_temp", "auxadc4-usb_temp_v_l", "auxadc5-usb_temp_v_r";
			io-channels = <0xffffffff 0x3 0xffffffff 0x4 0xffffffff 0x5>;
			pinctrl-0 = <0x66>;
			pinctrl-1 = <0x67>;
			pinctrl-10 = <0x70>;
			pinctrl-2 = <0x68>;
			pinctrl-3 = <0x69>;
			pinctrl-4 = <0x6a>;
			pinctrl-5 = <0x6b>;
			pinctrl-6 = <0x6c>;
			pinctrl-7 = <0x6d>;
			pinctrl-8 = <0x6e>;
			pinctrl-9 = <0x6f>;
			pinctrl-names = "default", "charger_gpio_as_output_low", "charger_gpio_as_output_high", "ship_sleep", "ship_active", "dischg_enable", "dischg_disable", "chgvin_enable", "chgvin_disable", "ccdetect_active", "ccdetect_sleep";
			qcom,batt_capacity_mah = <0x1194>;
			qcom,ccdetect-gpio = <0xffffffff 0x5 0x0>;
			qcom,charger_current_vooc_ma_normal = <0x708>;
			qcom,charger_hv_thr = <0x26ac>;
			qcom,charger_lv_thr = <0xd48>;
			qcom,charger_recv_thr = <0x251c>;
			qcom,chargerid_support;
			qcom,chargerid_switch-gpio = <0xffffffff 0xc0 0x0>;
			qcom,check_batt_full_by_sw;
			qcom,chg_ctrl_by_calling;
			qcom,chg_ctrl_by_camera;
			qcom,chg_ctrl_by_lcd;
			qcom,chg_ctrl_by_vooc;
			qcom,chgvin = <0xffffffff 0x9 0x0>;
			qcom,cold_bat_decidegc = <0x14>;
			qcom,cold_vfloat_over_sw_limit = <0xf96>;
			qcom,cold_vfloat_sw_limit = <0xf5a>;
			qcom,cool_bat_decidegc = <0x32>;
			qcom,cool_vfloat_over_sw_limit = <0x115d>;
			qcom,cool_vfloat_sw_limit = <0x1121>;
			qcom,default_iterm_ma = <0x73>;
			qcom,default_little_cool_vfloat_over_sw_limit = <0x115d>;
			qcom,default_little_cool_vfloat_sw_limit = <0x1121>;
			qcom,default_normal_vfloat_over_sw_limit = <0x115d>;
			qcom,default_normal_vfloat_sw_limit = <0x1121>;
			qcom,default_temp_little_cool_fastchg_current_ma = <0x44c>;
			qcom,default_temp_little_cool_vfloat_mv = <0x1153>;
			qcom,default_temp_normal_fastchg_current_ma = <0x44c>;
			qcom,default_temp_normal_vfloat_mv = <0x1153>;
			qcom,dischg-gpio = <0xffffffff 0x33 0x0>;
			qcom,dual_ffc;
			qcom,external_gauge;
			qcom,ff1_exit_step_ma = <0x96>;
			qcom,ff1_normal_fastchg_ma = <0x226>;
			qcom,ff1_warm_exit_step_ma = <0x96>;
			qcom,ff1_warm_fastchg_ma = <0x226>;
			qcom,ffc1_normal_vfloat_over_sw_limit = <0x1194>;
			qcom,ffc1_temp_normal_vfloat_mv = <0x1194>;
			qcom,ffc2_exit_step_ma = <0x96>;
			qcom,ffc2_normal_fastchg_ma = <0x15e>;
			qcom,ffc2_normal_vfloat_over_sw_limit = <0x1194>;
			qcom,ffc2_normal_vfloat_sw_limit = <0x115a>;
			qcom,ffc2_temp_high_decidegc = <0x190>;
			qcom,ffc2_temp_low_decidegc = <0x78>;
			qcom,ffc2_temp_normal_vfloat_mv = <0x1194>;
			qcom,ffc2_temp_warm_decidegc = <0x15e>;
			qcom,ffc2_warm_fastchg_ma = <0x15e>;
			qcom,ffc2_warm_vfloat_sw_limit = <0x1155>;
			qcom,ffc_normal_vfloat_over_sw_limit = <0x1194>;
			qcom,ffc_normal_vfloat_sw_limit = <0x1167>;
			qcom,ffc_support;
			qcom,ffc_temp_normal_vfloat_mv = <0x1194>;
			qcom,ffc_warm_vfloat_sw_limit = <0x1162>;
			qcom,hot_bat_decidegc = <0x212>;
			qcom,hv_flashled_support;
			qcom,input_current_calling_ma = <0x5dc>;
			qcom,input_current_camera_ma = <0x4b0>;
			qcom,input_current_cdp_ma = <0x5dc>;
			qcom,input_current_charger_ma = <0x7d0>;
			qcom,input_current_led_ma = <0x4b0>;
			qcom,input_current_led_ma_high = <0x4b0>;
			qcom,input_current_led_ma_normal = <0x7d0>;
			qcom,input_current_led_ma_warm = <0x5dc>;
			qcom,input_current_usb_ma = <0x1f4>;
			qcom,input_current_vooc_led_ma_high = <0x4b0>;
			qcom,input_current_vooc_led_ma_normal = <0xe10>;
			qcom,input_current_vooc_led_ma_warm = <0x708>;
			qcom,input_current_vooc_ma_high = <0x898>;
			qcom,input_current_vooc_ma_normal = <0xe10>;
			qcom,input_current_vooc_ma_warm = <0xc80>;
			qcom,iterm_disabled = <0x0>;
			qcom,iterm_ma = <0x73>;
			qcom,led_high_bat_decidegc = <0x172>;
			qcom,led_warm_bat_decidegc = <0x15e>;
			qcom,little_cold_bat_decidegc = <0x0>;
			qcom,little_cold_vfloat_over_sw_limit = <0x115d>;
			qcom,little_cold_vfloat_sw_limit = <0x1121>;
			qcom,little_cool_bat_decidegc = <0x78>;
			qcom,little_cool_vfloat_over_sw_limit = <0x115d>;
			qcom,little_cool_vfloat_sw_limit = <0x1121>;
			qcom,lpd-disable;
			qcom,max_chg_time_sec = <0xfd20>;
			qcom,new_ui_warning_support;
			qcom,non_normal_vterm_hw_inc = <0x12>;
			qcom,non_standard_fastchg_current_ma = <0x200>;
			qcom,non_standard_vfloat_mv = <0xf8c>;
			qcom,non_standard_vfloat_over_sw_limit = <0xf96>;
			qcom,non_standard_vfloat_sw_limit = <0xf5a>;
			qcom,normal_bat_decidegc = <0xa0>;
			qcom,normal_vfloat_over_sw_limit = <0x115d>;
			qcom,normal_vfloat_sw_limit = <0x1121>;
			qcom,normal_vterm_hw_inc = <0x12>;
			qcom,overtemp_bat_decidegc = <0x15e>;
			qcom,pd_input_current_charger_ma = <0x7d0>;
			qcom,pd_temp_cool_fastchg_current_ma_high = <0x7d0>;
			qcom,pd_temp_cool_fastchg_current_ma_low = <0x5dc>;
			qcom,pd_temp_little_cold_fastchg_current_ma_high = <0x708>;
			qcom,pd_temp_little_cold_fastchg_current_ma_low = <0x5dc>;
			qcom,pd_temp_little_cool_fastchg_current_ma = <0x7d0>;
			qcom,pd_temp_normal_fastchg_current_ma = <0x7d0>;
			qcom,pd_temp_warm_fastchg_current_ma = <0x258>;
			qcom,qc_input_current_charger_ma = <0x7d0>;
			qcom,qc_temp_cool_fastchg_current_ma_high = <0x7d0>;
			qcom,qc_temp_cool_fastchg_current_ma_low = <0x5dc>;
			qcom,qc_temp_little_cold_fastchg_current_ma_high = <0x708>;
			qcom,qc_temp_little_cold_fastchg_current_ma_low = <0x5dc>;
			qcom,qc_temp_little_cool_fastchg_current_ma = <0x7d0>;
			qcom,qc_temp_normal_fastchg_current_ma = <0x7d0>;
			qcom,qc_temp_warm_fastchg_current_ma = <0x258>;
			qcom,recharge-mv = <0x64>;
			qcom,removed_bat_decidegc = <0xbe>;
			qcom,ship-gpio = <0xffffffff 0x7e 0x0>;
			qcom,short_c_bat_cv_mv = <0x10ea>;
			qcom,short_c_bat_fastchg_current_ma = <0x200>;
			qcom,short_c_bat_vfloat_mv = <0xed8>;
			qcom,short_c_bat_vfloat_sw_limit = <0xea6>;
			qcom,smart_charging_screenoff;
			qcom,sw_vfloat_over_protect_enable;
			qcom,temp_cold_fastchg_current_ma = <0x12c>;
			qcom,temp_cold_vfloat_mv = <0xf8c>;
			qcom,temp_cool_fastchg_current_ma_high = <0x44c>;
			qcom,temp_cool_fastchg_current_ma_low = <0x44c>;
			qcom,temp_cool_vfloat_mv = <0x1153>;
			qcom,temp_little_cold_fastchg_current_ma = <0x3b6>;
			qcom,temp_little_cold_fastchg_current_ma_high = <0x3b6>;
			qcom,temp_little_cold_fastchg_current_ma_low = <0x3b6>;
			qcom,temp_little_cold_vfloat_mv = <0x1153>;
			qcom,temp_little_cool_fastchg_current_ma = <0x44c>;
			qcom,temp_little_cool_vfloat_mv = <0x1153>;
			qcom,temp_normal_fastchg_current_ma = <0x44c>;
			qcom,temp_normal_vfloat_mv = <0x1153>;
			qcom,temp_warm_fastchg_current_ma = <0x226>;
			qcom,temp_warm_fastchg_current_ma_led_on = <0xfa>;
			qcom,temp_warm_vfloat_mv = <0x1022>;
			qcom,vbatt_full_thr = <0x1153>;
			qcom,vbatt_hv_thr = <0x11f8>;
			qcom,vbatt_num = <0x2>;
			qcom,vbatt_pdqc_to_5v_thr = <0x1004>;
			qcom,vbatt_power_off = <0xce4>;
			qcom,vbatt_soc_1 = <0xcee>;
			qcom,vfloat_step_mv = <0x8>;
			qcom,vooc_project = <0x3>;
			qcom,vooc_temp_bat_hot_decidegc = <0x1b8>;
			qcom,vooc_temp_bat_normal_decidegc = <0x15e>;
			qcom,vooc_temp_bat_warm_decidegc = <0x172>;
			qcom,warm_bat_decidegc = <0x1c2>;
			qcom,warm_vfloat_over_sw_limit = <0x102c>;
			qcom,warm_vfloat_sw_limit = <0xff0>;
			recharge_after_full;
		};
	};

	fragment@53 {
		target = <0xffffffff>;

		__overlay__ {
			status = "okay";

			aw8697_haptic@5A {
				compatible = "awinic,aw8697_haptic";
				irq-gpio = <0xffffffff 0x87 0x2008>;
				pinctrl-0 = <0x71>;
				pinctrl-names = "default";
				qcom,device_id = <0x340>;
				reg = <0x5a>;
				reset-gpio = <0xffffffff 0xb9 0x1>;
				status = "ok";
			};
		};
	};

	fragment@54 {
		target = <0xffffffff>;

		__overlay__ {
			pinctrl-0 = <0x72>;
			pinctrl-1 = <0x73>;
			pinctrl-names = "i2c-state", "output-low-state";
		};
	};

	fragment@55 {
		target = <0xffffffff>;

		__overlay__ {

			i2c7_sda_i2c_state {
				phandle = <0x72>;

				pins_cmd_dat {
					bias-pull-up = <0xb>;
					pinmux = <0x7000>;
					slew-rate = <0x0>;
				};
			};

			i2c7_sda_output_low_state {
				phandle = <0x73>;

				pins_cmd_dat {
					output-low;
					pinmux = <0x7000>;
					slew-rate = <0x1>;
				};
			};
		};
	};

	fragment@56 {
		target = <0xffffffff>;

		__overlay__ {
			clock-frequency = <0x186a0>;
			status = "okay";

			bq27541-battery@55 {
				compatible = "oppo,bq27541-battery";
				qcom,batt_bq28z610;
				qcom,modify-soc-smooth;
				reg = <0x55 0x0>;
				status = "okay";
			};

			da9313-divider@68 {
				compatible = "oppo,da9313-divider";
				qcom,ic_en_mode;
				reg = <0x68 0x0>;
				status = "okay";
			};

			mp2650-charger@5c {
				compatible = "oppo,mp2650-charger";
				pinctrl-0 = <0x74>;
				pinctrl-1 = <0x75>;
				pinctrl-2 = <0x76>;
				pinctrl-names = "mps_otg_en_active", "mps_otg_en_sleep", "mps_otg_en_default";
				qcom,mps_otg_en-gpio = <0xffffffff 0x85 0x0>;
				reg = <0x5c>;
				status = "okay";
			};

			rk826_fastcg@0a {
				compatible = "oppo,rk826-fastcg";
				pinctrl-0 = <0x77>;
				pinctrl-1 = <0x78>;
				pinctrl-10 = <0x7d>;
				pinctrl-11 = <0x7e>;
				pinctrl-12 = <0x7f>;
				pinctrl-13 = <0x80>;
				pinctrl-14 = <0x81>;
				pinctrl-15 = <0x82>;
				pinctrl-2 = <0x77>;
				pinctrl-3 = <0x78>;
				pinctrl-4 = <0x77>;
				pinctrl-5 = <0x78>;
				pinctrl-6 = <0x79>;
				pinctrl-7 = <0x7a>;
				pinctrl-8 = <0x7b>;
				pinctrl-9 = <0x7c>;
				pinctrl-names = "switch1_act_switch2_act", "switch1_sleep_switch2_sleep", "switch1_act_switch3_act", "switch1_sleep_switch3_sleep", "switch1_act_switch2_sleep", "switch1_sleep_switch2_act", "clock_active", "clock_sleep", "data_active", "data_sleep", "reset_active", "reset_sleep", "charging_switch1_ctr1_active", "charging_switch1_ctr1_sleep", "vooc_asic_id_active", "vooc_asic_id_sleep";
				qcom,charging_clock-gpio = <0xffffffff 0x5f 0x0>;
				qcom,charging_data-gpio = <0xffffffff 0x5e 0x0>;
				qcom,charging_reset-gpio = <0xffffffff 0xbd 0x0>;
				qcom,charging_switch1-gpio = <0xffffffff 0xbf 0x0>;
				qcom,charging_switch1_ctr1-gpio = <0xffffffff 0xba 0x0>;
				qcom,oppo_batt_4400mv;
				qcom,support_vooc_by_normal_charger_path;
				qcom,vooc-fw-type = <0x20>;
				qcom,vooc-high-soc = <0x5a>;
				qcom,vooc-high-temp = <0x1ae>;
				qcom,vooc-low-soc = <0x1>;
				qcom,vooc-low-temp = <0x32>;
				qcom,vooc-normal-to-little-cool-current = <0x5>;
				qcom,vooc_asic_id-gpio = <0xffffffff 0x38 0x0>;
				qcom,vooc_fw_update_newmethod;
				qcom,vooc_multistep_adjust_current_support;
				qcom,vooc_multistep_initial_batt_temp = <0x136>;
				qcom,vooc_over_high_or_low_current = <0x2>;
				qcom,vooc_strategy1_batt_high_temp0 = <0x1a9>;
				qcom,vooc_strategy1_batt_high_temp1 = <0x1ae>;
				qcom,vooc_strategy1_batt_high_temp2 = <0x1b3>;
				qcom,vooc_strategy1_batt_low_temp0 = <0x190>;
				qcom,vooc_strategy1_batt_low_temp1 = <0x19f>;
				qcom,vooc_strategy1_batt_low_temp2 = <0x1a4>;
				qcom,vooc_strategy1_high_current0 = <0x4>;
				qcom,vooc_strategy1_high_current1 = <0x3>;
				qcom,vooc_strategy1_high_current2 = <0x2>;
				qcom,vooc_strategy1_low_current0 = <0x4>;
				qcom,vooc_strategy1_low_current1 = <0x4>;
				qcom,vooc_strategy1_low_current2 = <0x3>;
				qcom,vooc_strategy2_batt_up_down_temp2 = <0x17c>;
				qcom,vooc_strategy2_batt_up_down_temp4 = <0x190>;
				qcom,vooc_strategy2_batt_up_temp1 = <0x177>;
				qcom,vooc_strategy2_batt_up_temp3 = <0x186>;
				qcom,vooc_strategy2_batt_up_temp5 = <0x19a>;
				qcom,vooc_strategy2_batt_up_temp6 = <0x19f>;
				qcom,vooc_strategy2_high0_current = <0x5>;
				qcom,vooc_strategy2_high1_current = <0x4>;
				qcom,vooc_strategy2_high2_current = <0x3>;
				qcom,vooc_strategy2_high3_current = <0x2>;
				qcom,vooc_strategy_normal_current = <0x6>;
				reg = <0xa 0x0>;
				status = "okay";
			};
		};
	};

	fragment@57 {
		target = <0xffffffff>;

		__overlay__ {

			ccdetect_active {
				phandle = <0x6f>;

				pins_cmd_dat {
					bias-disable;
					input-enable;
					pinmux = <0x500>;
					slew-rate = <0x0>;
				};
			};

			ccdetect_sleep {
				phandle = <0x70>;

				pins_cmd_dat {
					bias-disable;
					input-enable;
					pinmux = <0x500>;
					slew-rate = <0x0>;
				};
			};

			charger_gpio_as_output_high {
				phandle = <0x68>;

				pins_cmd_dat {
					output-high;
					pinmux = <0xc000>;
					slew-rate = <0x1>;
				};
			};

			charger_gpio_as_output_low {
				phandle = <0x67>;

				pins_cmd_dat {
					output-low;
					pinmux = <0xc000>;
					slew-rate = <0x1>;
				};
			};

			chgvin_disable {
				phandle = <0x6e>;

				pins_cmd_dat {
					bias-pull-down = <0x0>;
					output-high;
					pinmux = <0x900>;
					slew-rate = <0x1>;
				};
			};

			chgvin_enable {
				phandle = <0x6d>;

				pins_cmd_dat {
					bias-pull-up = <0x0>;
					output-low;
					pinmux = <0x900>;
					slew-rate = <0x1>;
				};
			};

			dischg_disable {
				phandle = <0x6c>;

				pins_cmd_dat {
					bias-pull-down = <0x0>;
					output-low;
					pinmux = <0x3300>;
					slew-rate = <0x1>;
				};
			};

			dischg_enable {
				phandle = <0x6b>;

				pins_cmd_dat {
					bias-pull-up = <0x0>;
					output-high;
					pinmux = <0x3300>;
					slew-rate = <0x1>;
				};
			};

			eint0default {
				phandle = <0x66>;
			};

			ship_active {
				phandle = <0x6a>;

				pins_cmd_dat {
					output-high;
					pinmux = <0x7e00>;
					slew-rate = <0x1>;
				};
			};

			ship_sleep {
				phandle = <0x69>;

				pins_cmd_dat {
					output-low;
					pinmux = <0x7e00>;
					slew-rate = <0x1>;
				};
			};
		};
	};

	fragment@58 {
		target = <0xffffffff>;

		__overlay__ {

			charging_clock_active {
				phandle = <0x79>;

				pins_cmd_dat {
					bias-pull-up = <0x0>;
					pinmux = <0x5f00>;
					slew-rate = <0x0>;
				};
			};

			charging_clock_sleep {
				phandle = <0x7a>;

				pins_cmd_dat {
					bias-pull-down = <0x0>;
					pinmux = <0x5f00>;
					slew-rate = <0x0>;
				};
			};

			charging_data_active {
				phandle = <0x7b>;

				pins_cmd_dat {
					bias-pull-down = <0x0>;
					pinmux = <0x5e00>;
					slew-rate = <0x0>;
				};
			};

			charging_data_sleep {
				phandle = <0x7c>;

				pins_cmd_dat {
					bias-pull-down = <0x0>;
					pinmux = <0x5e00>;
					slew-rate = <0x0>;
				};
			};

			charging_reset_active {
				phandle = <0x7d>;

				pins_cmd_dat {
					output-high;
					pinmux = <0xbd00>;
					slew-rate = <0x1>;
				};
			};

			charging_reset_sleep {
				phandle = <0x7e>;

				pins_cmd_dat {
					output-low;
					pinmux = <0xbd00>;
					slew-rate = <0x1>;
				};
			};

			charging_switch1_active {
				phandle = <0x77>;

				pins_cmd_dat {
					output-high;
					pinmux = <0xbf00>;
					slew-rate = <0x1>;
				};
			};

			charging_switch1_ctr1_active {
				phandle = <0x7f>;

				pins_cmd_dat {
					output-high;
					pinmux = <0xba00>;
					slew-rate = <0x1>;
				};
			};

			charging_switch1_ctr1_sleep {
				phandle = <0x80>;

				pins_cmd_dat {
					output-low;
					pinmux = <0xba00>;
					slew-rate = <0x1>;
				};
			};

			charging_switch1_sleep {
				phandle = <0x78>;

				pins_cmd_dat {
					output-low;
					pinmux = <0xbf00>;
					slew-rate = <0x1>;
				};
			};

			mps_otg_en_active {
				phandle = <0x74>;

				pins_cmd_dat {
					output-high;
					pinmux = <0x8500>;
					slew-rate = <0x1>;
				};
			};

			mps_otg_en_default {
				phandle = <0x76>;

				pins_cmd_dat {
					output-low;
					pinmux = <0x8500>;
					slew-rate = <0x1>;
				};
			};

			mps_otg_en_sleep {
				phandle = <0x75>;

				pins_cmd_dat {
					output-low;
					pinmux = <0x8500>;
					slew-rate = <0x1>;
				};
			};

			vooc_asic_id_active {
				phandle = <0x81>;

				pins_cmd_dat {
					bias-pull-up;
					input-enable;
					pinmux = <0x3800>;
					slew-rate = <0x0>;
				};
			};

			vooc_asic_id_sleep {
				phandle = <0x82>;

				pins_cmd_dat {
					bias-pull-down;
					input-enable;
					pinmux = <0x3800>;
					slew-rate = <0x0>;
				};
			};
		};
	};

	fragment@59 {
		target = <0xffffffff>;

		__overlay__ {
			pinctrl-0 = <0x83>;
			pinctrl-1 = <0x84>;
			pinctrl-names = "uart0_rx_gpio", "uart0_tx_gpio";
			status = "okay";
		};
	};

	fragment@6 {
		target = <0xffffffff>;

		__overlay__ {
			keypad,volume-down = <0xffffffff 0x9b 0x0>;
			keypad,volume-up = <0xffffffff 0x98 0x0>;
			pinctrl-0 = <0xe>;
			pinctrl-1 = <0xf>;
			pinctrl-names = "volume_up_as_int", "volume_down_as_int";
			status = "okay";
		};
	};

	fragment@60 {
		target = <0xffffffff>;

		__overlay__ {

			uart0_rx_gpio@gpio92 {
				phandle = <0x83>;

				pins_cmd_dat {
					bias-pull-down = <0x0>;
					input-enable;
					pinmux = <0x5c00>;
					slew-rate = <0x0>;
				};
			};

			uart0_tx_gpio@gpio93 {
				phandle = <0x84>;

				pins_cmd_dat {
					bias-pull-down = <0x0>;
					input-enable;
					pinmux = <0x5d00>;
					slew-rate = <0x0>;
				};
			};
		};
	};

	fragment@61 {
		target = <0xffffffff>;

		__overlay__ {
			#address-cells = <0x1>;
			#size-cells = <0x0>;

			dbmd4_interface@0 {
				compatible = "dspg,dbmd4-spi";
				dma_min_buffer_size = <0x0>;
				phandle = <0x85>;
				read-chunk-size = <0x2000>;
				reg = <0x0>;
				spi-max-frequency = <0xf4240>;
				status = "okay";
				write-chunk-size = <0x40000>;
			};
		};
	};

	fragment@62 {
		target = <0xffffffff>;

		__overlay__ {
			amodel_options = <0x24>;
			analog_mic_analog_gain = <0xe>;
			auto_buffering = <0x1>;
			auto_detection = <0x1>;
			boot_options = <0x200>;
			cd-interfaces = <0x85>;
			detection_after_buffering = <0x0>;
			detection_buffer_channels = <0x0>;
			feature-va;
			firmware_id = <0xdbd4>;
			ldo-gpio = <0xffffffff 0x7f 0x0>;
			master-clk-rate = <0x8000>;
			min_samples_chunk_size = <0x80>;
			multi-interface-support = <0x1>;
			pcm_streaming_mode = <0x1>;
			reset-gpio = <0xffffffff 0x13 0x0>;
			send_uevent_after_buffering = <0x0>;
			send_uevent_on_detection = <0x1>;
			sv-gpio = <0xffffffff 0x16 0x0>;
			use_gpio_for_wakeup = <0x1>;
			va-config = <0x800c2400 0x80290020 0x802210a0 0x80330056 0x80091400 0x80158e8e 0x8018000a 0x801b0020 0x80230000 0x801a0011 0x80108000 0x8aab0040 0x805004b0 0x805104b0 0x80410001 0x8060ef81 0x8061f98f 0x806221c0 0x8063fb2f 0x806421c0 0x8065fb2f 0x80660006 0x80000000 0x80000000 0x80000000>;
			va-firmware-name = "dbmd4_va_fw.bin";
			va-interfaces = <0x0 0x0 0x0 0x0>;
			va-mic-config = <0x5012 0x1044 0x7>;
			va-mic-mode = <0x4>;
			va-speeds = <0x0 0x70800 0x0 0xea600 0x0 0x1e8480 0x0 0x493e00 0x0 0x2dc6c0 0x0 0x493e00>;
			va_advanced_options = <0x1d>;
			va_backlog_length = <0x780>;
			va_passphrase_margins = <0x320640>;
			wakeup-gpio = <0xffffffff 0x1b 0x0>;
			wakeup_set_value = <0x0>;
		};
	};

	fragment@63 {
		target = <0xffffffff>;

		__overlay__ {

			power_helper {
				compatible = "oplus,power-helper";
			};
		};
	};

	fragment@64 {
		target = <0xffffffff>;

		__overlay__ {
			compatible = "mediatek, swtp-eint";
			debounce = <0x7d000>;
		};
	};

	fragment@65 {
		target = <0xffffffff>;

		__overlay__ {

			adc_channel@ {
				compatible = "mediatek,adc_channel";
				mediatek,adc_fdd_rf_params_dynamic_custom_ch = <0x2>;
				mediatek,temperature0 = <0x0>;
				mediatek,temperature1 = <0x1>;
				status = "okay";
			};
		};
	};

	fragment@66 {
		target = <0xffffffff>;

		__overlay__ {
			io-channels = <0xffffffff 0x2>;
		};
	};

	fragment@67 {
		target = <0xffffffff>;

		__overlay__ {
			mediatek,clkbuf-config = <0x2 0x1 0x1 0x2 0x0 0x0 0x1>;
			mediatek,clkbuf-controls-for-desense = <0x0 0x4 0x0 0x4 0x0 0x0 0x0>;
			mediatek,clkbuf-output-impedance = <0x6 0x4 0x4 0x4 0x0 0x0 0x4>;
			mediatek,clkbuf-quantity = <0x7>;
			status = "okay";
		};
	};

	fragment@68 {
		target = <0xffffffff>;

		__overlay__ {
			#address-cells = <0x1>;
			#size-cells = <0x0>;
			clock-frequency = <0x61a80>;
			mediatek,use-open-drain;

			i2c_lcd_bias@3e {
				compatible = "mediatek,i2c_lcd_bias";
				phandle = <0x9f>;
				reg = <0x3e>;
				status = "okay";
			};
		};
	};

	fragment@69 {
		target = <0xffffffff>;

		__overlay__ {
			#address-cells = <0x1>;
			#size-cells = <0x0>;
			clock-frequency = <0x61a80>;
			mediatek,use-open-drain;
		};
	};

	fragment@7 {
		target = <0xffffffff>;

		__overlay__ {

			volume_down@0 {
				phandle = <0xf>;

				pins_cmd_dat {
					input-enable;
					pinmux = <0x9b00>;
					slew-rate = <0x0>;
				};
			};

			volume_up@0 {
				phandle = <0xe>;

				pins_cmd_dat {
					input-enable;
					pinmux = <0x9800>;
					slew-rate = <0x0>;
				};
			};
		};
	};

	fragment@70 {
		target = <0xffffffff>;

		__overlay__ {
			#address-cells = <0x1>;
			#size-cells = <0x0>;
			clock-frequency = <0x61a80>;
			mediatek,use-open-drain;

			camera_main@1c {
				compatible = "mediatek,camera_main";
				phandle = <0xa0>;
				reg = <0x1c>;
				status = "okay";
			};

			camera_main_af@72 {
				compatible = "mediatek,camera_main_af";
				phandle = <0xa2>;
				reg = <0x72>;
				status = "okay";
			};

			camera_main_eeprom@a0 {
				compatible = "mediatek,camera_main_eeprom";
				phandle = <0xa1>;
				reg = <0xa0>;
				status = "okay";
			};

			camera_main_three@13 {
				compatible = "mediatek,camera_main_three";
				phandle = <0xa3>;
				reg = <0x13>;
				status = "okay";
			};
		};
	};

	fragment@71 {
		target = <0xffffffff>;

		__overlay__ {
			#address-cells = <0x1>;
			#size-cells = <0x0>;
			clock-frequency = <0x61a80>;
			mediatek,use-open-drain;

			strobe_main@63 {
				compatible = "mediatek,strobe_main";
				phandle = <0xa4>;
				reg = <0x63>;
				status = "okay";
			};
		};
	};

	fragment@72 {
		target = <0xffffffff>;

		__overlay__ {
			#address-cells = <0x1>;
			#size-cells = <0x0>;
			clock-frequency = <0x61a80>;
			mediatek,use-open-drain;

			camera_main_two@10 {
				compatible = "mediatek,camera_main_two";
				phandle = <0xa5>;
				reg = <0x10>;
				status = "okay";
			};

			camera_main_two_af@0c {
				compatible = "mediatek,camera_main_two_af";
				phandle = <0xaa>;
				reg = <0xc>;
				status = "okay";
			};

			camera_main_two_eeprom@51 {
				compatible = "mediatek,camera_main_two_eeprom";
				phandle = <0xa6>;
				reg = <0x51>;
				status = "okay";
			};

			camera_sub@1a {
				compatible = "mediatek,camera_sub";
				phandle = <0xa8>;
				reg = <0x1a>;
				status = "okay";
			};

			camera_sub_eeprom@54 {
				compatible = "mediatek,camera_sub_eeprom";
				phandle = <0xa9>;
				reg = <0x54>;
				status = "okay";
			};

			camera_sub_two@53 {
				compatible = "mediatek,camera_sub_two";
				phandle = <0xa7>;
				reg = <0x53>;
				status = "okay";
			};
		};
	};

	fragment@73 {
		target = <0xffffffff>;

		__overlay__ {
			#address-cells = <0x1>;
			#size-cells = <0x0>;
			clock-frequency = <0x33e140>;
			mediatek,use-push-pull;

			subpmic@34 {
				compatible = "mediatek,subpmic";
				phandle = <0xab>;
				reg = <0x34>;
				status = "okay";
			};

			subpmic_ldo@64 {
				compatible = "mediatek,subpmic_ldo";
				phandle = <0xae>;
				reg = <0x64>;
				status = "okay";
			};

			subpmic_pmic@1a {
				compatible = "mediatek,subpmic_pmic";
				phandle = <0xad>;
				reg = <0x1a>;
				status = "okay";
			};

			usb_type_c@4e {
				compatible = "mediatek,usb_type_c";
				phandle = <0xac>;
				reg = <0x4e>;
				status = "okay";
			};
		};
	};

	fragment@74 {
		target = <0xffffffff>;

		__overlay__ {
			#address-cells = <0x1>;
			#size-cells = <0x0>;
			clock-frequency = <0x61a80>;
			mediatek,use-open-drain;

			dp_switch@50 {
				compatible = "mediatek,dp_switch";
				phandle = <0xb0>;
				reg = <0x50>;
				status = "okay";
			};

			ext_buck_vmddr@51 {
				compatible = "mediatek,ext_buck_vmddr";
				phandle = <0xb1>;
				reg = <0x51>;
				status = "okay";
			};

			speaker_amp@34 {
				compatible = "mediatek,speaker_amp";
				phandle = <0xaf>;
				reg = <0x34>;
				status = "okay";
			};
		};
	};

	fragment@75 {
		target = <0xffffffff>;

		__overlay__ {
			#address-cells = <0x1>;
			#size-cells = <0x0>;
			clock-frequency = <0x186a0>;
			mediatek,use-open-drain;

			bq27411_gauge@55 {
				compatible = "mediatek,bq27411_gauge";
				phandle = <0xb2>;
				reg = <0x55>;
				status = "okay";
			};
		};
	};

	fragment@76 {
		target = <0xffffffff>;

		__overlay__ {
			#address-cells = <0x1>;
			#size-cells = <0x0>;
			clock-frequency = <0x61a80>;
			mediatek,use-open-drain;

			external_pmic@09 {
				compatible = "mediatek,external_pmic";
				phandle = <0xb3>;
				reg = <0x9>;
				status = "okay";
			};

			fan53870@35 {
				compatible = "mediatek,fan53870";
				phandle = <0xb4>;
				reg = <0x35>;
				status = "okay";
			};
		};
	};

	fragment@77 {
		target = <0xffffffff>;

		__overlay__ {
			#address-cells = <0x1>;
			#size-cells = <0x0>;
			clock-frequency = <0x61a80>;
			mediatek,use-open-drain;
		};
	};

	fragment@78 {
		target = <0xffffffff>;

		__overlay__ {
			GPIO_FDD_BAND_SUPPORT_DETECT_1ST_PIN = <0xffffffff 0x3f 0x0>;
			GPIO_FDD_BAND_SUPPORT_DETECT_2ND_PIN = <0xffffffff 0x40 0x0>;
			GPIO_FDD_BAND_SUPPORT_DETECT_3RD_PIN = <0xffffffff 0x41 0x0>;
			GPIO_FDD_BAND_SUPPORT_DETECT_4TH_PIN = <0xffffffff 0x42 0x0>;
			GPIO_SIM1_HOT_PLUG = <0xffffffff 0x2b 0x0>;
			GPIO_SIM1_SCLK = <0xffffffff 0x32 0x0>;
			GPIO_SIM1_SIO = <0xffffffff 0x30 0x0>;
			GPIO_SIM1_SRST = <0xffffffff 0x31 0x0>;
			GPIO_SIM2_SCLK = <0xffffffff 0x2d 0x0>;
			GPIO_SIM2_SIO = <0xffffffff 0x2f 0x0>;
			GPIO_SIM2_SRST = <0xffffffff 0x2e 0x0>;
		};
	};

	fragment@79 {
		target = <0xffffffff>;

		__overlay__ {
			gpio_init_default = <0x0 0x0 0x0 0x0 0x1 0x1 0x1 0x1 0x0 0x0 0x0 0x1 0x0 0x1 0x2 0x0 0x0 0x0 0x1 0x0 0x1 0x3 0x0 0x0 0x0 0x1 0x0 0x1 0x4 0x0 0x0 0x0 0x1 0x1 0x1 0x5 0x0 0x1 0x0 0x1 0x0 0x1 0x6 0x0 0x1 0x0 0x1 0x0 0x0 0x7 0x0 0x0 0x0 0x1 0x0 0x1 0x8 0x0 0x1 0x0 0x1 0x0 0x1 0x9 0x0 0x1 0x0 0x1 0x0 0x1 0xa 0x2 0x0 0x0 0x1 0x0 0x0 0xb 0x2 0x0 0x0 0x0 0x0 0x0 0xc 0x2 0x0 0x0 0x1 0x0 0x0 0xd 0x2 0x0 0x0 0x0 0x0 0x0 0xe 0x0 0x1 0x0 0x1 0x0 0x0 0xf 0x0 0x0 0x0 0x1 0x0 0x0 0x10 0x0 0x1 0x0 0x1 0x0 0x0 0x11 0x1 0x0 0x0 0x1 0x0 0x0 0x12 0x0 0x0 0x0 0x1 0x0 0x1 0x13 0x0 0x1 0x0 0x1 0x0 0x1 0x14 0x0 0x1 0x0 0x1 0x0 0x1 0x15 0x0 0x0 0x0 0x1 0x1 0x1 0x16 0x0 0x0 0x0 0x1 0x0 0x1 0x17 0x0 0x0 0x0 0x1 0x1 0x1 0x18 0x0 0x0 0x0 0x1 0x1 0x1 0x19 0x0 0x0 0x0 0x1 0x1 0x1 0x1a 0x0 0x1 0x0 0x1 0x0 0x1 0x1b 0x0 0x1 0x0 0x1 0x0 0x1 0x1c 0x0 0x0 0x0 0x1 0x0 0x1 0x1d 0x0 0x0 0x0 0x1 0x0 0x1 0x1e 0x0 0x1 0x0 0x1 0x0 0x1 0x1f 0x0 0x0 0x0 0x1 0x1 0x1 0x20 0x1 0x0 0x0 0x0 0x0 0x1 0x21 0x1 0x0 0x0 0x0 0x0 0x1 0x22 0x1 0x0 0x0 0x1 0x0 0x1 0x23 0x1 0x0 0x0 0x0 0x0 0x1 0x24 0x1 0x1 0x0 0x0 0x0 0x0 0x25 0x1 0x1 0x0 0x0 0x0 0x0 0x26 0x1 0x0 0x0 0x1 0x1 0x0 0x27 0x1 0x1 0x0 0x1 0x0 0x0 0x28 0x1 0x0 0x0 0x0 0x0 0x0 0x29 0x1 0x0 0x0 0x1 0x0 0x0 0x2a 0x0 0x1 0x0 0x1 0x0 0x0 0x2b 0x1 0x0 0x0 0x1 0x1 0x1 0x2c 0x0 0x0 0x0 0x1 0x0 0x1 0x2d 0x1 0x0 0x0 0x0 0x0 0x1 0x2e 0x1 0x0 0x0 0x0 0x0 0x1 0x2f 0x1 0x0 0x0 0x1 0x1 0x1 0x30 0x1 0x0 0x0 0x1 0x1 0x1 0x31 0x1 0x0 0x0 0x0 0x0 0x1 0x32 0x1 0x0 0x0 0x0 0x0 0x1 0x33 0x0 0x1 0x0 0x1 0x0 0x1 0x34 0x1 0x0 0x0 0x1 0x1 0x1 0x35 0x1 0x0 0x0 0x1 0x1 0x1 0x36 0x1 0x0 0x0 0x1 0x1 0x1 0x37 0x1 0x0 0x0 0x1 0x1 0x1 0x38 0x1 0x0 0x0 0x1 0x1 0x1 0x39 0x1 0x0 0x0 0x1 0x0 0x0 0x3a 0x1 0x0 0x0 0x1 0x0 0x0 0x3b 0x1 0x0 0x0 0x1 0x0 0x1 0x3c 0x1 0x0 0x0 0x1 0x0 0x1 0x3d 0x1 0x0 0x0 0x1 0x0 0x0 0x3e 0x1 0x0 0x0 0x1 0x0 0x1 0x3f 0x0 0x0 0x0 0x1 0x0 0x0 0x40 0x0 0x0 0x0 0x1 0x0 0x0 0x41 0x0 0x0 0x0 0x1 0x0 0x0 0x42 0x0 0x0 0x0 0x1 0x0 0x0 0x43 0x1 0x0 0x0 0x1 0x0 0x0 0x44 0x1 0x0 0x0 0x1 0x0 0x0 0x45 0x1 0x0 0x0 0x1 0x0 0x0 0x46 0x1 0x0 0x0 0x1 0x0 0x0 0x47 0x1 0x0 0x0 0x1 0x0 0x0 0x48 0x0 0x0 0x0 0x1 0x1 0x0 0x49 0x1 0x0 0x0 0x1 0x0 0x0 0x4a 0x1 0x0 0x0 0x1 0x0 0x0 0x4b 0x1 0x0 0x0 0x1 0x0 0x0 0x4c 0x1 0x0 0x0 0x1 0x0 0x0 0x4d 0x1 0x0 0x0 0x1 0x0 0x0 0x4e 0x1 0x0 0x0 0x1 0x0 0x0 0x4f 0x1 0x0 0x0 0x1 0x0 0x0 0x50 0x1 0x0 0x0 0x1 0x0 0x0 0x51 0x1 0x0 0x0 0x1 0x0 0x0 0x52 0x1 0x0 0x0 0x1 0x0 0x0 0x53 0x1 0x0 0x0 0x1 0x0 0x0 0x54 0x1 0x0 0x0 0x1 0x0 0x0 0x55 0x1 0x0 0x0 0x1 0x0 0x0 0x56 0x1 0x0 0x0 0x1 0x0 0x0 0x57 0x1 0x0 0x0 0x1 0x0 0x0 0x58 0x1 0x0 0x0 0x1 0x0 0x0 0x59 0x1 0x0 0x0 0x0 0x0 0x1 0x5a 0x1 0x0 0x0 0x0 0x0 0x1 0x5c 0x1 0x0 0x0 0x0 0x0 0x0 0x5d 0x1 0x0 0x0 0x0 0x0 0x0 0x5e 0x0 0x1 0x0 0x1 0x0 0x0 0x5f 0x0 0x1 0x0 0x1 0x0 0x0 0x60 0x7 0x0 0x0 0x1 0x0 0x0 0x61 0x7 0x0 0x0 0x1 0x0 0x0 0x62 0x7 0x0 0x0 0x1 0x0 0x0 0x63 0x7 0x0 0x0 0x0 0x0 0x0 0x64 0x7 0x0 0x0 0x1 0x0 0x0 0x65 0x7 0x0 0x0 0x1 0x0 0x0 0x66 0x7 0x0 0x0 0x1 0x0 0x0 0x67 0x1 0x0 0x0 0x1 0x0 0x1 0x68 0x1 0x1 0x0 0x1 0x0 0x1 0x69 0x1 0x0 0x0 0x0 0x0 0x1 0x6a 0x1 0x1 0x0 0x1 0x0 0x1 0x6b 0x7 0x0 0x0 0x1 0x0 0x1 0x6c 0x7 0x0 0x0 0x1 0x0 0x0 0x6d 0x7 0x0 0x0 0x1 0x0 0x0 0x6e 0x0 0x1 0x0 0x1 0x0 0x0 0x6f 0x0 0x1 0x0 0x1 0x0 0x0 0x70 0x0 0x1 0x0 0x1 0x0 0x0 0x71 0x0 0x1 0x0 0x1 0x0 0x0 0x72 0x2 0x0 0x0 0x1 0x0 0x0 0x73 0x2 0x0 0x0 0x0 0x0 0x0 0x74 0x2 0x0 0x0 0x0 0x0 0x0 0x75 0x2 0x0 0x0 0x0 0x0 0x0 0x76 0x2 0x0 0x0 0x1 0x1 0x1 0x77 0x2 0x0 0x0 0x1 0x1 0x1 0x78 0x1 0x0 0x0 0x1 0x1 0x1 0x79 0x1 0x0 0x0 0x1 0x1 0x1 0x7a 0x1 0x0 0x0 0x1 0x1 0x1 0x7b 0x1 0x0 0x0 0x1 0x1 0x1 0x7c 0x1 0x0 0x0 0x0 0x0 0x1 0x7d 0x1 0x0 0x0 0x0 0x0 0x1 0x7e 0x0 0x1 0x0 0x1 0x0 0x0 0x7f 0x0 0x1 0x1 0x1 0x0 0x0 0x80 0x0 0x1 0x0 0x1 0x0 0x1 0x81 0x0 0x1 0x0 0x1 0x0 0x0 0x82 0x1 0x1 0x0 0x0 0x0 0x0 0x83 0x1 0x1 0x0 0x0 0x0 0x0 0x84 0x1 0x0 0x0 0x1 0x0 0x0 0x85 0x0 0x1 0x0 0x1 0x0 0x0 0x86 0x0 0x1 0x0 0x1 0x0 0x0 0x87 0x0 0x0 0x0 0x1 0x1 0x0 0x88 0x1 0x1 0x0 0x0 0x0 0x0 0x89 0x1 0x1 0x0 0x0 0x0 0x0 0x8a 0x0 0x1 0x0 0x1 0x0 0x0 0x8b 0x1 0x0 0x0 0x1 0x1 0x1 0x8c 0x1 0x0 0x0 0x1 0x1 0x1 0x8d 0x1 0x0 0x0 0x1 0x1 0x1 0x8e 0x1 0x0 0x0 0x1 0x1 0x1 0x8f 0x1 0x1 0x0 0x0 0x0 0x0 0x90 0x1 0x1 0x0 0x0 0x0 0x0 0x91 0x1 0x1 0x0 0x0 0x0 0x0 0x92 0x1 0x1 0x0 0x0 0x0 0x0 0x93 0x1 0x1 0x0 0x0 0x0 0x0 0x94 0x0 0x1 0x0 0x1 0x0 0x0 0x95 0x1 0x1 0x0 0x0 0x0 0x0 0x96 0x1 0x1 0x0 0x0 0x0 0x0 0x97 0x1 0x1 0x0 0x0 0x0 0x0 0x98 0x0 0x0 0x0 0x1 0x0 0x0 0x99 0x0 0x0 0x0 0x1 0x0 0x0 0x9a 0x1 0x0 0x0 0x1 0x1 0x0 0x9b 0x1 0x0 0x0 0x1 0x1 0x0 0x9c 0x1 0x0 0x0 0x0 0x0 0x0 0x9d 0x0 0x0 0x0 0x0 0x0 0x0 0x9e 0x1 0x0 0x0 0x1 0x0 0x0 0x9f 0x1 0x0 0x0 0x0 0x0 0x0 0xa0 0x1 0x0 0x0 0x1 0x1 0x1 0xa1 0x1 0x0 0x0 0x1 0x1 0x1 0xa2 0x0 0x0 0x0 0x1 0x0 0x1 0xa3 0x0 0x0 0x0 0x1 0x0 0x1 0xa4 0x0 0x0 0x0 0x1 0x0 0x1 0xa5 0x1 0x0 0x0 0x1 0x0 0x1 0xa6 0x1 0x0 0x0 0x1 0x0 0x1 0xa7 0x0 0x0 0x0 0x1 0x0 0x1 0xa8 0x6 0x0 0x0 0x1 0x1 0x1 0xa9 0x6 0x0 0x0 0x1 0x1 0x1 0xaa 0x6 0x0 0x0 0x1 0x1 0x1 0xab 0x6 0x0 0x0 0x1 0x1 0x1 0xac 0x0 0x0 0x0 0x1 0x0 0x0 0xad 0x0 0x0 0x0 0x1 0x0 0x0 0xae 0x0 0x0 0x0 0x1 0x0 0x0 0xaf 0x0 0x0 0x0 0x1 0x0 0x0 0xb0 0x0 0x0 0x0 0x1 0x0 0x0 0xb1 0x0 0x0 0x0 0x1 0x0 0x0 0xb2 0x0 0x0 0x0 0x1 0x0 0x0 0xb3 0x0 0x0 0x0 0x1 0x0 0x0 0xb4 0x0 0x0 0x0 0x1 0x0 0x0 0xb5 0x0 0x0 0x0 0x1 0x0 0x0 0xb6 0x0 0x0 0x0 0x1 0x0 0x0 0xb9 0x0 0x0 0x0 0x0 0x0 0x1 0xba 0x0 0x1 0x0 0x1 0x0 0x1 0xbd 0x0 0x1 0x0 0x1 0x0 0x1 0xbf 0x0 0x1 0x0 0x1 0x0 0x1 0xc0 0x0 0x1 0x0 0x1 0x0 0x1 0xc3 0x1 0x0 0x0 0x0 0x0 0x0 0xc4 0x1 0x0 0x0 0x0 0x0 0x1 0xc5 0x1 0x0 0x0 0x0 0x0 0x1 0xc6 0x1 0x0 0x0 0x0 0x0 0x1 0xc7 0x1 0x0 0x0 0x1 0x0 0x1 0xc8 0x1 0x0 0x0 0x1 0x1 0x1 0xc9 0x1 0x0 0x0 0x1 0x1 0x1 0xca 0x1 0x0 0x0 0x1 0x1 0x1 0xcb 0x1 0x0 0x0 0x1 0x1 0x1 0xcc 0x1 0x0 0x0 0x1 0x1 0x1 0xcd 0x1 0x0 0x0 0x1 0x1 0x1 0xce 0x1 0x0 0x0 0x0 0x0 0x0 0xcf 0x1 0x0 0x0 0x0 0x0 0x0 0xd0 0x1 0x0 0x0 0x0 0x0 0x0 0xd1 0x1 0x0 0x0 0x1 0x0 0x0 0xd2 0x1 0x0 0x0 0x0 0x0 0x0 0xd3 0x1 0x0 0x0 0x0 0x0 0x0 0xd4 0x1 0x0 0x0 0x0 0x0 0x0 0xd5 0x1 0x0 0x0 0x1 0x0 0x1 0xd6 0x1 0x0 0x0 0x0 0x0 0x1 0xd7 0x1 0x0 0x0 0x0 0x0 0x1 0xd8 0x1 0x0 0x0 0x0 0x0 0x1 0xd9 0x1 0x0 0x0 0x0 0x0 0x1 0xda 0x1 0x0 0x0 0x1 0x0 0x1 0xdb 0x1 0x0 0x0 0x1 0x0 0x1 0xdc 0x0 0x0 0x0 0x1 0x0 0x0 0xdd 0x0 0x0 0x0 0x1 0x0 0x0 0xde 0x0 0x0 0x0 0x1 0x0 0x0 0xdf 0x0 0x0 0x0 0x1 0x0 0x0 0xe0 0x0 0x0 0x0 0x1 0x0 0x0 0xe1 0x0 0x0 0x0 0x1 0x0 0x0 0xe2 0x0 0x0 0x0 0x1 0x0 0x0>;
		};
	};

	fragment@8 {
		target = <0xffffffff>;

		__overlay__ {
			clock-frequency = <0x61a80>;
			pinctrl-0 = <0x10>;
			pinctrl-1 = <0x11>;
			pinctrl-2 = <0x12>;
			pinctrl-3 = <0x13>;
			pinctrl-4 = <0x14>;
			pinctrl-names = "default", "ts_int_active", "ts_reset_active", "ts_int_suspend", "ts_reset_suspend";

			s6sy771_20601@48 {
				black_gesture_support;
				charger_pump_support;
				chip-name = "S6SY771";
				compatible = "sec-s6sy771";
				fingerprint_underscreen_support;
				fw_update_app_support;
				game_switch_support;
				headset_pump_support;
				interrupt-parent = <0xffffffff>;
				interrupts = <0x15 0x2008>;
				irq-gpio = <0xffffffff 0x15 0x2008>;
				kernel_grip_support;
				pinctrl-0 = <0x15>;
				pinctrl-1 = <0x16>;
				pinctrl-names = "pmx_ts_active", "pmx_ts_suspend";
				pressure_report_support;
				prevention,condition_area_width = <0x2d 0x1e 0x32 0x32>;
				prevention,condition_judge_para = <0x32 0x0>;
				prevention,dead_area_width = <0xa 0xa>;
				prevention,eli_area_width = <0x78 0x1f4 0x258 0x78>;
				prevention,grip_disable_level = <0x4>;
				prevention,grip_handle_in_fw;
				prevention,large_area_width = <0x46 0x64>;
				prevention,large_corner_judge_para = <0x32 0x0 0x0 0x0 0x0 0x0>;
				prevention,large_corner_width = <0x3c 0xc8 0x0>;
				prevention,large_judge_para = <0xf 0x28 0x28>;
				prevention,makeup_cnt_weight = <0x4 0x1 0x2 0x2 0x1>;
				prevention,no_handle_para = <0x0 0x258 0x384>;
				reg = <0x48>;
				reset-gpio = <0xffffffff 0x14 0x1>;
				smart_gesture_support;
				touchpanel,button-type = <0x4>;
				touchpanel,display-coords = <0x438 0x960>;
				touchpanel,elimination-range = <0x14 0xc8 0xc8>;
				touchpanel,max-num-support = <0xa>;
				touchpanel,panel-coords = <0x438 0x960>;
				touchpanel,touchmajor-limit = <0x20 0x36>;
				touchpanel,tx-rx-num = <0x10 0x24>;
				touchpanel.button-TRx = <0x0 0x0>;
				vdd_2v8-supply = <0xffffffff>;
			};

			synaptics_20601@4B {
				black_gesture_support;
				charger_pump_support;
				chip-name = "S3908";
				compatible = "synaptics-s3908";
				fingerprint_underscreen_support;
				freq_hop_simulate_support;
				fw_edge_limit_support;
				fw_update_app_support;
				game_switch_support;
				interrupt-parent = <0xffffffff>;
				interrupts = <0x15 0x2008>;
				irq-gpio = <0xffffffff 0x15 0x2008>;
				irq_need_dev_resume_ok;
				pinctrl-0 = <0x15>;
				pinctrl-1 = <0x16>;
				pinctrl-names = "pmx_ts_active", "pmx_ts_suspend";
				pressure_report_support;
				reg = <0x4b>;
				report_flow_unlock_support;
				reset-gpio = <0xffffffff 0x14 0x1>;
				screenoff_fingerprint_info_support;
				smart_gesture_support;
				touchpanel,button-type = <0x4>;
				touchpanel,curved-size = <0x2d>;
				touchpanel,display-coords = <0x438 0x960>;
				touchpanel,int-mode = <0x1>;
				touchpanel,max-num-support = <0xa>;
				touchpanel,panel-coords = <0x438 0x960>;
				touchpanel,touchmajor-limit = <0x0 0x36>;
				touchpanel,tx-rx-num = <0x10 0x24>;
				touchpanel.button-TRx = <0x0 0x0>;
				vdd_2v8-supply = <0xffffffff>;
			};
		};
	};

	fragment@80 {
		target = <0xffffffff>;

		__overlay__ {
			deb-gpios = <0xffffffff 0x0 0x0>;
			debounce = <0x7d000>;
			interrupt-parent = <0xffffffff>;
			interrupts = <0x0 0x8 0x0 0x0>;
			status = "okay";
		};
	};

	fragment@81 {
		target = <0xffffffff>;

		__overlay__ {
			interrupt-parent = <0xffffffff>;
			interrupts = <0x7 0x4 0x7 0x0>;
			status = "okay";
		};
	};

	fragment@82 {
		target = <0xffffffff>;

		__overlay__ {
			interrupt-parent = <0xffffffff>;
			interrupts = <0x15 0x2 0x15 0x0>;
			status = "okay";
		};
	};

	fragment@83 {
		target = <0xffffffff>;

		__overlay__ {
			interrupt-parent = <0xffffffff>;
			interrupts = <0x18 0x2 0x18 0x0>;
			status = "okay";
		};
	};

	fragment@84 {
		target = <0xffffffff>;

		__overlay__ {
			interrupt-parent = <0xffffffff>;
			interrupts = <0x19 0x2 0x19 0x0>;
			status = "okay";
		};
	};

	fragment@85 {
		target = <0xffffffff>;

		__overlay__ {
			interrupt-parent = <0xffffffff>;
			interrupts = <0x1f 0x8 0x1f 0x0>;
			status = "okay";
		};
	};

	fragment@86 {
		target = <0xffffffff>;

		__overlay__ {
			interrupt-parent = <0xffffffff>;
			interrupts = <0x29 0x1 0x29 0x1>;
			status = "okay";
		};
	};

	fragment@87 {
		target = <0xffffffff>;

		__overlay__ {
			deb-gpios = <0xffffffff 0x48 0x0>;
			interrupt-parent = <0xffffffff>;
			interrupts = <0x48 0x4 0x48 0x0>;
			status = "okay";
		};
	};

	fragment@88 {
		target = <0xffffffff>;

		__overlay__ {
			compatible = "mediatek,md1_sim1_hot_plug_eint-eint";
			debounce = <0x0 0x2710>;
			dedicated = <0x0 0x0>;
			interrupts = <0x0 0x8>;
			sockettype = <0x0 0x0>;
			src_pin = <0x0 0x1>;
			status = "okay";
		};
	};

	fragment@89 {
		target = <0xffffffff>;

		__overlay__ {
			regulator-default-on = <0x1>;
			regulator-name = "vcamio";
			status = "okay";
		};
	};

	fragment@9 {
		target = <0xffffffff>;

		__overlay__ {

			camera_eeprom0@59 {
				compatible = "mediatek,camera_eeprom";
				phandle = <0x92>;
				reg = <0x59>;
				status = "okay";
			};
		};
	};

	fragment@90 {
		target = <0xffffffff>;

		__overlay__ {
			regulator-default-on = <0x1>;
			regulator-name = "vtp";
			status = "okay";
		};
	};

	fragment@91 {
		target = <0xffffffff>;

		__overlay__ {
			status = "okay";
			vcamio-supply = <0xffffffff>;
			vcamio_main2-supply = <0xffffffff>;
			vcamio_main3-supply = <0xffffffff>;
			vcamio_sub-supply = <0xffffffff>;
			vcamio_sub2-supply = <0xffffffff>;
		};
	};

	fragment@92 {
		target = <0xffffffff>;

		__overlay__ {
			status = "okay";
			vtouch-supply = <0xffffffff>;
		};
	};

	fragment@93 {
		target = <0xffffffff>;

		__overlay__ {
			mediatek,kpd-hw-dl-key0 = <0x11>;
			mediatek,kpd-hw-dl-key1 = <0x1>;
			mediatek,kpd-hw-dl-key2 = <0x8>;
			mediatek,kpd-hw-factory-key = <0x1>;
			mediatek,kpd-hw-init-map = <0x0 0x72 0x0 0x0 0x0 0x0 0x0 0x0 0x0 0x0 0x0 0x0 0x0 0x0 0x0 0x0 0x0 0x0 0x0 0x0 0x0 0x0 0x0 0x0 0x0 0x0 0x0 0x0 0x0 0x0 0x0 0x0 0x0 0x0 0x0 0x0 0x0 0x0 0x0 0x0 0x0 0x0 0x0 0x0 0x0 0x0 0x0 0x0 0x0 0x0 0x0 0x0 0x0 0x0 0x0 0x0 0x0 0x0 0x0 0x0 0x0 0x0 0x0 0x0 0x0 0x0 0x0 0x0 0x0 0x0 0x0 0x0>;
			mediatek,kpd-hw-map-num = <0x48>;
			mediatek,kpd-hw-pwrkey = <0x8>;
			mediatek,kpd-hw-recovery-key = <0x11>;
			mediatek,kpd-hw-rstkey = <0x11>;
			mediatek,kpd-key-debounce = <0x400>;
			mediatek,kpd-pwkey-gpio-din = <0x0>;
			mediatek,kpd-pwrkey-eint-gpio = <0x0>;
			mediatek,kpd-sw-pwrkey = <0x74>;
			mediatek,kpd-sw-rstkey = <0x73>;
			mediatek,kpd-use-extend-type = <0x0>;
			status = "okay";
		};
	};
};
